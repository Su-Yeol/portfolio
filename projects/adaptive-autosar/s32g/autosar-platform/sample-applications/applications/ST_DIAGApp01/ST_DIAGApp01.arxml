AUTOSAR XML (schema 00052)
package /apd/AdaptiveApplicationSwComponentTypes
  adaptive application sw component type ST_DIAGApp01
    provide port DiagDataServicePport: provided-interface=DataIdentifier
package /apd/Executables
  executable ST_DIAGApp01: category=APPLICATION_LEVEL, minimum-timer-granularity=1000.0
    root sw component prototype ST_DIAGApp01Root: application-type=ST_DIAGApp01
