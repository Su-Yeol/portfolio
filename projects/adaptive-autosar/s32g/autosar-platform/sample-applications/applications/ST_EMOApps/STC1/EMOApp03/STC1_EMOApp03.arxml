AUTOSAR XML (schema 00052)
package /apd/AdaptiveApplicationSwComponentTypes
  adaptive application sw component type STC1_EMOApp03
package /apd/Executables
  executable STC1_EMOApp03: category=APPLICATION_LEVEL, minimum-timer-granularity=1000.0, reporting-behavior=REPORTS-EXECUTION-STATE, version=1.0.0
    root sw component prototype STC1_EMOApp03Root: application-type=STC1_EMOApp03
