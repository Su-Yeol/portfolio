AUTOSAR XML (schema 00052)
package /apd/AdaptiveApplicationSwComponentTypes
  adaptive application sw component type CMValidatorSubscriber
    require port CMValidatorSubscriber_RPort: required-interface=CMValidatorPublisher
package /apd/Executables
  executable CMValidatorSubscriber: category=APPLICATION_LEVEL, minimum-timer-granularity=1000.0
    root sw component prototype CMValidatorSubscriber: application-type=CMValidatorSubscriber
