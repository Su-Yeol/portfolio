AUTOSAR XML (schema 00052)
package /apd/AdaptiveApplicationSwComponentTypes
  adaptive application sw component type SensorDemoApplication
package /apd/Executables
  executable SensorDemoApplication: category=APPLICATION_LEVEL, minimum-timer-granularity=1000, reporting-behavior=REPORTS-EXECUTION-STATE
    root sw component prototype SensorDemoApplication: application-type=SensorDemoApplication
