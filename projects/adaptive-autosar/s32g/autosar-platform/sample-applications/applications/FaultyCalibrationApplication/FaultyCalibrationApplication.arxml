AUTOSAR XML (schema 00052)
package /apd/AdaptiveApplicationSwComponentTypes
  adaptive application sw component type FaultyCalibrationApplication
package /apd/Executables
  executable FaultyCalibrationApplication: category=APPLICATION_LEVEL, minimum-timer-granularity=1000, reporting-behavior=REPORTS-EXECUTION-STATE
    root sw component prototype FaultyCalibrationApp: application-type=FaultyCalibrationApplication
