AUTOSAR XML (schema 00052)
package /apd/AdaptiveApplicationSwComponentTypes
  adaptive application sw component type fc_firewall
package /apd/Executables
  executable fc_firewall: category=APPLICATION_LEVEL, minimum-timer-granularity=1000.0, version=1.0.0-1234567890
    root sw component prototype fc_firewallRoot: application-type=fc_firewall
