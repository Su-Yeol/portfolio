AUTOSAR XML (schema 00052)
package /apd/AdaptiveApplicationSwComponentTypes
  adaptive application sw component type access_manager_swc
package /apd/Executables
  executable access_manager: category=PLATFORM_LEVEL, build-type=BUILD-TYPE-DEBUG, minimum-timer-granularity=1000.0, version=1.0.0
    root sw component prototype access_manager_root: application-type=access_manager_swc
