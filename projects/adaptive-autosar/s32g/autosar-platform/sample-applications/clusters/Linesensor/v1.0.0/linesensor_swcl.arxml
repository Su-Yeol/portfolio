AUTOSAR XML (schema 00052)
package /apd/SoftwareClusters/Linesensor
  software cluster LinesensorAppSwcl: artifact-checksums=@ARTIFACT_CHECKSUMS@, installation-behavior=CAN-BE-REMOVED, license=AUTOSAR_LIC, release-notes=R2003_RN, type-approval=e1*2024/123*4567*89, vendor-id=1447315780, version=1.0.0
