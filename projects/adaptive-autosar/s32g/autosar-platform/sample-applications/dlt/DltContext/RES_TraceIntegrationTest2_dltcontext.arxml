AUTOSAR XML (schema 00052)
package /apd/Dlt
  dlt context TraceIntegrationTest2_DltContext: context-id=TIT2_CX, dlt-messages=Test1Msg
