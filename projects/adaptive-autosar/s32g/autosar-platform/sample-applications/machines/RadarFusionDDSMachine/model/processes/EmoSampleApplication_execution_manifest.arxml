AUTOSAR XML (schema 00052)
package /apd/Machines/RadarFusionDDSMachine/ProcessToMachineMappings
  process to machine mapping set EmoSampleApplication
    process to machine mapping EmoSampleApplication: machine=RadarFusionDDSMachine, process=EmoSampleApplication
package /apd/Machines/RadarFusionDDSMachine/DltLogChannelToProcessMappings
  dlt application to process mapping EmoSampleApplicationDltApplicationToProcessMapping: dlt-application=EmoSampleApplicationLogChannel, process=EmoSampleApplication
  dlt log sink to port prototype mapping EmoSampleApplicationDltLogSinkToPortPrototypeMapping: dlt-context=DefaultDltContext, dlt-log-sink=[EmoSampleApplicationFileDltSink, ConsoleDltSink, RemoteDltSink], process=EmoSampleApplication
package /apd/Machines/RadarFusionDDSMachine/Processes
  process EmoSampleApplication: design=EmoSampleApplication, executable=EmoSampleApplication
    process state machine state_machine: type=ProcessStateMachine
    state-dependent-startup-configs:
      function-group-state=MachineFG.Driving, resource-group=ResourceGroup1, startup-config=ConfigDriving
      function-group-state=MachineFG.Parking, resource-group=ResourceGroup1, startup-config=ConfigParking
package /apd/Machines/RadarFusionDDSMachine/StartupConfigSets
  startup config ConfigDriving: environment-variables=tag-with-optional-value={key=DLT_LOG_MODE, value=3}, execution-error=EmoSampleApplicationExecutionErrorDriving, process-argument=Driving, scheduling-policy=SCHED_RR, scheduling-priority=12, termination-behavior=PROCESS-IS-NOT-SELF-TERMINATING, timeout={enter-timeout-value=1.0, exit-timeout-value=0.5}
  startup config ConfigParking: environment-variables=tag-with-optional-value={key=DLT_LOG_MODE, value=3}, execution-error=EmoSampleApplicationExecutionErrorParking, process-argument=Parking, scheduling-policy=SCHED_RR, scheduling-priority=12, termination-behavior=PROCESS-IS-SELF-TERMINATING, timeout={enter-timeout-value=0.75, exit-timeout-value=0.3}
package /apd/Machines/RadarFusionDDSMachine/EmoSampleApplicationExecErrors
  process execution error EmoSampleApplicationExecutionErrorDriving: execution-error=42
  process execution error EmoSampleApplicationExecutionErrorParking: execution-error=55
