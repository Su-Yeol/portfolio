AUTOSAR XML (schema 00052)
package /apd/Machines/RadarFusionDDSMachine/ServiceInstanceToMachineMappings
  dds service instance to machine mapping radar_RequiredServiceInstance_toMachine: communication-connector=RadarFusionDDSConnector, service-instance=Radar_RequiredDdsServiceInstance
package /apd/Machines/RadarFusionDDSMachine/ServiceInstances
  dds required service instance Radar_RequiredDdsServiceInstance: service-interface-deployment=Radar_Dds, qos-profile=default, domain-id=42, dds-event-qos-props{qos-profile=default, event=DdsEventBrakeEvent}, required-service-instance-id=19
    e-2-e-event-protection-propss:
      end 2 end event protection props End2EndEventProtectionProps: data-ids=4321, e-2-e-profile-configuration=PROFILE_01, event=DdsEventBrakeEvent, max-data-length=4096, min-data-length=1
      end 2 end event protection props End2EndEventProtectionProps: data-ids=[4321, 4321], e-2-e-profile-configuration=PROFILE_01, event=DdsEventParkingBrakeEvent, max-data-length=4096, min-data-length=1
