AUTOSAR XML (schema 00052)
package /apd/Machines/RadarFusionDDSMachine/ProcessToMachineMappings
  process to machine mapping set Radar
    process to machine mapping Radar: machine=RadarFusionDDSMachine, process=radar
package /apd/Machines/RadarFusionDDSMachine/Processes
  process radar: design=radar, executable=radar, state-dependent-startup-config{function-group-state=[MachineFG.Driving, MachineFG.Parking], resource-group=ResourceGroup1, startup-config=RadarStartup}
    process state machine state_machine: type=ProcessStateMachine
package /apd/Machines/RadarFusionDDSMachine/Dlt
  dlt application to process mapping RadarManagerDltApplicationToProcessMapping: dlt-application=RadarApplication, process=radar
  dlt log sink to port prototype mapping RadarDltLogSinkToPortPrototypeMapping: dlt-context=DefaultDltContext, dlt-log-sink=[ConsoleDltSink, RemoteDltSink, RadarFileDltSink], process=radar
package /apd/Machines/RadarFusionDDSMachine/ServiceInstanceToPortPrototypeMappings
  service instance to port prototype mapping radar_ProvidedServiceInstance_toPort: port-prototype=radar_PPort, process=radar, service-instance=Radar_ProvidedDdsServiceInstance
package /apd/Machines/RadarFusionDDSMachine/StartupConfigSets
  startup config RadarStartup: scheduling-policy=SCHEDULING-POLICY-ROUND-ROBIN, scheduling-priority=12, termination-behavior=PROCESS-IS-NOT-SELF-TERMINATING
