AUTOSAR XML (schema 00052)
package /adcm/Machines/AdaptiveMachine/ProcessDesigns
  process design TimeSyncConsumer: executable=TimeSyncConsumer
