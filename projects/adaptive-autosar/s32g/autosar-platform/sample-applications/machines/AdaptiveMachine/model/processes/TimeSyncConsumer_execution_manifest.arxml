AUTOSAR XML (schema 00052)
package /adcm/Machines/AdaptiveMachine/ProcessToMachineMappings
  process to machine mapping set TimeSyncConsumer
    process to machine mapping TimeSyncConsumer: machine=AdaptiveMachine, process=TimeSyncConsumer
package /adcm/Machines/AdaptiveMachine/DltLogChannelToProcessMappings
  dlt application to process mapping TimeSyncConsumerDltApplicationToProcessMapping: dlt-application=TimeSyncConsumerApplication, process=TimeSyncConsumer
  dlt log sink to port prototype mapping TimeSyncConsumerDltLogSinkToPortPrototypeMapping: dlt-context=DefaultDltContext, dlt-log-sink=[TimeSyncConsumerFileDltSink, ConsoleDltSink, RemoteDltSink], process=TimeSyncConsumer
package /adcm/Machines/AdaptiveMachine/Processes
  process TimeSyncConsumer: executable=TimeSyncConsumer, state-dependent-startup-config{execution-dependency=state_machine.Running, function-group-state=MachineFG.Driving, resource-group=ResourceGroupADCM, startup-config=TimeSyncConsumer}
    process state machine state_machine: type=ProcessStateMachine
package /adcm/Machines/AdaptiveMachine/StartupConfigSets
  startup config TimeSyncConsumer: scheduling-policy=SCHEDULING-POLICY-ROUND-ROBIN, scheduling-priority=12, termination-behavior=PROCESS-IS-NOT-SELF-TERMINATING
