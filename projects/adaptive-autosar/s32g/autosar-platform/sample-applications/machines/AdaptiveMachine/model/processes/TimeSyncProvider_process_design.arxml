AUTOSAR XML (schema 00052)
package /adcm/Machines/AdaptiveMachine/ProcessDesigns
  process design TimeSyncProvider: executable=TimeSyncProvider
