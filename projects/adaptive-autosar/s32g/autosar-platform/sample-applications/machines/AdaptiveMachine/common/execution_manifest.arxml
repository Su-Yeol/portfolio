AUTOSAR XML (schema 00052)
package /adcm/ModeDeclarationGroups
  mode declaration group ProcessStateMachine: initial-mode=Idle
    5 x mode:
      Idle
      Starting
      Running
      Terminating
      Terminated
package /adcm/StartupConfigSets
  startup config DefaultStartupConfig: scheduling-policy=SCHEDULING-POLICY-ROUND-ROBIN, scheduling-priority=12
