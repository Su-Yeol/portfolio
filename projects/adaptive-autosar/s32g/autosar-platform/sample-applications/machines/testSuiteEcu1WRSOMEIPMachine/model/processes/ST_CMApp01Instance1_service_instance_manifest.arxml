AUTOSAR XML (schema 00052)
package /apd/Machines/testSuiteEcu1WRSOMEIPMachine/ServiceInstanceToMachineMappings
  someip service instance to machine mapping CMApp01DiagRoutineProvidedServiceInstanceToEcu1Machine: communication-connector=CommunicationWRSOMEIPConnector1, service-instance=ST_CMApp01DiagRoutineProvidedSomeipServiceInstance, udp-port=ST_CMApp01DiagRoutineApplicationEndpoint
  someip service instance to machine mapping CMService1ProvidedServiceInstanceToEcu1Machine: communication-connector=CommunicationWRSOMEIPConnector1, service-instance=ST_CMService1ProvidedSomeipServiceInstance, udp-port=CmService1ApplicationEndpoint
package /apd/Machines/testSuiteEcu1WRSOMEIPMachine/ServiceInstances
  provided someip service instance ST_CMApp01DiagRoutineProvidedSomeipServiceInstance: service-interface-deployment=RoutineService_Someip, sd-server-config=SomeipSdServerServiceInstanceConfig, service-instance-id=1710
  provided someip service instance ST_CMService1ProvidedSomeipServiceInstance: service-interface-deployment=CMService1_Someip, sd-server-config=SomeipSdServerServiceInstanceConfig, service-instance-id=19
