AUTOSAR XML (schema 00052)
package /apd/Machines/testSuiteEcu1WRSOMEIPMachine/ProcessToMachineMappings
  4 x process to machine mapping set:
    STC1_EMOApp02ProcessToMachineMapping
      process to machine mapping STC1_EMOApp02SwcInstanceTotestSuiteEcu1WRSOMEIPMachine: machine=testSuiteEcu1WRSOMEIPMachine, process=STC1_EMOApp02Instance
    STC1_EMOApp03ProcessToMachineMapping
      process to machine mapping STC1_EMOApp03SwcInstanceTotestSuiteEcu1WRSOMEIPMachine: machine=testSuiteEcu1WRSOMEIPMachine, process=STC1_EMOApp03Instance
    STC1_EMOApp04ProcessToMachineMapping
      process to machine mapping STC1_EMOApp04SwcInstanceTotestSuiteEcu1WRSOMEIPMachine: machine=testSuiteEcu1WRSOMEIPMachine, process=STC1_EMOApp04Instance
    STC1_EMOApp05ProcessToMachineMapping
      process to machine mapping STC1_EMOApp05SwcInstanceTotestSuiteEcu1WRSOMEIPMachine: machine=testSuiteEcu1WRSOMEIPMachine, process=STC1_EMOApp05Instance
package /apd/Machines/testSuiteEcu1WRSOMEIPMachine/Processes
  4 x process:
    STC1_EMOApp02Instance: design=STC1_EMOApp02Instance, executable=STC1_EMOApp02, state-dependent-startup-config{function-group-state=SystemTestFunctionGroup.STC_EMO_00001_Driving, resource-group=ResourceGroup1, startup-config=STC1_EMOApp02Startup}
      process state machine state_machine: type=ProcessStateMachine
    STC1_EMOApp03Instance: design=STC1_EMOApp03Instance, executable=STC1_EMOApp03, state-dependent-startup-config{function-group-state=SystemTestFunctionGroup.STC_EMO_00001_Driving, resource-group=ResourceGroup1, startup-config=STC1_EMOApp03Startup}
      process state machine state_machine: type=ProcessStateMachine
    STC1_EMOApp04Instance: design=STC1_EMOApp04Instance, executable=STC1_EMOApp04, state-dependent-startup-config{function-group-state=SystemTestFunctionGroup.STC_EMO_00001_Driving, resource-group=ResourceGroup1, startup-config=STC1_EMOApp04Startup}
      process state machine state_machine: type=ProcessStateMachine
    STC1_EMOApp05Instance: design=STC1_EMOApp05Instance, executable=STC1_EMOApp05, state-dependent-startup-config{function-group-state=SystemTestFunctionGroup.STC_EMO_00001_Driving, resource-group=ResourceGroup1, startup-config=STC1_EMOApp05Startup}
      process state machine state_machine: type=ProcessStateMachine
package /apd/Machines/testSuiteEcu1WRSOMEIPMachine/StartupConfigSets
  4 x startup config, all with environment-variables=tag-with-optional-value={key=DLT_LOG_MODE, value=3}, scheduling-policy=SCHEDULING-POLICY-ROUND-ROBIN, scheduling-priority=12, termination-behavior=PROCESS-IS-NOT-SELF-TERMINATING:
    STC1_EMOApp{02..05}Startup
package /apd/Machines/testSuiteEcu1WRSOMEIPMachine/DltApplicationToProcessMappings
  4 x dlt application to process mapping:
    STC1_EMOApp{02..05}InstanceDltApplicationToProcessMapping: dlt-application=STC1_EMOApp{02..05}Application, process=STC1_EMOApp{02..05}Instance
  4 x dlt log sink to port prototype mapping, all with dlt-context=DefaultDltContext:
    STC1_EMOApp{02..05}InstanceDltLogSinkToPortPrototypeMapping: dlt-log-sink=[STC1_EMOApp{02..05}FileDltSink, RemoteDltSink], process=STC1_EMOApp{02..05}Instance
