AUTOSAR XML (schema 00052)
package /apd/Machines/testSuiteEcu1WRSOMEIPMachine/ServiceInstanceToMachineMappings
  dds service instance to machine mapping DDSService1ProvidedServiceInstanceToEcu1Machine: communication-connector=CommunicationWRSOMEIPConnector1, service-instance=[ST_DDSService1ProvidedDdsServiceInstance, ST_DDSService2ProvidedDdsServiceInstance, ST_DDSService3ProvidedDdsServiceInstance, ST_DDSService4ProvidedDdsServiceInstance, ST_DDSService5ProvidedDdsServiceInstance]
package /apd/Machines/testSuiteEcu1WRSOMEIPMachine/ServiceInstances
  5 x dds provided service instance, all with qos-profile=default:
    ST_DDSService1ProvidedDdsServiceInstance: service-interface-deployment=DDSService1_Dds, domain-id=42, dds-event-qos-props{qos-profile=default, event=DdsEventA}, service-instance-id=29
    ST_DDSService2ProvidedDdsServiceInstance: service-interface-deployment=DDSService2_Dds, domain-id=40, dds-event-qos-props{qos-profile=default, event=DdsEventC}, service-instance-id=30
    ST_DDSService3ProvidedDdsServiceInstance: service-interface-deployment=DDSService3_Dds, domain-id=41, dds-field-qos-props{qos-profile=default, field=FieldA_Dds}, service-instance-id=31
    ST_DDSService4ProvidedDdsServiceInstance: service-interface-deployment=DDSService4_Dds, domain-id=39, service-instance-id=32
    ST_DDSService5ProvidedDdsServiceInstance: service-interface-deployment=DDSService5_Dds, domain-id=38, service-instance-id=33
