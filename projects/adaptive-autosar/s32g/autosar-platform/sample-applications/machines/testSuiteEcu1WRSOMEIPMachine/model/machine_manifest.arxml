AUTOSAR XML (schema 00052)
package /apd/Machines/testSuiteEcu1WRSOMEIPMachine
  machine testSuiteEcu1WRSOMEIPMachine: default-application-timeout=exit-timeout-value=0.1, environment-variables=tag-with-optional-value={key=DLT_LOG_MODE, value=3}, machine-design=testSuiteEcu1WRSOMEIPMachineDesign
    module-instantiations:
      log and trace instantiation LogAndTraceInstanciation: dlt-ecu=testSuiteEcu1WRSOMEIPMachineDltEcu, log-sink=ConsoleDltSink
      os module instantiation Linux
        6 x resource group:
          ResourceGroup1: cpu-usage=95, mem-usage=2000000000
          ResourceGroup2: cpu-usage=95, mem-usage=2000000000
          ResourceGroupDB: cpu-usage=80, mem-usage=500000000
          ResourceGroupDIAG: cpu-usage=80, mem-usage=500000000
          ResourceGroupIAM: cpu-usage=80, mem-usage=500000000
          ResourceGroupSM: cpu-usage=80, mem-usage=500000000
      ucm subordinate module instantiation UcmInstance: identifier=DevelopmentMachineUCM
package /apd/Machines/testSuiteEcu1WRSOMEIPMachine/ModeDeclarationGroups
  5 x mode declaration group:
    testSuiteEcu1WRSOMEIPMachineState: initial-mode=Startup
      8 x mode:
        Driving
        Leaving
        Off
        Parking
        Restart
        Shutdown
        Startup
        Verify
    CM_Testcase_1: initial-mode=CM_Testcase_1/Off
      4 x mode:
        Off
        On
        Shutdown
        Verify
    SystemTestFunctionGroup: initial-mode=SystemTestFunctionGroup/Off
      20 x mode:
        Off
        STS_DDS_{00001..00004}
        STS_CM_00001
        STS_CM_00003
        STS_CM_00004
        STC_EMO_00001_Driving
        STC_EMO_00001_Parking
        STC_EMO_00001_Shutdown
        STC_EMO_00001_Startup
        STC_EMO_00001_Restart
        STC_EMO_00002_Driving
        STC_EMO_00002_Parking
        STC_EMO_00002_Shutdown
        STC_EMO_00002_Startup
        STC_EMO_00002_Restart
        Shutdown
        Verify
    SystemTestFunctionGroup1: initial-mode=SystemTestFunctionGroup1/Off
      6 x mode:
        Off
        STC_EMO_00002_Running
        STC_EMO_00002_Fallback
        STC_EMO_00002_Diag
        Shutdown
        Verify
    SystemTestFunctionGroup2: initial-mode=SystemTestFunctionGroup2/Off
      4 x mode:
        Off
        STC_EMO_00002_On
        STC_EMO_00002_Activate
        Verify
package /apd/Machines/testSuiteEcu1WRSOMEIPMachine/FunctionGroupSets
  function group set testSuiteEcu1FunctionGroups
    function-groups:
      7 x mode declaration group prototype:
        MachineFG: type=testSuiteEcu1WRSOMEIPMachineState
        CMTestCase1FG: type=CM_Testcase_1
        SystemTestFunctionGroup: type=SystemTestFunctionGroup
        SystemTestFunctionGroup1: type=SystemTestFunctionGroup1
        SystemTestFunctionGroup2: type=SystemTestFunctionGroup2
        Lane_Change_Assistance: type=Lane_Change_Assistance
        Pedestrian_Protection: type=Pedestrian_Protection
package /apd/Machines/testSuiteEcu1WRSOMEIPMachine/SoftwareClusters
  software cluster testSuiteCMCluster:
    category=PLATFORM_CORE
    claimed-function-group=[MachineFG, Lane_Change_Assistance, Pedestrian_Protection, CMTestCase1FG, SystemTestFunctionGroup, SystemTestFunctionGroup1, SystemTestFunctionGroup2]
    contained-process=[ST_CMApp01Instance1, ST_CMApp03Instance1, ST_CMApp10Instance1, ST_CMApp12Instance1, ST_CMApp13Instance1, ST_DIAGApp01Instance1, StateManager, ST_DDSApp01Instance1, ST_DDSApp02Instance1, STBG_EMOAppSysFGInstance, STBG_EMOAppSysFG1Instance, STBG_EMOAppSysFG2Instance, STC1_EMOApp02Instance, STC1_EMOApp03Instance, STC1_EMOApp04Instance, STC1_EMOApp05Instance, STC2_EMOApp02Instance, STC2_EMOApp03Instance, STC2_EMOApp04Instance, STC2_EMOApp05Instance, STC2_EMOApp06Instance]
    module-instantiation=[Linux, LogAndTraceInstanciation]
package /apd/Machines/testSuiteEcu1WRSOMEIPMachine/dlt
  dlt ecu testSuiteEcu1WRSOMEIPMachineDltEcu
    21 x dlt application, all with contexts=DefaultDltContext:
      CMApp01Application: application-description=CM App 01, application-id=CM01
      CMApp03Application: application-description=CM App 03, application-id=CM03
      CMApp10Application: application-description=CM App 10, application-id=CM10
      CMApp12Application: application-description=CM App 12, application-id=CM12
      CMApp13Application: application-description=CM App 13, application-id=CM13
      DIAGApp01Application: application-description=Diag App 01, application-id=DA01
      StateManagerApplication: application-description=State Manager, application-id=STMR
      DDSApp01Application: application-description=DDS App 01, application-id=DD01
      DDSApp02Application: application-description=DDS App 02, application-id=DD02
      STBG_EMOAppSysFGApplication: application-description=STBG EMOAppSysFG, application-id=EMB0
      STBG_EMOAppSysFG1Application: application-description=STBG EMOAppSysFG1, application-id=EMB1
      STBG_EMOAppSysFG2Application: application-description=STBG EMOAppSysFG2, application-id=EMB2
      STC1_EMOApp02Application: application-description=STC1 EMOApp02, application-id=EM12
      STC1_EMOApp03Application: application-description=STC1 EMOApp03, application-id=EM13
      STC1_EMOApp04Application: application-description=STC1 EMOApp04, application-id=EM14
      STC1_EMOApp05Application: application-description=STC1 EMOApp05, application-id=EM15
      STC2_EMOApp02Application: application-description=STC2 EMOApp02, application-id=EM22
      STC2_EMOApp03Application: application-description=STC2 EMOApp03, application-id=EM23
      STC2_EMOApp04Application: application-description=STC2 EMOApp04, application-id=EM24
      STC2_EMOApp05Application: application-description=STC2 EMOApp05, application-id=EM25
      STC2_EMOApp06Application: application-description=STC2 EMOApp06, application-id=EM26
  dlt log sink ConsoleDltSink: category=DLT_LOGSINK_CONSOLE, buffer-output=true, default-log-threshold=VERBOSE
