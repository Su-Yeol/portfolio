AUTOSAR XML (schema 00052)
package /apd/Machines/testSuiteEcu1WRSOMEIPMachine/ProcessToMachineMappings
  process to machine mapping set DDSApp01ProcessToMachineMapping
    process to machine mapping DDSApp01SwcInstance1TotestSuiteEcu1WRSOMEIPMachine: machine=testSuiteEcu1WRSOMEIPMachine, process=ST_DDSApp01Instance1
package /apd/Machines/testSuiteEcu1WRSOMEIPMachine/Processes
  process ST_DDSApp01Instance1: design=ST_DDSApp01Instance1, executable=ST_DDSApp01, state-dependent-startup-config{function-group-state=[SystemTestFunctionGroup.STS_DDS_00001, SystemTestFunctionGroup.STS_DDS_00002, SystemTestFunctionGroup.STS_DDS_00003, SystemTestFunctionGroup.STS_DDS_00004], resource-group=ResourceGroup1, startup-config=ST_DDSApp01Startup}
    process state machine state_machine: type=ProcessStateMachine
package /apd/Machines/testSuiteEcu1WRSOMEIPMachine/ServiceInstanceToPortPrototypeMappings
  5 x service instance to port prototype mapping, all with process=ST_DDSApp01Instance1:
    DDSService{1..5}ProvidedServiceInstanceToPort: port-prototype=DDSApp01Service{1..5}PPort, service-instance=ST_DDSService{1..5}ProvidedDdsServiceInstance
package /apd/Machines/testSuiteEcu1WRSOMEIPMachine/StartupConfigSets
  startup config ST_DDSApp01Startup: environment-variables=[{key=VSOMEIP_CONFIGURATION, value=/opt/DDSApp01/etc/vsomeip.json}, {key=DLT_LOG_MODE, value=3}], scheduling-policy=SCHEDULING-POLICY-ROUND-ROBIN, scheduling-priority=12
package /apd/Machines/testSuiteEcu1WRSOMEIPMachine/DltLogChannelToProcessMappings
  dlt application to process mapping ST_DDSApp01Instance1DltApplicationToProcessMapping: dlt-application=DDSApp01Application, process=ST_DDSApp01Instance1
  dlt log sink to port prototype mapping ST_DDSApp01Instance1DltLogSinkToPortPrototypeMapping: dlt-context=DefaultDltContext, dlt-log-sink=[DDSApp01FileDltSink, ConsoleDltSink, RemoteDltSink], process=ST_DDSApp01Instance1
