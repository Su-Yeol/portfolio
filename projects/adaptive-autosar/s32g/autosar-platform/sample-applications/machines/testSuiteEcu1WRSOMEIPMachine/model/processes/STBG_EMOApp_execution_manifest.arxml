AUTOSAR XML (schema 00052)
package /apd/Machines/testSuiteEcu1WRSOMEIPMachine/ProcessToMachineMappings
  process to machine mapping set STBG_EMOAppSysFGProcessToMachineMapping
    process to machine mapping STBG_EMOAppSysFGSwcInstanceTotestSuiteEcu1WRSOMEIPMachine: machine=testSuiteEcu1WRSOMEIPMachine, process=STBG_EMOAppSysFGInstance
  process to machine mapping set STBG_EMOAppSysFG1ProcessToMachineMapping
    process to machine mapping STBG_EMOAppSysFG1SwcInstanceTotestSuiteEcu1WRSOMEIPMachine: machine=testSuiteEcu1WRSOMEIPMachine, process=STBG_EMOAppSysFG1Instance
  process to machine mapping set STBG_EMOAppSysFG2ProcessToMachineMapping
    process to machine mapping STBG_EMOAppSysFG2SwcInstanceTotestSuiteEcu1WRSOMEIPMachine: machine=testSuiteEcu1WRSOMEIPMachine, process=STBG_EMOAppSysFG2Instance
package /apd/Machines/testSuiteEcu1WRSOMEIPMachine/Processes
  process STBG_EMOAppSysFGInstance:
    design=STBG_EMOAppSysFGInstance
    executable=STBG_EMOAppSysFG
    state-dependent-startup-config{function-group-state=[SystemTestFunctionGroup.STC_EMO_00001_Driving, SystemTestFunctionGroup.STC_EMO_00001_Parking, SystemTestFunctionGroup.STC_EMO_00001_Shutdown, SystemTestFunctionGroup.STC_EMO_00001_Startup, SystemTestFunctionGroup.STC_EMO_00001_Restart, SystemTestFunctionGroup.STC_EMO_00002_Driving, SystemTestFunctionGroup.STC_EMO_00002_Parking, SystemTestFunctionGroup.STC_EMO_00002_Shutdown, SystemTestFunctionGroup.STC_EMO_00002_Startup, SystemTestFunctionGroup.STC_EMO_00002_Restart], resource-group=ResourceGroup1, startup-config=STBG_EMOAppSysFGStartup}
    process state machine state_machine: type=ProcessStateMachine
  process STBG_EMOAppSysFG1Instance: design=STBG_EMOAppSysFG1Instance, executable=STBG_EMOAppSysFG1, state-dependent-startup-config{function-group-state=[SystemTestFunctionGroup1.STC_EMO_00002_Running, SystemTestFunctionGroup1.STC_EMO_00002_Fallback, SystemTestFunctionGroup1.STC_EMO_00002_Diag], resource-group=ResourceGroup1, startup-config=STBG_EMOAppSysFG1Startup}
    process state machine state_machine: type=ProcessStateMachine
  process STBG_EMOAppSysFG2Instance: design=STBG_EMOAppSysFG2Instance, executable=STBG_EMOAppSysFG2, state-dependent-startup-config{function-group-state=[SystemTestFunctionGroup2.STC_EMO_00002_On, SystemTestFunctionGroup2.STC_EMO_00002_Activate], resource-group=ResourceGroup1, startup-config=STBG_EMOAppSysFG2Startup}
    process state machine state_machine: type=ProcessStateMachine
package /apd/Machines/testSuiteEcu1WRSOMEIPMachine/StartupConfigSets
  startup config STBG_EMOAppSysFGStartup: environment-variables=tag-with-optional-value={key=DLT_LOG_MODE, value=3}, scheduling-policy=SCHEDULING-POLICY-ROUND-ROBIN, scheduling-priority=12, termination-behavior=PROCESS-IS-NOT-SELF-TERMINATING
  startup config STBG_EMOAppSysFG1Startup: environment-variables=tag-with-optional-value={key=DLT_LOG_MODE, value=3}, scheduling-policy=SCHEDULING-POLICY-ROUND-ROBIN, scheduling-priority=12, termination-behavior=PROCESS-IS-NOT-SELF-TERMINATING
  startup config STBG_EMOAppSysFG2Startup: environment-variables=tag-with-optional-value={key=DLT_LOG_MODE, value=3}, scheduling-policy=SCHEDULING-POLICY-ROUND-ROBIN, scheduling-priority=12, termination-behavior=PROCESS-IS-NOT-SELF-TERMINATING
package /apd/Machines/testSuiteEcu1WRSOMEIPMachine/DltApplicationToProcessMappings
  dlt application to process mapping STBG_EMOAppSysFGInstanceDltApplicationToProcessMapping: dlt-application=STBG_EMOAppSysFGApplication, process=STBG_EMOAppSysFGInstance
  dlt application to process mapping STBG_EMOAppSysFG1InstanceDltApplicationToProcessMapping: dlt-application=STBG_EMOAppSysFG1Application, process=STBG_EMOAppSysFG1Instance
  dlt application to process mapping STBG_EMOAppSysFG2InstanceDltApplicationToProcessMapping: dlt-application=STBG_EMOAppSysFG2Application, process=STBG_EMOAppSysFG2Instance
  dlt log sink to port prototype mapping STBG_EMOAppSysFGInstanceDltLogSinkToPortPrototypeMapping: dlt-context=DefaultDltContext, dlt-log-sink=[STBG_EMOAppSysFGFileDltSink, RemoteDltSink], process=STBG_EMOAppSysFGInstance
  dlt log sink to port prototype mapping STBG_EMOAppSysFG1InstanceDltLogSinkToPortPrototypeMapping: dlt-context=DefaultDltContext, dlt-log-sink=[STBG_EMOAppSysFG1FileDltSink, RemoteDltSink], process=STBG_EMOAppSysFG1Instance
  dlt log sink to port prototype mapping STBG_EMOAppSysFG2InstanceDltLogSinkToPortPrototypeMapping: dlt-context=DefaultDltContext, dlt-log-sink=[STBG_EMOAppSysFG2FileDltSink, RemoteDltSink], process=STBG_EMOAppSysFG2Instance
