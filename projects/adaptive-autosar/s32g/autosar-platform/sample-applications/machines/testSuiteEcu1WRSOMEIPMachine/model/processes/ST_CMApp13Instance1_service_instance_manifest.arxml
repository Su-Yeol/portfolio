AUTOSAR XML (schema 00052)
package /apd/Machines/testSuiteEcu1WRSOMEIPMachine/ServiceInstanceToMachineMappings
  someip service instance to machine mapping CmService6RequiredServiceInstanceToEcu1Machine: communication-connector=CommunicationWRSOMEIPConnector1, service-instance=ST_CMApp13CMService6RequiredSomeipServiceInstance, udp-port=CmService6ApplicationEndpoint
  someip service instance to machine mapping CMApp13DiagDataIdentifierProvidedServiceInstanceToEcu1Machine: communication-connector=CommunicationWRSOMEIPConnector1, service-instance=ST_CMApp13DiagDataIdentifierProvidedSomeipServiceInstance, udp-port=CMApp13DiagDataIdentifierApplicationEndpoint
  someip service instance to machine mapping CMApp13DiagRoutineProvidedServiceInstanceToEcu1Machine: communication-connector=CommunicationWRSOMEIPConnector1, service-instance=ST_CMApp13DiagRoutineProvidedSomeipServiceInstance, udp-port=ST_CMApp13DiagRoutineApplicationEndpoint
package /apd/Machines/testSuiteEcu1WRSOMEIPMachine/ServiceInstances
  required someip service instance ST_CMApp13CMService6RequiredSomeipServiceInstance: service-interface-deployment=CMService6_Someip, required-service-instance-id=35, sd-client-config=SomeipSdClientServiceInstanceConfig
  provided someip service instance ST_CMApp13DiagDataIdentifierProvidedSomeipServiceInstance: service-interface-deployment=DataIdentifier_Someip, sd-server-config=SomeipSdServerServiceInstanceConfig, service-instance-id=1203
  provided someip service instance ST_CMApp13DiagRoutineProvidedSomeipServiceInstance: service-interface-deployment=RoutineService_Someip, sd-server-config=SomeipSdServerServiceInstanceConfig, service-instance-id=1734
