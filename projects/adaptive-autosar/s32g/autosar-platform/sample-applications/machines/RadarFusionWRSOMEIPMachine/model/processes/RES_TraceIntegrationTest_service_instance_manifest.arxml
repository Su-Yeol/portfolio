AUTOSAR XML (schema 00052)
package /apd/Machines/RadarFusionWRSOMEIPMachine/ServiceInstanceToMachineMappings
  someip service instance to machine mapping TIT_RequiredServiceInstance_toMachine: communication-connector=RadarFusionWRSOMEIPConnector, service-instance=TIT_RequiredSomeipServiceInstance, udp-port=TriggerApplicationEndpoint
package /apd/Machines/RadarFusionWRSOMEIPMachine/ServiceInstances
  required someip service instance TIT_RequiredSomeipServiceInstance: service-interface-deployment=TitService_Someip, required-minor-version=0, required-service-instance-id=24, sd-client-config=SomeipSdClientServiceInstanceConfig, version-driven-find-behavior=MINIMUM-MINOR-VERSION
    someip required event group sensorData_Someip_group: event-group=sensorData_Someip_group
