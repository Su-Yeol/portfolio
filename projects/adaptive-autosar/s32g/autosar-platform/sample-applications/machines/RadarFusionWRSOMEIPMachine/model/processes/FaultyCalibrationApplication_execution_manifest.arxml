AUTOSAR XML (schema 00052)
package /apd/Machines/RadarFusionWRSOMEIPMachine/ProcessToMachineMappings
  process to machine mapping set FaultyCalibrationApplication
    process to machine mapping FaultyCalibrationApplication: machine=RadarFusionWRSOMEIPMachine, process=FaultyCalibrationApplication
package /apd/Machines/RadarFusionWRSOMEIPMachine/dlt
  dlt application to process mapping FaultyCalibrationDltApplicationToProcessMapping: dlt-application=FaultyCalibrationApplication, process=FaultyCalibrationApplication
  dlt log sink to port prototype mapping FaultyCalibrationDltLogSinkToPortPrototypeMapping: dlt-context=DefaultDltContext, dlt-log-sink=[ConsoleDltSink, FaultyCalibrationFileDltSink], process=FaultyCalibrationApplication
package /apd/Machines/RadarFusionWRSOMEIPMachine/Processes
  process FaultyCalibrationApplication: design=FaultyCalibrationApplication, executable=FaultyCalibrationApplication, number-of-restart-attempts=3, state-dependent-startup-config{function-group-state=Sensor.Calibration, resource-group=ResourceGroup1, startup-config=FaultyCalibrationApplication}
    process state machine state_machine: type=ProcessStateMachine
package /apd/Machines/RadarFusionWRSOMEIPMachine/StartupConfigSets
  startup config FaultyCalibrationApplication: scheduling-policy=SCHEDULING-POLICY-ROUND-ROBIN, scheduling-priority=12, termination-behavior=PROCESS-IS-NOT-SELF-TERMINATING, timeout={enter-timeout-value=1, exit-timeout-value=1}
