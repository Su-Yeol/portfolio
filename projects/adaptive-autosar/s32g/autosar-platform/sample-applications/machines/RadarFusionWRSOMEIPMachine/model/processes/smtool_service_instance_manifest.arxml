AUTOSAR XML (schema 00052)
package /apd/Machines/RadarFusionWRSOMEIPMachine/ServiceInstanceToMachineMappings
  someip service instance to machine mapping TriggerIn_RequiredServiceInstance_toMachine: communication-connector=RadarFusionWRSOMEIPConnector, service-instance=TriggerIn_RequiredSomeipServiceInstance, udp-port=TriggerApplicationEndpoint
  someip service instance to machine mapping TriggerOut_RequiredServiceInstance2_toMachine: communication-connector=RadarFusionWRSOMEIPConnector, service-instance=TriggerOut_RequiredSomeipServiceInstance, udp-port=TriggerApplicationEndpoint
package /apd/Machines/RadarFusionWRSOMEIPMachine/ServiceInstances
  required someip service instance TriggerIn_RequiredSomeipServiceInstance: service-interface-deployment=TriggerIn_Someip, required-minor-version=0, required-service-instance-id=49, sd-client-config=SomeipSdClientServiceInstanceConfig, version-driven-find-behavior=MINIMUM-MINOR-VERSION
  required someip service instance TriggerOut_RequiredSomeipServiceInstance: service-interface-deployment=TriggerOut_Someip, required-minor-version=0, required-service-instance-id=668, sd-client-config=SomeipSdClientServiceInstanceConfig, version-driven-find-behavior=MINIMUM-MINOR-VERSION
