AUTOSAR XML (schema 00052)
package /apd/Machines/RadarFusionWRSOMEIPMachine/ProcessToMachineMappings
  process to machine mapping set pkgmgr_sample
    process to machine mapping pkgmgr_sample: machine=RadarFusionWRSOMEIPMachine, process=pkgmgr_sample
package /apd/Machines/RadarFusionWRSOMEIPMachine/DltLogChannelToProcessMappings
  dlt application to process mapping pkgmgr_sampleDltApplicationToProcessMapping: dlt-application=PkgmgrApplication, process=pkgmgr_sample
  dlt log sink to port prototype mapping pkgmgr_sampleDltLogSinkToPortPrototypeMapping: dlt-context=DefaultDltContext, dlt-log-sink=[ConsoleDltSink, RemoteDltSink, PkgmgrFileDltSink], process=pkgmgr_sample
package /apd/Machines/RadarFusionWRSOMEIPMachine/Processes
  process pkgmgr_sample: executable=pkgmgr_sample, state-dependent-startup-config{execution-dependency=state_machine.Running, function-group-state=MachineFG.Driving, resource-group=ResourceGroup1, startup-config=pkgmgr_sample_startup}
    process state machine state_machine: type=ProcessStateMachine
package /apd/Machines/RadarFusionWRSOMEIPMachine/ServiceInstanceToPortPrototypeMappings
  service instance to port prototype mapping RequiredPackageManagementInstanceToPortMapping: port-prototype=PackageManagementRPort, process=pkgmgr_sample, service-instance=RequiredSomeIpPackageManagementInstance
package /apd/Machines/RadarFusionWRSOMEIPMachine/StartupConfigSets
  startup config pkgmgr_sample_startup: scheduling-policy=SCHEDULING-POLICY-ROUND-ROBIN, scheduling-priority=12, termination-behavior=PROCESS-IS-SELF-TERMINATING
    process-arguments:
      --campaign
      UpdatableApp_1.0.0_Install.zip
      --campaign
      UpdatableApp_2.0.0_Update.zip
      --campaign
      UpdatableApp_3.0.0_Remove.zip
      --test-downgrade
      UpdatableApp_1.0.0_Install.zip
      --ucmId
      RadarFusionWRSOMEIPMachineUCM
