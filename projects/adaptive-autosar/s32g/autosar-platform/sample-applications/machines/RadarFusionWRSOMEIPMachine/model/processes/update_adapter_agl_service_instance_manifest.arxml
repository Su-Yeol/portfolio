AUTOSAR XML (schema 00052)
package /apd/Machines/RadarFusionWRSOMEIPMachine/ServiceInstanceToMachineMappings
  someip service instance to machine mapping UpdateAdapterAglPackageManagementInstanceToMachineMapping: communication-connector=RadarFusionWRSOMEIPConnector, service-instance=UpdateAdapterAglSomeIpPackageManagementInstance, tcp-port=UpdateAdapterAglApplicationEndpoint
package /apd/Machines/RadarFusionWRSOMEIPMachine/ServiceInstances
  provided someip service instance UpdateAdapterAglSomeIpPackageManagementInstance: service-interface-deployment=PackageManagementSomeIp, sd-server-config=SomeipSdServerServiceInstanceConfig, service-instance-id=814
    someip provided event group CurrentStatus_provided_eventgroup: event-group=CurrentStatus_eventgroup, multicast-threshold=0
