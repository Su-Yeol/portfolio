AUTOSAR XML (schema 00052)
package /apd/Machines/FusionMachine/ProcessToMachineMappings
  process to machine mapping set ara_tsync_daemon
    process to machine mapping ara_tsync_daemon: machine=FusionMachine, process=ara_tsync_daemon
package /apd/Machines/FusionMachine/Processes
  process ara_tsync_daemon: executable=ara_tsync_daemon, state-dependent-startup-config{function-group-state=[MachineFG.Driving, MachineFG.Parking], resource-group=ResourceGroup2, startup-config=ara_tsync_daemon}
    process state machine state_machine: type=ProcessStateMachine
package /apd/Machines/FusionMachine/StartupConfigSets
  startup config ara_tsync_daemon: environment-variables=tag-with-optional-value={key=TSYNC_APP_INTERFACE, value=/opt/ara_tsync_daemon/etc/TimeSyncConsumerInterface.json}, scheduling-policy=SCHEDULING-POLICY-ROUND-ROBIN, scheduling-priority=12, termination-behavior=PROCESS-IS-NOT-SELF-TERMINATING
package /apd/Machines/FusionMachine/DltMappings
  dlt application to process mapping TimeSyncDltApplicationToProcessMapping: dlt-application=ara_tsync_daemon_LogApplication, process=ara_tsync_daemon
  dlt log sink to port prototype mapping TimeSyncDltLogSinkToPortPrototypeMapping: dlt-context=DefaultDltContext, dlt-log-sink=[ConsoleDltSink, RemoteDltSink, TimeSyncFileDltSink], process=ara_tsync_daemon
