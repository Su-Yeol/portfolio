AUTOSAR XML (schema 00052)
package /apd/Machines/FusionMachine/ServiceInstanceToMachineMappings
  someip service instance to machine mapping RequiredControllerInstanceToMachineMapping: communication-connector=FusionConnector, service-instance=[RequiredSomeIpActorInstance, RequiredSomeIpLineSensorInstance, RequiredSomeIpUltraSonicSensorInstance]
package /apd/Machines/FusionMachine/ServiceInstances
  required someip service instance RequiredSomeIpActorInstance: service-interface-deployment=ActorServInterfaceSomeIp, required-minor-version=0, required-service-instance-id=20545, sd-client-config=SomeipSdClientServiceInstanceConfig
  required someip service instance RequiredSomeIpLineSensorInstance: service-interface-deployment=LineSensorSomeIp, required-minor-version=0, required-service-instance-id=20556, sd-client-config=SomeipSdClientServiceInstanceConfig
    someip required event group LineSensorEvent: event-group=LineSensorEventGroup
  required someip service instance RequiredSomeIpUltraSonicSensorInstance: service-interface-deployment=UltraSonicSensorSomeIp, required-minor-version=0, required-service-instance-id=20565, sd-client-config=SomeipSdClientServiceInstanceConfig
    someip required event group UltraSonicSensorEvent: event-group=UltraSonicSensorEventGroup
