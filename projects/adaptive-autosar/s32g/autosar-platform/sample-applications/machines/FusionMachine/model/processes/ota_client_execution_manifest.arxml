AUTOSAR XML (schema 00052)
package /apd/Machines/FusionMachine/ProcessToMachineMappings
  process to machine mapping set ota_client
    process to machine mapping ota_client: machine=FusionMachine, process=ota_client
package /apd/Machines/FusionMachine/DltLogChannelToProcessMappings
  dlt application to process mapping ota_clientDltApplicationToProcessMapping: dlt-application=OtaClientApplication, process=ota_client
  dlt log sink to port prototype mapping ota_clientDltLogSinkToPortPrototypeMapping: dlt-context=DefaultDltContext, dlt-log-sink=[ConsoleDltSink, RemoteDltSink, OtaClientFileDltSink], process=ota_client
package /apd/Machines/FusionMachine/Processes
  process ota_client: executable=ota_app, state-dependent-startup-config{function-group-state=MachineFG.Driving, resource-group=ResourceGroup1, startup-config=ota_client_startup}
    process state machine state_machine: type=ProcessStateMachine
package /apd/Machines/FusionMachine/ServiceInstanceToPortPrototypeMappings
  service instance to port prototype mapping RequiredVehPackageManagementInstanceToPortMapping: port-prototype=VehiclePackageManagementRPort, process=ota_client, service-instance=RequiredSomeIpVehiclePackageManagementInstance
package /apd/Machines/FusionMachine/StartupConfigSets
  startup config ota_client_startup: process-arguments=[--provider-mode, hawkbitProvider, --c, etc/config.ini], scheduling-policy=SCHEDULING-POLICY-ROUND-ROBIN, scheduling-priority=12, termination-behavior=PROCESS-IS-SELF-TERMINATING
