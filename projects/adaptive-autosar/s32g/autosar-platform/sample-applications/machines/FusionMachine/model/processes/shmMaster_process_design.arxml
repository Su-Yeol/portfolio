AUTOSAR XML (schema 00052)
package /apd/Machines/FusionMachine/ProcessDesigns
  process design shmMaster: executable=shmMaster
