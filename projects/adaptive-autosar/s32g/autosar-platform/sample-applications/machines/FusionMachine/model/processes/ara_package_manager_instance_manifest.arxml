AUTOSAR XML (schema 00052)
package /apd/Machines/FusionMachine/ServiceInstanceToMachineMappings
  someip service instance to machine mapping PackageManagementInstanceToMachineMapping: communication-connector=FusionConnector, service-instance=SomeIpPackageManagementInstance, tcp-port=PackageManagementApplicationEndpoint
  someip service instance to machine mapping RequiredUpdateRequestInstanceToMachineMapping: communication-connector=FusionConnector, service-instance=UpdateRequest_RequiredSomeipServiceInstance
package /apd/Machines/FusionMachine/ServiceInstances
  provided someip service instance SomeIpPackageManagementInstance: service-interface-deployment=PackageManagementSomeIp, sd-server-config=SomeipSdServerServiceInstanceConfig, service-instance-id=812
    someip provided event group CurrentStatus_provided_eventgroup: event-group=CurrentStatus_eventgroup, multicast-threshold=0
  required someip service instance UpdateRequest_RequiredSomeipServiceInstance: service-interface-deployment=UpdateRequest_Someip, required-minor-version=0, required-service-instance-id=667, sd-client-config=SomeipSdClientServiceInstanceConfig
