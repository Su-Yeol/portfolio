AUTOSAR XML (schema 00052)
package /apd/Machines/shmMachine/ProcessDesigns
  process design shmClient2: executable=shmClient2
