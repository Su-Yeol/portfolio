AUTOSAR XML (schema 00052)
package /apd/Machines/testSuiteEcu2WRSOMEIPMachine/ServiceInstanceToMachineMappings
  someip service instance to machine mapping CmService6RequiredServiceInstanceToEcu2Machine: communication-connector=CommunicationWRSOMEIPConnector1, service-instance=ST_CMApp14CMService6RequiredSomeipServiceInstance, udp-port=CMService6ApplicationEndpoint
  someip service instance to machine mapping CMApp14DiagDataIdentifierProvidedServiceInstanceToEcu2Machine: communication-connector=CommunicationWRSOMEIPConnector1, service-instance=ST_CMApp14DiagDataIdentifierProvidedSomeipServiceInstance, udp-port=CMApp14DiagDataIdentifierApplicationEndpoint
  someip service instance to machine mapping CMApp14DiagRoutineProvidedServiceInstanceToEcu2Machine: communication-connector=CommunicationWRSOMEIPConnector1, service-instance=ST_CMApp14DiagRoutineProvidedSomeipServiceInstance, udp-port=ST_CMApp14DiagRoutineApplicationEndpoint
package /apd/Machines/testSuiteEcu2WRSOMEIPMachine/ServiceInstances
  required someip service instance ST_CMApp14CMService6RequiredSomeipServiceInstance: service-interface-deployment=CMService6_Someip, required-service-instance-id=35, sd-client-config=SomeipSdClientServiceInstanceConfig
  provided someip service instance ST_CMApp14DiagDataIdentifierProvidedSomeipServiceInstance: service-interface-deployment=DataIdentifier_Someip, sd-server-config=SomeipSdServerServiceInstanceConfig, service-instance-id=1303
  provided someip service instance ST_CMApp14DiagRoutineProvidedSomeipServiceInstance: service-interface-deployment=RoutineService_Someip, sd-server-config=SomeipSdServerServiceInstanceConfig, service-instance-id=1735
