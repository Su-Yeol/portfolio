AUTOSAR XML (schema 00052)
package /apd/Machines/RadarFusionMachine/ServiceInstanceToMachineMappings
  9 x someip service instance to machine mapping, all with communication-connector=RadarFusionConnector, udp-port=TriggerApplicationEndpoint:
    OsiAdiAdapter_RequiredServiceInstance_toMachine: service-instance=OsiAdiAdapterRequiredSomeipServiceInstance
    OsiAdiAdapter_RequiredServiceInstance{2..9}_toMachine: service-instance=OsiAdiAdapterRequiredSomeipServiceInstance{2..9}
package /apd/Machines/RadarFusionMachine/ServiceInstances
  9 x required someip service instance, all with required-minor-version=0, sd-client-config=SomeipSdClientServiceInstanceConfig, version-driven-find-behavior=MINIMUM-MINOR-VERSION:
    OsiAdiAdapterRequiredSomeipServiceInstance: service-interface-deployment=RoadObjects_Someip, required-service-instance-id=150
      e-2-e-event-protection-propss:
        end 2 end event protection props End2EndEventProtectionProps: data-ids=[4321, 4321], e-2-e-profile-configuration=PROFILE_01, event=RoadObjectInterface_Someip, max-data-length=4096, min-data-length=1
      someip required event group RequiredEventgroup1: event-group=SomeipEventgroup1
    OsiAdiAdapterRequiredSomeipServiceInstance2: service-interface-deployment=StaticObjects_Someip, required-service-instance-id=151
      e-2-e-event-protection-propss:
        end 2 end event protection props End2EndEventProtectionProps: data-ids=4321, e-2-e-profile-configuration=PROFILE_01, event=StaticObjectInterface_Someip, max-data-length=4096, min-data-length=1
      someip required event group RequiredEventgroup1: event-group=SomeipEventgroup1
    OsiAdiAdapterRequiredSomeipServiceInstance3: service-interface-deployment=PotentiallyMovingObjects_Someip, required-service-instance-id=152
      e-2-e-event-protection-propss:
        end 2 end event protection props End2EndEventProtectionProps: data-ids=4321, e-2-e-profile-configuration=PROFILE_01, event=PotentiallyMovingObjectsInterface_Someip, max-data-length=4096, min-data-length=1
      someip required event group RequiredEventgroup1: event-group=SomeipEventgroup1
    OsiAdiAdapterRequiredSomeipServiceInstance4: service-interface-deployment=CameraFeatures_Someip, required-service-instance-id=153
      e-2-e-event-protection-propss:
        end 2 end event protection props End2EndEventProtectionProps: data-ids=4321, e-2-e-profile-configuration=PROFILE_01, event=CameraFeaturesInterface_Someip, max-data-length=4096, min-data-length=1
      someip required event group RequiredEventgroup1: event-group=SomeipEventgroup1
    OsiAdiAdapterRequiredSomeipServiceInstance5: service-interface-deployment=CameraDetection_Someip, required-service-instance-id=154
      e-2-e-event-protection-propss:
        end 2 end event protection props End2EndEventProtectionProps: data-ids=4321, e-2-e-profile-configuration=PROFILE_01, event=CameraDetectionInterface_Someip, max-data-length=4096, min-data-length=1
      someip required event group RequiredEventgroup1: event-group=SomeipEventgroup1
    OsiAdiAdapterRequiredSomeipServiceInstance6: service-interface-deployment=UltrasonicDetections_Someip, required-service-instance-id=155
      e-2-e-event-protection-propss:
        end 2 end event protection props End2EndEventProtectionProps: data-ids=4321, e-2-e-profile-configuration=PROFILE_01, event=UltrasonicDetectionsInterface_Someip, max-data-length=4096, min-data-length=1
      someip required event group RequiredEventgroup1: event-group=SomeipEventgroup1
    OsiAdiAdapterRequiredSomeipServiceInstance7: service-interface-deployment=UltrasonicFeatures_Someip, required-service-instance-id=156
      e-2-e-event-protection-propss:
        end 2 end event protection props End2EndEventProtectionProps: data-ids=4321, e-2-e-profile-configuration=PROFILE_01, event=UltrasonicFeaturesInterface_Someip, max-data-length=4096, min-data-length=1
      someip required event group RequiredEventgroup1: event-group=SomeipEventgroup1
    OsiAdiAdapterRequiredSomeipServiceInstance8: service-interface-deployment=LidarDetections_Someip, required-service-instance-id=157
      e-2-e-event-protection-propss:
        end 2 end event protection props End2EndEventProtectionProps: data-ids=4321, e-2-e-profile-configuration=PROFILE_01, event=LidarDetectionsInterface_Someip, max-data-length=4096, min-data-length=1
      someip required event group RequiredEventgroup1: event-group=SomeipEventgroup1
    OsiAdiAdapterRequiredSomeipServiceInstance9: service-interface-deployment=RadarDetections_Someip, required-service-instance-id=158
      e-2-e-event-protection-propss:
        end 2 end event protection props End2EndEventProtectionProps: data-ids=4321, e-2-e-profile-configuration=PROFILE_01, event=RadarDetectionsInterface_Someip, max-data-length=4096, min-data-length=1
      someip required event group RequiredEventgroup1: event-group=SomeipEventgroup1
