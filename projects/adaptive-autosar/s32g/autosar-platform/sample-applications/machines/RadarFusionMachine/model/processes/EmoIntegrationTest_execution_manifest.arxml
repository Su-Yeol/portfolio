AUTOSAR XML (schema 00052)
package /apd/Machines/RadarFusionMachine/ProcessToMachineMappings
  process to machine mapping set EmoIntegrationTest
    process to machine mapping EmoIntegrationTest: machine=RadarFusionMachine, process=EmoIntegrationTest, shall-run-on=[ProcessorCore0, ProcessorCore1]
package /apd/Machines/RadarFusionMachine/DltLogChannelToProcessMappings
  dlt application to process mapping EmoIntegrationTestDltApplicationToProcessMapping: dlt-application=EmoIntegrationTestApplication, process=EmoIntegrationTest
  dlt log sink to port prototype mapping EmoIntegrationTestDltLogSinkToPortPrototypeMapping: dlt-context=DefaultDltContext, dlt-log-sink=[ConsoleDltSink, EmoIntegrationTestLogFileDltSink, RemoteDltSink], process=EmoIntegrationTest
package /apd/Machines/RadarFusionMachine/Processes
  process EmoIntegrationTest: design=EmoIntegrationTestDesign, executable=EmoIntegrationTest, state-dependent-startup-config{function-group-state=MachineFG.Driving, resource-group=ResourceGroup1, startup-config=ConfigDriving}
    process state machine state_machine: type=ProcessStateMachine
package /apd/Machines/RadarFusionMachine/ProcessDesigns
  process design EmoIntegrationTestDesign: executable=EmoIntegrationTest
package /apd/Machines/RadarFusionMachine/StartupConfigs
  startup config ConfigDriving: environment-variables=tag-with-optional-value={key=DLT_LOG_MODE, value=3}, execution-error=EmoIntegrationTestExecutionError, process-arguments=[Argument 1, Argument 2, Argument 3], scheduling-policy=SCHED_RR, scheduling-priority=12, termination-behavior=PROCESS-IS-SELF-TERMINATING
package /apd/Machines/RadarFusionMachine/EmoIntegrationTestExecErrors
  process execution error EmoIntegrationTestExecutionError: execution-error=5
