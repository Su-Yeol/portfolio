AUTOSAR XML (schema 00052)
package /apd/Machines/RadarFusionMachine/ProcessToMachineMappings
  process to machine mapping set OsiAdiAdapter
    process to machine mapping OsiAdiAdapter: machine=RadarFusionMachine, process=OsiAdiAdapter
package /apd/Machines/RadarFusionMachine/DltLogChannelToProcessMappings
  dlt application to process mapping OsiAdiAdapterDltApplicationToProcessMapping: dlt-application=OsiAdiAdapterApplication, process=OsiAdiAdapter
  dlt log sink to port prototype mapping OsiAdiAdapterDltLogSinkToPortPrototypeMapping: dlt-context=DefaultDltContext, dlt-log-sink=[ConsoleDltSink, RemoteDltSink, OsiAdiAdapterFileDltSink], process=OsiAdiAdapter
package /apd/Machines/RadarFusionMachine/Processes
  process OsiAdiAdapter: design=OsiAdiAdapter, executable=OsiAdiAdapter, state-dependent-startup-config{function-group-state=[MachineFG.Driving, MachineFG.Parking], resource-group=ResourceGroup1, startup-config=OsiAdiAdapterStartup}
    process state machine state_machine: type=ProcessStateMachine
package /apd/Machines/RadarFusionMachine/ServiceInstanceToPortPrototypeMappings
  9 x service instance to port prototype mapping, all with process=OsiAdiAdapter:
    OsiAdiAdapter_ProvidedServiceInstance_toPort: port-prototype=OsiAdiAdapter_PPort, service-instance=OsiAdiAdapterProvidedSomeipServiceInstance
    OsiAdiAdapter_ProvidedServiceInstance{2..9}_toPort: port-prototype=OsiAdiAdapter_PPort{2..9}, service-instance=OsiAdiAdapterProvidedSomeipServiceInstance{2..9}
package /apd/Machines/RadarFusionMachine/StartupConfigSets
  startup config OsiAdiAdapterStartup: environment-variables=tag-with-optional-value={key=VSOMEIP_CONFIGURATION, value=/etc/vsomeip.json}, scheduling-policy=SCHEDULING-POLICY-ROUND-ROBIN, scheduling-priority=12, termination-behavior=PROCESS-IS-NOT-SELF-TERMINATING
