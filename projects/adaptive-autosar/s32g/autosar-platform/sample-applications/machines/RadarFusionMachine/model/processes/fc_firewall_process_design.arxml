AUTOSAR XML (schema 00052)
package /apd/Machines/RadarFusionMachine
  process design Fc_FirewallDesign: executable=fc_firewall
