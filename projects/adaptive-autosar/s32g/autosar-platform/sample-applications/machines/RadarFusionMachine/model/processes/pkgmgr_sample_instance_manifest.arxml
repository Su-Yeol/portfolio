AUTOSAR XML (schema 00052)
package /apd/Machines/RadarFusionMachine/ServiceInstanceToMachineMappings
  someip service instance to machine mapping RequiredPackageManagementInstanceToMachineMapping: communication-connector=RadarFusionConnector, service-instance=RequiredSomeIpPackageManagementInstance
package /apd/Machines/RadarFusionMachine/ServiceInstances
  required someip service instance RequiredSomeIpPackageManagementInstance: service-interface-deployment=PackageManagementSomeIp, required-minor-version=0, required-service-instance-id=812, sd-client-config=SomeipSdClientServiceInstanceConfig
    someip required event group CurrentStatus_required_eventgroup: event-group=CurrentStatus_eventgroup
