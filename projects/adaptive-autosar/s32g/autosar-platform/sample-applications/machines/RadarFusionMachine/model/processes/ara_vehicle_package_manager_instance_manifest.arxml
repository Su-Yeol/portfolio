AUTOSAR XML (schema 00052)
package /apd/Machines/RadarFusionMachine/ServiceInstanceToMachineMappings
  someip service instance to machine mapping VehiclePackageManagementInstanceToMachineMapping: communication-connector=RadarFusionConnector, service-instance=[ProvidedSomeIpVehicleDriverApplicationInterfaceInstance, ProvidedSomeIpVehiclePackageManagementInstance, ProvidedSomeIpVehicleStateManagerInterfaceInstance], tcp-port=VehiclePackageManagementApplicationEndpoint
  someip service instance to machine mapping PackageManagementInstanceToMachineMappingForVPM: communication-connector=RadarFusionConnector, service-instance=RequiredSomeIpPackageManagementInstanceForVehiclePackageManager
package /apd/Machines/RadarFusionMachine/ServiceInstances
  provided someip service instance ProvidedSomeIpVehicleDriverApplicationInterfaceInstance: service-interface-deployment=VehicleDriverApplicationInterfaceSomeIp, sd-server-config=SomeipSdServerServiceInstanceConfig, service-instance-id=910
    someip provided event group ApprovalRequired_provided_eventgroup: event-group=ApprovalRequired_eventgroup, multicast-threshold=0
    someip provided event group CampaignState_provided_eventgroup: event-group=CampaignState_eventgroup, multicast-threshold=0
    someip provided event group VehicleConditionCollection_provided_eventgroup: event-group=VehicleConditionCollection_eventgroup, multicast-threshold=0
  provided someip service instance ProvidedSomeIpVehiclePackageManagementInstance: service-interface-deployment=VehiclePackageManagementSomeIp, sd-server-config=SomeipSdServerServiceInstanceConfig, service-instance-id=909
    someip provided event group RequestedPackage_provided_eventgroup: event-group=RequestedPackage_eventgroup, multicast-threshold=0
    someip provided event group TransferState_provided_eventgroup: event-group=TransferState_eventgroup, multicast-threshold=0
    someip provided event group VehicleConditionCollection_provided_eventgroup: event-group=VehicleConditionCollection_eventgroup, multicast-threshold=0
  provided someip service instance ProvidedSomeIpVehicleStateManagerInterfaceInstance: service-interface-deployment=VehicleStateManagerInterfaceSomeIp, sd-server-config=SomeipSdServerServiceInstanceConfig, service-instance-id=911
    someip provided event group VehicleConditionCollection_provided_eventgroup: event-group=VehicleConditionCollection_eventgroup, multicast-threshold=0
  required someip service instance RequiredSomeIpPackageManagementInstanceForVehiclePackageManager: service-interface-deployment=PackageManagementSomeIp, required-minor-version=0, required-service-instance-id=ANY, sd-client-config=SomeipSdClientServiceInstanceConfig
    someip required event group CurrentStatus_required_eventgroup: event-group=CurrentStatus_eventgroup
