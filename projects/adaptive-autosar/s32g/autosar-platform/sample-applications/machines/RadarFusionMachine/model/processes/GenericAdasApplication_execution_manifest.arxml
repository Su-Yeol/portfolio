AUTOSAR XML (schema 00052)
package /apd/Machines/RadarFusionMachine/ProcessToMachineMappings
  process to machine mapping set GenericAdasApplication
    process to machine mapping GenericAdasApplication: machine=RadarFusionMachine, process=GenericAdasApplication
package /apd/Machines/RadarFusionMachine/DltLogChannelToProcessMappings
  dlt application to process mapping GenericAdasDltApplicationToProcessMapping: dlt-application=GenericAdasApplication, process=GenericAdasApplication
  dlt log sink to port prototype mapping GenericAdasDltLogSinkToPortPrototypeMapping: dlt-context=DefaultDltContext, dlt-log-sink=[ConsoleDltSink, RemoteDltSink, GenericAdasApplicationFileDltSink], process=GenericAdasApplication
package /apd/Machines/RadarFusionMachine/Processes
  process GenericAdasApplication: design=GenericAdasApplication, executable=GenericAdasApplication, state-dependent-startup-config{function-group-state=[MachineFG.Driving, MachineFG.Parking], resource-group=ResourceGroup1, startup-config=GenericAdasApplicationStartup}
    process state machine state_machine: type=ProcessStateMachine
package /apd/Machines/RadarFusionMachine/ServiceInstanceToPortPrototypeMappings
  9 x service instance to port prototype mapping, all with process=GenericAdasApplication:
    OsiAdiAdapter_RequiredServiceInstance_toPort: port-prototype=GenericAdasApplication_RPort, service-instance=OsiAdiAdapterRequiredSomeipServiceInstance
    OsiAdiAdapter_RequiredServiceInstance{2..9}_toPort: port-prototype=GenericAdasApplication_RPort{2..9}, service-instance=OsiAdiAdapterRequiredSomeipServiceInstance{2..9}
package /apd/Machines/RadarFusionMachine/StartupConfigSets
  startup config GenericAdasApplicationStartup: environment-variables=tag-with-optional-value={key=VSOMEIP_CONFIGURATION, value=/etc/vsomeip.json}, scheduling-policy=SCHEDULING-POLICY-ROUND-ROBIN, scheduling-priority=12, termination-behavior=PROCESS-IS-NOT-SELF-TERMINATING
