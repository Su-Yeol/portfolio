AUTOSAR XML (schema 00052)
package /apd/Machines/RadarFusionMachine
  machine RadarFusionMachine: default-application-timeout=exit-timeout-value=0.5, environment-variables=tag-with-optional-value={key=DLT_LOG_MODE, value=3}, machine-design=RadarFusionMachineDesign
    module-instantiations:
      log and trace instantiation LogAndTraceInstanciation: log-sink=ConsoleDltSink
      os module instantiation Linux
        6 x resource group:
          ResourceGroup1: cpu-usage=95, mem-usage=2000000000
          ResourceGroup2: cpu-usage=95, mem-usage=2000000000
          ResourceGroupDB: cpu-usage=80, mem-usage=500000000
          ResourceGroupDIAG: cpu-usage=80, mem-usage=500000000
          ResourceGroupIAM: cpu-usage=80, mem-usage=500000000
          ResourceGroupSM: cpu-usage=80, mem-usage=500000000
      ucm master module instantiation UcmInstance: identifier=RadarFusionMachineUCM
    processor DefaultProcessor
      processor core ProcessorCore0: core-id=0
      processor core ProcessorCore1: core-id=1
package /apd/Machines/RadarFusionMachine/E2E
  e 2 e profile configuration set e2eprofiles
    e 2 e profile configuration PROFILE_01: max-delta-counter=1, max-error-state-init=0, max-error-state-invalid=0, max-error-state-valid=0, min-ok-state-init=1, min-ok-state-invalid=1, min-ok-state-valid=1, profile-name=PROFILE_01, window-size-init=1, window-size-invalid=1, window-size-valid=1
package /apd/Machines/RadarFusionMachine/FunctionGroupSets
  function group set RadarFusionFunctionGroups
    function-groups:
      8 x mode declaration group prototype:
        MachineFG: type=MachineState
        Lane_Change_Assistance: type=Lane_Change_Assistance
        Sensor: type=Sensor
        Pedestrian_Protection: type=Pedestrian_Protection
        UltrasonicsensorApplicationFG: type=UltrasonicsensorApplicationFG
        ControllerApplicationFG: type=ControllerApplicationFG
        UpdatableApplicationFG: type=UpdatableApplicationFG
        UCMDemoModeFG: type=UCMDemoModeFG
package /apd/Machines/RadarFusionMachine/SoftwareClusters
  4 x software cluster:
    RadarFusionCoreCluster:
      category=PLATFORM_CORE
      claimed-function-group=[MachineFG, Lane_Change_Assistance, Sensor, Pedestrian_Protection, UCMDemoModeFG]
      contained-process=[actor, access_manager, controller, CMValidatorPublisher, CMValidatorSubscriber, DemonstratorTutorial, AdiOsiAdapter, EmoIntegrationTest, SmartCameraSensor, EmoSampleApplication, ExtendedTutorial, FaultyCalibrationApplication, FaultyProbingApplication, FaultyReportingApplication, flashing_adapter, fusion, linesensor, OsiAdiAdapter, GenericAdasApplication, ota_client, package_manager, PersistencyDemo, PersistencyRedundancyDemo, PhmDemo, pkgmgr_sample, radar, RES_TimingRefApp, RES_TimingRefServiceApp, RES_TraceIntegrationTest, RES_TraceIntegrationTest2, SecDemoFc, SecIamTestApp, SensorDemoApplication, smtool, StateManager, TimeSyncConsumer, TimeSyncProvider, TlvDemoReceiver, TlvDemoSender, transfer_performance_check, ultrasonicsensor, UpdatableApp, update_adapter_agl, update_adapter_android, vehicle_driver_application, vehicle_package_manager, vehicle_state_manager_application]
      installation-behavior=CANNOT-BE-REMOVED
      module-instantiation=Linux
    ControllerAppSwcl: claimed-function-group=ControllerApplicationFG, contained-process=controller, installation-behavior=CAN-BE-REMOVED
    UpdatableAppSwcl: claimed-function-group=UpdatableApplicationFG, contained-process=UpdatableApp, installation-behavior=CAN-BE-REMOVED
    UltrasonicSensorAppSwcl: claimed-function-group=UltrasonicsensorApplicationFG, contained-process=ultrasonicsensor, installation-behavior=CAN-BE-REMOVED
package /apd/Machines/RadarFusionMachine/Dlt
  dlt ecu RadarFusionDltEcu
    46 x dlt application, all with contexts=DefaultDltContext:
      Actor: application-description=example app. picar actor, application-id=PIA
      Controller: application-description=example app. picar controller, application-id=PIC
      LineSensor: application-description=example app. picar linesensor, application-id=PIL
      UltrasonicSensor: application-description=example app. picar ultrasonicsensor, application-id=PIU
      CMValidatorPublisherApplication: application-description=CM Validator Publisher Application, application-id=CMVP
      CMValidatorSubscriberApplication: application-description=CM Validator Subscriber Application, application-id=CMVS
      DemonstratorTutorialApplication: application-description=Demonstrator Tutorial Application, application-id=TTRL
      EmoIntegrationTestApplication: application-description=EMO Integration Test, application-id=EMIT
      TlvDemoReceiverApplication: application-description=TLV receiver Application, application-id=TTRL
      TlvDemoSenderApplication: application-description=TLV sender Application, application-id=TTRL
      ExtendedTutorialApplication: application-description=Extended Tutorial Application, application-id=ETRL
      TimeSyncProviderApplication: application-description=Time Sync Provider Application, application-id=TSYP
      TimeSyncConsumerApplication: application-description=Time Sync Consumer Application, application-id=TSYC
      RES_TimingRefApp: application-description=Time Reference Application, application-id=RTRA
      RES_TimingRefServiceApp: application-description=Time Reference Application Service Provider, application-id=RTRS
      RES_TraceIntegrationTest: application-description=Trace Integration Test, application-id=RTIT
      RES_TraceIntegrationTest2: application-description=Trace Integration Test2, application-id=RTI2
      FaultyCalibrationApplication: application-description=Faulty Calibration Application, application-id=FCAP
      FaultyProbingApplication: application-description=Faulty Probing Application, application-id=FPAP
      FaultyReportingApplication: application-description=Faulty Reporting Application, application-id=FPAP
      PhmDemoApplication: application-description=PhmDemo Application, application-id=PHMD
      FusionApplication: application-description=example app. fusion, application-id=EXFU
      RadarApplication: application-description=example app. radar, application-id=EXRA
      AdiOsiAdapterApplication: application-description=example app. AdiOsiAdapter, application-id=AOAR
      SmartCameraSensorApplication: application-description=example app. SmartCameraSensor, application-id=SCS
      OsiAdiAdapterApplication: application-description=example app. OsiAdiAdapter, application-id=OAAR
      GenericAdasApplication: application-description=example app. GenericAdasApplication, application-id=GAA
      VehicleDriverIfApplication: application-description=example app. vehicle driver interface, application-id=VDIF
      SensorDemoApplication: application-description=Sensor Demo Application, application-id=SDAP
      StateManagerApplication: application-description=State Manager, application-id=STMR
      OtaClientApplication: application-description=example app. ota, application-id=EXOTA
      FlashingAdapterApplication: application-description=Flashing Adapter, application-id=FLAD
      UpdateAdapterAGLApplication: application-description=Update Adapter for non-AUTOSAR platform, application-id=UAGL
      UpdateAdapterAndroidApplication: application-description=Update Adapter for non-AUTOSAR platform, application-id=UAND
      PkgmgrApplication: application-description=UCM SAMPLE, application-id=UCMS
      PackageManager: application-description=UCM, application-id=UCM
      VehiclePackageManager: application-description=UCM Master, application-id=UCMM
      TransferPerformanceCheckApplication: application-description=Transfer Performance Test, application-id=EXTPT
      DriverIfApplication: application-description=example app. dif, application-id=EXDIF
      UpdatableApplication: application-description=Updatable App, application-id=UAPP
      EmoSampleApplication: application-description=Emo Sample Application, application-id=EMAP
      SecDemoFcApplication: application-description=Sec Demo Fc Application, application-id=SDFC
      SecIamTestAppApplication: application-description=Sec Iam Test Application, application-id=SIT
      VehicleStateManagerIfApplication: application-description=example app. vehicle state manager interface, application-id=VSMI
      fc_firewall: application-description=Firewall, application-id=Firewall
      OEMApplication: application-description=OEM App, application-id=OAPP
  dlt log sink ConsoleDltSink: category=DLT_LOGSINK_CONSOLE, buffer-output=true, default-log-threshold=VERBOSE
