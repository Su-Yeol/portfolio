AUTOSAR XML (schema 00052)
package /apd/Machines/RadarFusionMachine/ServiceInstanceToMachineMappings
  9 x someip service instance to machine mapping, all with communication-connector=RadarFusionConnector, udp-port=TriggerApplicationEndpoint:
    OsiAdiAdapter_ProvidedServiceInstance_toMachine: service-instance=OsiAdiAdapterProvidedSomeipServiceInstance
    OsiAdiAdapter_ProvidedServiceInstance{2..9}_toMachine: service-instance=OsiAdiAdapterProvidedSomeipServiceInstance{2..9}
package /apd/Machines/RadarFusionMachine/ServiceInstances
  9 x provided someip service instance, all with sd-server-config=SomeipSdServerServiceInstanceConfig:
    OsiAdiAdapterProvidedSomeipServiceInstance: service-interface-deployment=RoadObjects_Someip, service-instance-id=150
      e-2-e-event-protection-propss:
        end 2 end event protection props End2EndEventProtectionProps: data-ids=4321, e-2-e-profile-configuration=PROFILE_01, event=RoadObjectInterface_Someip, max-data-length=4096, min-data-length=1
      someip provided event group RequiredEventgroup1: event-group=SomeipEventgroup1, multicast-threshold=0
    OsiAdiAdapterProvidedSomeipServiceInstance2: service-interface-deployment=StaticObjects_Someip, service-instance-id=151
      e-2-e-event-protection-propss:
        end 2 end event protection props End2EndEventProtectionProps: data-ids=4321, e-2-e-profile-configuration=PROFILE_01, event=StaticObjectInterface_Someip, max-data-length=4096, min-data-length=1
      someip provided event group RequiredEventgroup1: event-group=SomeipEventgroup1, multicast-threshold=0
    OsiAdiAdapterProvidedSomeipServiceInstance3: service-interface-deployment=PotentiallyMovingObjects_Someip, service-instance-id=152
      e-2-e-event-protection-propss:
        end 2 end event protection props End2EndEventProtectionProps: data-ids=4321, e-2-e-profile-configuration=PROFILE_01, event=PotentiallyMovingObjectsInterface_Someip, max-data-length=4096, min-data-length=1
      someip provided event group RequiredEventgroup1: event-group=SomeipEventgroup1, multicast-threshold=0
    OsiAdiAdapterProvidedSomeipServiceInstance4: service-interface-deployment=CameraFeatures_Someip, service-instance-id=153
      e-2-e-event-protection-propss:
        end 2 end event protection props End2EndEventProtectionProps: data-ids=4321, e-2-e-profile-configuration=PROFILE_01, event=CameraFeaturesInterface_Someip, max-data-length=4096, min-data-length=1
      someip provided event group RequiredEventgroup1: event-group=SomeipEventgroup1, multicast-threshold=0
    OsiAdiAdapterProvidedSomeipServiceInstance5: service-interface-deployment=CameraDetection_Someip, service-instance-id=154
      e-2-e-event-protection-propss:
        end 2 end event protection props End2EndEventProtectionProps: data-ids=4321, e-2-e-profile-configuration=PROFILE_01, event=CameraDetectionInterface_Someip, max-data-length=4096, min-data-length=1
      someip provided event group RequiredEventgroup1: event-group=SomeipEventgroup1, multicast-threshold=0
    OsiAdiAdapterProvidedSomeipServiceInstance6: service-interface-deployment=UltrasonicDetections_Someip, service-instance-id=155
      e-2-e-event-protection-propss:
        end 2 end event protection props End2EndEventProtectionProps: data-ids=4321, e-2-e-profile-configuration=PROFILE_01, event=UltrasonicDetectionsInterface_Someip, max-data-length=4096, min-data-length=1
      someip provided event group RequiredEventgroup1: event-group=SomeipEventgroup1, multicast-threshold=0
    OsiAdiAdapterProvidedSomeipServiceInstance7: service-interface-deployment=UltrasonicFeatures_Someip, service-instance-id=156
      e-2-e-event-protection-propss:
        end 2 end event protection props End2EndEventProtectionProps: data-ids=4321, e-2-e-profile-configuration=PROFILE_01, event=UltrasonicFeaturesInterface_Someip, max-data-length=4096, min-data-length=1
      someip provided event group RequiredEventgroup1: event-group=SomeipEventgroup1, multicast-threshold=0
    OsiAdiAdapterProvidedSomeipServiceInstance8: service-interface-deployment=LidarDetections_Someip, service-instance-id=157
      e-2-e-event-protection-propss:
        end 2 end event protection props End2EndEventProtectionProps: data-ids=4321, e-2-e-profile-configuration=PROFILE_01, event=LidarDetectionsInterface_Someip, max-data-length=4096, min-data-length=1
      someip provided event group RequiredEventgroup1: event-group=SomeipEventgroup1, multicast-threshold=0
    OsiAdiAdapterProvidedSomeipServiceInstance9: service-interface-deployment=RadarDetections_Someip, service-instance-id=158
      e-2-e-event-protection-propss:
        end 2 end event protection props End2EndEventProtectionProps: data-ids=4321, e-2-e-profile-configuration=PROFILE_01, event=RadarDetectionsInterface_Someip, max-data-length=4096, min-data-length=1
      someip provided event group RequiredEventgroup1: event-group=SomeipEventgroup1, multicast-threshold=0
