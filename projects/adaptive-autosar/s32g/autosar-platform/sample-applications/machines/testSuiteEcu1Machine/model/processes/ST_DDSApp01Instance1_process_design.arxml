AUTOSAR XML (schema 00052)
package /apd/Machines/testSuiteEcu1Machine/ProcessDesigns
  process design ST_DDSApp01Instance1: executable=ST_DDSApp01
