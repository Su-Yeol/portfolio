AUTOSAR XML (schema 00052)
package /apd/Machines/testSuiteEcu1Machine/ProcessDesigns
  process design StateManager: executable=StateManager
