AUTOSAR XML (schema 00052)
package /apd/Machines/RadarMachine/ServiceInstanceToMachineMappings
  someip service instance to machine mapping tlv_ProvidedServiceInstance_toMachine: communication-connector=RadarConnector, service-instance=TlvProvidedSomeipServiceInstance, udp-port=TriggerApplicationEndpoint
package /apd/Machines/RadarMachine/ServiceInstances
  provided someip service instance TlvProvidedSomeipServiceInstance: service-interface-deployment=Tlv_Someip, sd-server-config=SomeipSdServerServiceInstanceConfig, service-instance-id=39
