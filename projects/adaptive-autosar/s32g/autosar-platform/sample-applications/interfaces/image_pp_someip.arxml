AUTOSAR XML (schema 00052)
package /apd/ServiceInterfaceDeployments
  someip service interface deployment ImagePP_Someip: service-interface=ImagePP, service-interface-id=5
    someip event deployment Data_Someip: event=Data, event-id=1, transport-protocol=UDP
    someip event group ImagePP: event-group-id=1, event=Data_Someip
