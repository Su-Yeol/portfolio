AUTOSAR XML (schema 00052)
package /apd/ServiceInterfaceDeployments
  someip service interface deployment UltraSonicSensorSomeIp: service-interface=UltraSonicSensorInterface, service-interface-id=263, service-interface-version={major-version=1, minor-version=0}
    someip event deployment UltraSonicSensorEvent: event=ultrasonicSensorEvent, event-id=23004, transport-protocol=UDP
    someip event group UltraSonicSensorEventGroup: event-group-id=4588, event=UltraSonicSensorEvent
