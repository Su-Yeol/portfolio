AUTOSAR XML (schema 00052)
package /apd/CppImplementationDataTypes
  std cpp implementation data type Position: category=STRUCTURE, type-emitter=TYPE_EMITTER_ARA  # Insert description here if needed.
    namespaces:
      symbol props apd
      symbol props shared
    cpp implementation data type element x: type-reference={inplace=false, type-reference=int32_t}
    cpp implementation data type element y: type-reference={inplace=false, type-reference=int32_t}
    cpp implementation data type element z: type-reference={inplace=false, type-reference=int32_t}
package /apd/ServiceInterfaces
  service interface ddsservice5
    namespaces:
      symbol props apd
      symbol props testsuite
      symbol props cmdds
    methods:
      operation MethodC
        arg target_position: type=Position, direction=IN
        arg success: type=bool, direction=OUT
        arg effective_position: type=Position, direction=OUT
      operation MethodD: fire-and-forget=true
        arg text: type=String, direction=IN
