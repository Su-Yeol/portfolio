AUTOSAR XML (schema 00052)
package /apd/ServiceInterfaceDeployments
  someip service interface deployment HealthIndicator_Someip: service-interface=HealthIndicator, service-interface-id=102, service-interface-version={major-version=1, minor-version=0}
    someip event deployment HealthIndicatorEvent_Someip: event=HealthIndicatorEvent, event-id=1, transport-protocol=UDP
    someip event group SomeipEventgroup1: event-group-id=1, event=HealthIndicatorEvent_Someip
