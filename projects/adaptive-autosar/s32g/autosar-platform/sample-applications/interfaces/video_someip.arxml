AUTOSAR XML (schema 00052)
package /apd/ServiceInterfaceDeployments
  someip service interface deployment Video_Someip: service-interface=Video, service-interface-id=65534
    someip event deployment Data_Someip: event=Data, event-id=1, transport-protocol=UDP
    someip event group Video: event-group-id=1, event=Data_Someip
