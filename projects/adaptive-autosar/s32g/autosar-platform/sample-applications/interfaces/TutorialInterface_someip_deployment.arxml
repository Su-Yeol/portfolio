AUTOSAR XML (schema 00052)
package /apd/ServiceInterfaceDeployments
  someip service interface deployment TutorialInterfaceSomeipDeployment: service-interface=TutorialInterface, service-interface-id=4242, service-interface-version={major-version=1, minor-version=0}
    someip event deployment DataDeployment: event=Data, event-id=1, transport-protocol=UDP
    someip event group TutorialInterfaceEventGroup: event-group-id=1, event=DataDeployment
