AUTOSAR XML (schema 00052)
package /apd/ServiceInterfaceDeployments
  someip service interface deployment CMService5_Someip: service-interface=CMService5, service-interface-id=55, service-interface-version={major-version=1, minor-version=0}
    someip event deployment CMEvent5: event=Event5, event-id=555, transport-protocol=UDP
    someip event group SomeipEventgroup5: event-group-id=555, event=CMEvent5
