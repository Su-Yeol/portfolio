AUTOSAR XML (schema 00052)
package /apd/ServiceInterfaces
  service interface RawUDS
    namespaces:
      symbol props ara
      symbol props diag
    methods:
      operation HandleMessage: possible-ap-error=[GeneralReject, ServiceNotSupported, SubfunctionNotSupported, IncorrectMessageLengthOrInvalidFormat, ResponseTooLong, BusyRepeatRequest, ConditionsNotCorrect, RequestSequenceError, NoResponseFromSubnetComponent, FailurePreventsExecutionOfRequestedAction, RequestOutOfRange, SecurityAccessDenied, ExceedNumberOfAttempts, RequiredTimeDelayNotExpired, UploadDownloadNotAccepted, TransferDataSuspended, WrongBlockSequenceCounter, RequestCorrectlyReceivedResponsePending, SubfunctionNotSupportedInActiveSession, ServiceNotSupportedInActiveSession]
        4 x arg:
          diagResponse: type=ByteArray, direction=OUT
          sendResponse: type=bool, direction=OUT
          diagRequest: type=ByteArray, direction=IN
          SID: type=int8_t, direction=IN
