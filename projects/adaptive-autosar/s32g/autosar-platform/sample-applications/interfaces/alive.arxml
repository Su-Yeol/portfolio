AUTOSAR XML (schema 00052)
package /apd/ServiceInterfaces
  service interface Alive
    namespaces:
      symbol props apd
      symbol props scenario2
      symbol props portinterfaces
    events:
      data Id: type=uint8_t
