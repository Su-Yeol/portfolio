AUTOSAR XML (schema 00052)
package /apd/ServiceInterfaces
  service interface CMService5
    namespaces:
      symbol props apd
      symbol props testsuite
      symbol props cm
    events:
      data Event5: type=int32_t
