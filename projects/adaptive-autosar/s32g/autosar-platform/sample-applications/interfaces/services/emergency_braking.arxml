AUTOSAR XML (schema 00052)
package /adcm
  service interface emergency_braking
    namespaces:
      symbol props adcm
    events:
      data emergencyBrakingEvent: type=emergency_braking_Objects
package /adcm/events
  std cpp implementation data type emergency_braking_Objects: category=STRUCTURE, type-emitter=TYPE_EMITTER_ARA
    namespaces:
      symbol props adcm
    cpp implementation data type element EmergencyLidarData: type-reference={inplace=false, type-reference=emergency_lidar_Array}
  std cpp implementation data type emergency_lidar_Array: category=VECTOR, cpp-template-argument=uint8_t, type-emitter=TYPE_EMITTER_ARA
