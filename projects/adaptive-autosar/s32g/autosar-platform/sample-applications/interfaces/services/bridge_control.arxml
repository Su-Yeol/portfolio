AUTOSAR XML (schema 00052)
package /adcm
  service interface bridge_control
    namespaces:
      symbol props adcm
    events:
      data controlBridgeEvent: type=bridge_control_Objects
package /adcm/events
  std cpp implementation data type bridge_control_Objects: category=STRUCTURE, type-emitter=TYPE_EMITTER_ARA
    namespaces:
      symbol props adcm
    6 x cpp implementation data type element:
      Acc: type-reference={inplace=false, type-reference=double}
      Break: type-reference={inplace=false, type-reference=double}
      Steer: type-reference={inplace=false, type-reference=double}
      RemoteEnable: type-reference={inplace=false, type-reference=bool}
      Enable: type-reference={inplace=false, type-reference=bool}
      Turn_signal: type-reference={inplace=false, type-reference=int8_t}
