AUTOSAR XML (schema 00052)
package /adcm
  service interface collect_fault_routing
    namespaces:
      symbol props adcm
    events:
      data collectFaultRoutingEvent: type=collect_fault_routing_Objects
package /adcm/events
  std cpp implementation data type collect_fault_routing_Objects: category=STRUCTURE, type-emitter=TYPE_EMITTER_ARA
    namespaces:
      symbol props adcm
    cpp implementation data type element AP: type-reference={inplace=false, type-reference=uint8_t}
    cpp implementation data type element Fault_Routing: type-reference={inplace=false, type-reference=uint8Vector}
