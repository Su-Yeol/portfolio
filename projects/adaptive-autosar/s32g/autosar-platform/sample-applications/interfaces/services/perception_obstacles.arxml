AUTOSAR XML (schema 00052)
package /adcm
  service interface perception_obstacles
    namespaces:
      symbol props adcm
    events:
      data perceptionObstaclesEvent: type=perception_obstacles_Objects
package /adcm/events
  std cpp implementation data type perception_obstacles_Objects: category=STRUCTURE, type-emitter=TYPE_EMITTER_ARA
    namespaces:
      symbol props adcm
    cpp implementation data type element PerceptionObstacleVector: type-reference={inplace=false, type-reference=perception_obstacle_Array}
    cpp implementation data type element Lidar_Status: type-reference={inplace=false, type-reference=bool}
  std cpp implementation data type perception_obstacle_Array: category=VECTOR, cpp-template-argument=Perception_obstacles, type-emitter=TYPE_EMITTER_ARA
  std cpp implementation data type Perception_obstacles: category=STRUCTURE, type-emitter=TYPE_EMITTER_ARA
    namespaces:
      symbol props adcm
    9 x cpp implementation data type element:
      Id: type-reference={inplace=false, type-reference=uint16_t}
      Type: type-reference={inplace=false, type-reference=uint8_t}
      Position: type-reference={inplace=false, type-reference=Vector2D_F}
      Length: type-reference={inplace=false, type-reference=float}
      Width: type-reference={inplace=false, type-reference=float}
      Timestamp: type-reference={inplace=false, type-reference=double}
      Velocity_x: type-reference={inplace=false, type-reference=float}
      Velocity_y: type-reference={inplace=false, type-reference=float}
      Heading: type-reference={inplace=false, type-reference=float}
