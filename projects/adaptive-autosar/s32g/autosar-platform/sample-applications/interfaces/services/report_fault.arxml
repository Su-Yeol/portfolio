AUTOSAR XML (schema 00052)
package /adcm
  service interface report_fault
    namespaces:
      symbol props adcm
    events:
      data reportFaultEvent: type=report_fault_Objects
package /adcm/events
  std cpp implementation data type report_fault_Objects: category=STRUCTURE, type-emitter=TYPE_EMITTER_ARA
    namespaces:
      symbol props adcm
    cpp implementation data type element AP: type-reference={inplace=false, type-reference=uint8_t}
    cpp implementation data type element FaultList: type-reference={inplace=false, type-reference=uint8Vector}
