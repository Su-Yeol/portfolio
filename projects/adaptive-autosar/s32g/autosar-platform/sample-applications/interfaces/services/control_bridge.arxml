AUTOSAR XML (schema 00052)
package /adcm
  service interface control_bridge
    namespaces:
      symbol props adcm
    events:
      data controlBridgeEvent: type=control_bridge_Objects
package /adcm/events
  std cpp implementation data type control_bridge_Objects: category=STRUCTURE, type-emitter=TYPE_EMITTER_ARA
    namespaces:
      symbol props adcm
    6 x cpp implementation data type element:
      Acc: type-reference={inplace=false, type-reference=double}
      Break: type-reference={inplace=false, type-reference=double}
      Steer: type-reference={inplace=false, type-reference=double}
      RemoteEnable: type-reference={inplace=false, type-reference=bool}
      Enable: type-reference={inplace=false, type-reference=bool}
      Turn_signal: type-reference={inplace=false, type-reference=int8_t}
