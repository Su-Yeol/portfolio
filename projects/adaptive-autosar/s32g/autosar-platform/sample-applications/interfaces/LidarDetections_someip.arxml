AUTOSAR XML (schema 00052)
package /apd/ServiceInterfaceDeployments
  someip service interface deployment LidarDetections_Someip: service-interface=LidarDetectionsService, service-interface-id=6, service-interface-version={major-version=1, minor-version=0}
    someip event deployment LidarDetectionsInterface_Someip: event=LidarDetectionInterfaceEvent, event-id=1, transport-protocol=UDP
    someip method deployment Capability_Someip: method=LidarDetectionsCapability, method-id=32000, transport-protocol=UDP
    someip event group SomeipEventgroup1: event-group-id=1, event=LidarDetectionsInterface_Someip
