AUTOSAR XML (schema 00052)
package /apd/PersistencyRedundancyDemo_Interfaces
  persistency key value storage interface PersistencyRedundancyDemo_KvsInterf
