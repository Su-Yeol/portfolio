AUTOSAR XML (schema 00052)
package /apd/Documentations
  documentation AUTOSAR_LIC: category=LICENSE
  documentation R2003_RN
