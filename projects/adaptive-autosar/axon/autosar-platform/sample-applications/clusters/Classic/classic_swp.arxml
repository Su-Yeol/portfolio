AUTOSAR XML (schema 00052)
package /apd/SoftwarePackages/@CSWPP_NAME@
  software package @CSWPP_NAME@SwpkgInstall: action-type=INSTALL, activation-action=NOTHING, compressed-software-package-size=0, estimated-duration-of-operation=42, minimum-supported-ucm-version=1.0.0_0, packager-id=1347111236, purpose-of-update=@CSWPP_NAME@SwpkgInstallUpdatePurpose, software-cluster=@CSWCL_NAME@Swcl, uncompressed-software-cluster-size=16384
  documentation @CSWPP_NAME@SwpkgInstallUpdatePurpose: documentation-content=p=l-1=Install the @CSWPP_NAME@ app application
