AUTOSAR XML (schema 00052)
package /apd/Executables
  executable linesensor: category=APPLICATION_LEVEL, build-type=BUILD-TYPE-DEBUG, minimum-timer-granularity=1000.0, reporting-behavior=REPORTS-EXECUTION-STATE, version=0.1.0
    root sw component prototype LineSensorRoot: application-type=linesensor
package /apd/AdaptiveApplicationSwComponentTypes
  adaptive application sw component type linesensor
    provide port LineSensorPPort: provided-interface=LineSensorInterface
