AUTOSAR XML (schema 00052)
package /apd/AdaptiveApplicationSwComponentTypes
  adaptive application sw component type shmClient1
    provide port shmClient1_PPort: provided-interface=HealthInfo
package /apd/Executables
  executable shmClient1: category=APPLICATION_LEVEL, minimum-timer-granularity=1000
    root sw component prototype shmClient1: application-type=shmClient1
