AUTOSAR XML (schema 00052)
package /apd/AdaptiveApplicationSwComponentTypes
  adaptive application sw component type PersistencyDemo
    provide/require port PersistencyKvsDemo_RPPort: provided-required-interface=PersistencyKvsDemo
package /apd/Executables
  executable PersistencyDemo: category=APPLICATION_LEVEL, minimum-timer-granularity=1000.0
    root sw component prototype PersistencyDemo: application-type=PersistencyDemo
