AUTOSAR XML (schema 00052)
package /apd/AdaptiveApplicationSwComponentTypes
  adaptive application sw component type flashing_adapter
    provide port PackageManagementProvided: provided-interface=PackageManagement
    provide/require port SwClusterDescPRPort: provided-required-interface=SwClusterDescriptionKVSInterface
    provide/require port SwPackageTransferStatusPRPort: provided-required-interface=SwPackageTransferStatus
package /apd/Executables
  executable flashing_adapter: category=APPLICATION_LEVEL, minimum-timer-granularity=1000.0, version=1.0.0
    root sw component prototype FlashingAdapterSwc: application-type=flashing_adapter
