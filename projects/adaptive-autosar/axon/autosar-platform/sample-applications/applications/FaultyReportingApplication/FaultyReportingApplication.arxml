AUTOSAR XML (schema 00052)
package /apd/AdaptiveApplicationSwComponentTypes
  adaptive application sw component type FaultyReportingApplication
package /apd/Executables
  executable FaultyReportingApplication: category=APPLICATION_LEVEL, minimum-timer-granularity=1000, reporting-behavior=DOES-NOT-REPORT-EXECUTION-STATE
    root sw component prototype FaultyReportingApp: application-type=FaultyReportingApplication
