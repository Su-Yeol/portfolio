AUTOSAR XML (schema 00052)
package /apd/AdaptiveApplicationSwComponentTypes
  adaptive application sw component type HpProcessingApp
    require port cpapservicePort: required-interface=SensorActuatorService
package /apd/Executables
  executable RES_TimingRefApp: category=APPLICATION_LEVEL, minimum-timer-granularity=1000
    root sw component prototype RES_TimingRefApp: application-type=HpProcessingApp
