AUTOSAR XML (schema 00052)
package /apd/testSuite/appDesignPortInterface/cmappsErrors
  ap application error InvalidConfigString: error-code=5, error-domain=SpecificErrors  # Configuration string is invalid.
  ap application error InvalidParameter: error-code=6, error-domain=SpecificErrors  # Parameter is invalid.
package /apd/testSuite/appDesignPortInterface/cmappsErrorsDomains
  ap application error domain SpecificErrors: value=44
    namespaces:
      symbol props apd
      symbol props testsuite
      symbol props cm
