AUTOSAR XML (schema 00052)
package /apd/ServiceInterfaceDeployments
  someip service interface deployment CameraFeatures_Someip: service-interface=CameraFeaturesService, service-interface-id=3, service-interface-version={major-version=1, minor-version=0}
    someip event deployment CameraFeaturesInterface_Someip: event=CameraFeatureInterfaceEvent, event-id=1, transport-protocol=UDP
    someip method deployment Capability_Someip: method=CameraFeaturesCapability, method-id=32000, transport-protocol=UDP
    someip event group SomeipEventgroup1: event-group-id=1, event=CameraFeaturesInterface_Someip
