AUTOSAR XML (schema 00052)
package /apd/ServiceInterfaces
  service interface DataIdentifier
    namespaces:
      symbol props ara
      symbol props diag
    methods:
      operation Write
        arg dataRecord: type=ByteArray, direction=IN
      operation Read
        arg dataRecord: type=ByteArray, direction=OUT
