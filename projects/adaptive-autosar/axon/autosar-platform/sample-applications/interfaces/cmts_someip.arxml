AUTOSAR XML (schema 00052)
package /apd/ServiceInterfaceDeployments
  someip service interface deployment Cmts_Someip: service-interface=Cmts, service-interface-id=999, service-interface-version={major-version=1, minor-version=0}
    someip field deployment TestCounter_Someip: field=TestCounter
      get getter: method-id=3001, transport-protocol=TCP
      set setter: method-id=3002, transport-protocol=TCP
