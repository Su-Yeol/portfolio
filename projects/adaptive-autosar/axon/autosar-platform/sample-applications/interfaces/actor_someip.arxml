AUTOSAR XML (schema 00052)
package /apd/ServiceInterfaceDeployments
  someip service interface deployment ActorServInterfaceSomeIp: service-interface=ActorInterface, service-interface-id=259, service-interface-version={major-version=1, minor-version=0}
    someip method deployment MoveDeployment: method=Move, method-id=793, transport-protocol=UDP
