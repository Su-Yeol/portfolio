AUTOSAR XML (schema 00052)
package /apd/ServiceInterfaces
  service interface LineSensorInterface: category=APPLICATION_LEVEL
    namespaces:
      symbol props apd
      symbol props picar
    events:
      data lineSensorEvent: type=linesensorType
package /apd/CppImplementationDataTypes
  std cpp implementation data type linesensorType: category=STRUCTURE, cpp-template-argument=uint16_t, type-emitter=TYPE_EMITTER_ARA
    namespaces:
      symbol props apd
      symbol props picar
    cpp implementation data type element objectVector: type-reference={inplace=false, type-reference=ByteArray}
