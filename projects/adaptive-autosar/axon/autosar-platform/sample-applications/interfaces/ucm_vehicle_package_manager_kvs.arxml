AUTOSAR XML (schema 00052)
package /apd/vehicle_package_manager/PersistencyKeyValueStorageInterfaces
  persistency key value storage interface VehiclePackageTransferStatus: redundancy=NONE, update-strategy=KEEP-EXISTING
