AUTOSAR XML (schema 00052)
package /apd/ServiceInterfaces
  service interface TutorialInterface
    namespaces:
      symbol props apd
    events:
      data Data: type=uint32_t
