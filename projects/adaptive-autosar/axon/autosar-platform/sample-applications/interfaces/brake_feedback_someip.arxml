AUTOSAR XML (schema 00052)
package /apd/ServiceInterfaceDeployments
  someip service interface deployment BrakeFeedback_Someip: service-interface=BrakeFeedback, service-interface-id=9
    someip event deployment BrakeFeedbackSignal_Someip: event=BrakeFeedbackSignal, event-id=1, transport-protocol=UDP
    someip event group BrakeFeedback: event-group-id=1, event=BrakeFeedbackSignal_Someip
