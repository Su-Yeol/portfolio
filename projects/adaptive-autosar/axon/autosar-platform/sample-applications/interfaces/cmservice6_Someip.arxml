AUTOSAR XML (schema 00052)
package /apd/ServiceInterfaceDeployments
  someip service interface deployment CMService6_Someip: service-interface=CMService6, service-interface-id=66, service-interface-version={major-version=1, minor-version=0}
    someip event deployment CMEvent6: event=Event6, event-id=666, transport-protocol=UDP
    someip event group SomeipEventgroup6: event-group-id=666, event=CMEvent6
