AUTOSAR XML (schema 00052)
package /apd/ServiceInterfaceDeployments
  someip service interface deployment RoutineService_Someip: service-interface=RoutineService, service-interface-id=1700
    someip method deployment RequestResults_Someip: method=RequestResults, method-id=1703, transport-protocol=UDP
    someip method deployment Start_Someip: method=Start, method-id=1701, transport-protocol=UDP
    someip method deployment Stop_Someip: method=Stop, method-id=1702, transport-protocol=UDP
