AUTOSAR XML (schema 00052)
package /apd/ServiceInterfaceDeployments
  dds service interface deployment DDSService4_Dds: service-interface=ddsservice4, method-reply-topic-name=DdsTopicDdsService4MethodReply, method-request-topic-name=DdsTopicDdsService4MethodRequest, service-interface-id=ddsservice4, transport-protocols=UDP
