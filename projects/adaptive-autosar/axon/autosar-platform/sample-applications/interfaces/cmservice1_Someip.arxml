AUTOSAR XML (schema 00052)
package /apd/ServiceInterfaceDeployments
  someip service interface deployment CMService1_Someip: service-interface=CMService1, service-interface-id=99, service-interface-version={major-version=1, minor-version=0}
    someip event deployment CMEvent1: event=Event1, event-id=111, transport-protocol=UDP
    someip event group SomeipEventgroup1: event-group-id=111, event=CMEvent1
