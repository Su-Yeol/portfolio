AUTOSAR XML (schema 00052)
package /apd/ServiceInterfaceDeployments
  someip service interface deployment Brake_Someip: service-interface=Brake, service-interface-id=2
    someip event deployment BrakeSignal_Someip: event=BrakeSignal, event-id=1, transport-protocol=UDP
    someip event group Brake: event-group-id=1, event=BrakeSignal_Someip
