AUTOSAR XML (schema 00052)
package /apd/CppImplementationDataTypes
  std cpp implementation data type RadarObjects: category=STRUCTURE, type-emitter=TYPE_EMITTER_ARA
    namespaces:
      symbol props ara
      symbol props com
      symbol props sample
    cpp implementation data type element active: type-reference={inplace=false, type-reference=bool}
    cpp implementation data type element objectVector: type-reference={inplace=false, type-reference=ByteArray}
  std cpp implementation data type Position: category=STRUCTURE, type-emitter=TYPE_EMITTER_ARA
    namespaces:
      symbol props ara
      symbol props com
      symbol props sample
    cpp implementation data type element x: type-reference={inplace=false, type-reference=int32_t}
    cpp implementation data type element y: type-reference={inplace=false, type-reference=int32_t}
    cpp implementation data type element z: type-reference={inplace=false, type-reference=int32_t}
  std cpp implementation data type FusionVariant: compu {0x01=FV_CHINA (China), 0x05=FV_USA (USA), 0x06=FV_EUROPE (Europe), 0x07=FV_RUSSIA (Russia)}, type-emitter=TYPE_EMITTER_ARA, type-reference=uint16_t
    namespaces:
      symbol props ara
      symbol props com
      symbol props sample
package /apd/RadarFusionErrors
  ap application error domain SpecificErrors: value=44
    namespaces:
      symbol props ara
      symbol props com
      symbol props sample
  ap application error domain GenericErrors: value=45
    namespaces:
      symbol props ara
      symbol props com
      symbol props sample
  ap application error InvalidConfigString: error-code=5, error-domain=SpecificErrors  # Configuration string is invalid.
  ap application error InvalidParameter: error-code=6, error-domain=SpecificErrors  # Parameter is invalid.
  ap application error GenericFailure: error-code=12, error-domain=GenericErrors  # Generic failure.
package /apd/ServiceInterfaces
  service interface radar
    namespaces:
      symbol props ara
      symbol props com
      symbol props sample
    events:
      data brakeEvent: type=RadarObjects
      data parkingBrakeEvent: type=RadarObjects
    4 x field:
      UpdateRate: type=uint32_t, has-getter=true, has-notifier=true, has-setter=true
      FrontObjectDistance: type=uint16_t, has-getter=false, has-notifier=true, has-setter=false
      RearObjectDistance: type=uint16_t, has-getter=true, has-notifier=false, has-setter=false
      ObjectDetectionLimit: type=uint16_t, has-getter=false, has-notifier=false, has-setter=true
    methods:
      operation Adjust
        arg target_position: type=Position, direction=IN
        arg success: type=bool, direction=OUT
        arg effective_position: type=Position, direction=OUT
      operation Calibrate: possible-ap-error=InvalidConfigString
        arg configuration: type=String, direction=IN
        arg variant: type=FusionVariant, direction=IN
        arg result: type=bool, direction=OUT
      operation Echo: fire-and-forget=true
        arg text: type=String, direction=IN
