AUTOSAR XML (schema 00052)
package /apd/ServiceInterfaceDeployments
  someip service interface deployment Alive_Someip: service-interface=Alive, service-interface-id=8
    someip event deployment Id_Someip: event=Id, event-id=1, transport-protocol=UDP
    someip event group Alive: event-group-id=1, event=Id_Someip
