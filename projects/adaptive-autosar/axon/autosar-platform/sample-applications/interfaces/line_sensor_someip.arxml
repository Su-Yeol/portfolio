AUTOSAR XML (schema 00052)
package /apd/ServiceInterfaceDeployments
  someip service interface deployment LineSensorSomeIp: service-interface=LineSensorInterface, service-interface-id=261, service-interface-version={major-version=1, minor-version=0}
    someip event deployment LineSensorEvent: event=lineSensorEvent, event-id=23004, transport-protocol=UDP
    someip event group LineSensorEventGroup: event-group-id=4578, event=LineSensorEvent
