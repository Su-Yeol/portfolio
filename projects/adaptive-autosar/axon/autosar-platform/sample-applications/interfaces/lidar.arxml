AUTOSAR XML (schema 00052)
package /apd/CppImplementationDataTypes
  std cpp implementation data type Test: category=STRUCTURE, type-emitter=TYPE_EMITTER_ARA
    namespaces:
      symbol props ara
      symbol props com
      symbol props sample
    cpp implementation data type element eventNumber: type-reference={inplace=0, type-reference=uint64_t}
    cpp implementation data type element active: type-reference={inplace=false, type-reference=bool}
package /apd/ServiceInterfaces
  service interface Lidar
    namespaces:
      symbol props ara
      symbol props com
      symbol props sample
    events:
      data Test: type=Test
      data AnotherTest: type=Test
    4 x field:
      UpdateRate: type=uint32_t, has-getter=true, has-notifier=true, has-setter=true
      FrontObjectDistance: type=uint16_t, has-getter=false, has-notifier=true, has-setter=false
      RearObjectDistance: type=uint16_t, has-getter=true, has-notifier=false, has-setter=false
      ObjectDetectionLimit: type=uint16_t, has-getter=false, has-notifier=false, has-setter=true
    methods:
      operation Calibrate
        arg source: type=String, direction=IN
        arg changesCount: type=uint64_t, direction=IN
        arg result: type=String, direction=OUT
      operation Adjust
