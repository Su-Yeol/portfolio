AUTOSAR XML (schema 00052)
package /apd/diag/timing
  someip sd server service instance config SecurityAccess_SomeipServerServiceInstanceConfig: initial-offer-behavior={initial-delay-max-value=0.1, initial-delay-min-value=0.01, initial-repetitions-base-delay=0.2, initial-repetitions-max=3}, offer-cyclic-delay=2.0, request-response-delay={max-value=1.5, min-value=1.5}, service-offer-time-to-live=3
package /apd/diag/instance
  provided someip service instance SecurityAccess_SWC1_SecLevel1: service-interface-deployment=SecurityAccess_Someip, sd-server-config=SecurityAccess_SomeipServerServiceInstanceConfig, service-instance-id=11
  provided someip service instance SecurityAccess_SWC1_SecLevel2: service-interface-deployment=SecurityAccess_Someip, sd-server-config=SecurityAccess_SomeipServerServiceInstanceConfig, service-instance-id=12
package /apd/diag/mapping
  someip service instance to machine mapping seedKey_toMachine11: communication-connector=myCommunicationConnector, service-instance=SecurityAccess_SWC1_SecLevel1
  someip service instance to machine mapping seedKey_toMachine12: communication-connector=myCommunicationConnector, service-instance=SecurityAccess_SWC1_SecLevel2
  service instance to port prototype mapping seedKey1_toPort: port-prototype=port, process=SeedKey_instance, service-instance=SecurityAccess_SWC1_SecLevel1
  service instance to port prototype mapping seedKey2_toPort: port-prototype=port, process=SeedKey_instance, service-instance=SecurityAccess_SWC1_SecLevel2
