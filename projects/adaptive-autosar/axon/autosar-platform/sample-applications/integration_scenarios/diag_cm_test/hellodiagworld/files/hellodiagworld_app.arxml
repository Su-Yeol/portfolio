AUTOSAR XML (schema 00052)
package /ara/diag
  adaptive application sw component type hellodiagworld_swc
    require port DiagnosticStatus: required-interface=DiagnosticStatus
  executable hellodiagworld_exe
    root sw component prototype hellodiagworld_component: application-type=hellodiagworld_swc
  process hellodiagworld: design=hellodiagworld_design, executable=hellodiagworld_exe
  process design hellodiagworld_design: executable=hellodiagworld_exe
  process to machine mapping set HelloDiagWorldMachineMappings
    process to machine mapping HelloDiagWorldMapping: machine=dmMachine, process=hellodiagworld
  required someip service instance HelloDiagWorld_DiagnosticStatusRequiredServiceInstance: service-interface-deployment=DiagnosticStatus_Someip, required-service-instance-id=ANY
  service instance to port prototype mapping HelloDiagWorld_DiagnosticStatusRequiredServiceInstance_toPort: port-prototype=DiagnosticStatus, process=hellodiagworld, service-instance=HelloDiagWorld_DiagnosticStatusRequiredServiceInstance
  someip service instance to machine mapping HelloDiagWorld_DiagnosticStatusRequiredServiceInstance_toMachine: communication-connector=myCommunicationConnector, service-instance=HelloDiagWorld_DiagnosticStatusRequiredServiceInstance, tcp-port=ApApplicationEndpoint8
