AUTOSAR XML (schema 00052)
package /apd/Machines/testSuiteEcu2WRSOMEIPMachine/ProcessToMachineMappings
  process to machine mapping set CMApp09ProcessToMachineMapping
    process to machine mapping CMApp09SwcInstance1TotestSuiteEcu2WRSOMEIPMachine: machine=testSuiteEcu2WRSOMEIPMachine, process=ST_CMApp09Instance1
package /apd/Machines/testSuiteEcu2WRSOMEIPMachine/Processes
  process ST_CMApp09Instance1: design=ST_CMApp09Instance1, executable=ST_CMApp09, state-dependent-startup-config{function-group-state=SystemTestFunctionGroup.STS_CM_00003, resource-group=ResourceGroup1, startup-config=ST_CMApp09Startup}
    process state machine state_machine: type=ProcessStateMachine
package /apd/Machines/testSuiteEcu2WRSOMEIPMachine/ServiceInstanceToPortPrototypeMappings
  service instance to port prototype mapping CMService5ProvidedServiceInstanceToPort: port-prototype=CMApp09Service5Pport, process=ST_CMApp09Instance1, service-instance=ST_CMService5ProvidedSomeipServiceInstance
  service instance to port prototype mapping DiagRoutinePPortToCMApp09: port-prototype=DiagRoutineServicePport, process=ST_CMApp09Instance1, service-instance=ST_CMApp09DiagRoutineProvidedSomeipServiceInstance
package /apd/Machines/testSuiteEcu2WRSOMEIPMachine/StartupConfigSets
  startup config ST_CMApp09Startup: environment-variables=[{key=VSOMEIP_CONFIGURATION, value=/opt/CMApp09/etc/vsomeip.json}, {key=DLT_LOG_MODE, value=3}], scheduling-policy=SCHEDULING-POLICY-ROUND-ROBIN, scheduling-priority=12
package /apd/Machines/testSuiteEcu2WRSOMEIPMachine/DltLogChannelToProcessMappings
  dlt application to process mapping ST_CMApp09Instance1DltApplicationToProcessMapping: dlt-application=CMApp09Application, process=ST_CMApp09Instance1
  dlt log sink to port prototype mapping ST_CMApp09Instance1DltLogSinkToPortPrototypeMapping: dlt-context=DefaultDltContext, dlt-log-sink=[CMApp09FileDltSink, ConsoleDltSink, RemoteDltSink], process=ST_CMApp09Instance1
