AUTOSAR XML (schema 00052)
package /apd/Machines/testSuiteEcu2WRSOMEIPMachine
  machine testSuiteEcu2WRSOMEIPMachine: default-application-timeout=exit-timeout-value=0.1, environment-variables=tag-with-optional-value={key=DLT_LOG_MODE, value=3}, machine-design=testSuiteEcu2WRSOMEIPMachineDesign
    module-instantiations:
      log and trace instantiation LogAndTraceInstanciation: dlt-ecu=testSuiteEcu2WRSOMEIPMachineDltEcu, log-sink=ConsoleDltSink
      os module instantiation Linux
        6 x resource group:
          ResourceGroup1: cpu-usage=95, mem-usage=2000000000
          ResourceGroup2: cpu-usage=95, mem-usage=2000000000
          ResourceGroupDB: cpu-usage=80, mem-usage=500000000
          ResourceGroupDIAG: cpu-usage=80, mem-usage=500000000
          ResourceGroupIAM: cpu-usage=80, mem-usage=500000000
          ResourceGroupSM: cpu-usage=80, mem-usage=500000000
      ucm subordinate module instantiation UcmInstance: identifier=DevelopmentMachineUCM
package /apd/Machines/testSuiteEcu2WRSOMEIPMachine/ModeDeclarationGroups
  mode declaration group testSuiteEcu2WRSOMEIPMachineState: initial-mode=Startup
    8 x mode:
      Driving
      Leaving
      Off
      Parking
      Restart
      Shutdown
      Startup
      Verify
  mode declaration group SystemTestFunctionGroup: initial-mode=SystemTestFunctionGroup/Off
    10 x mode:
      Off
      STS_DDS_{00001..00004}
      STS_CM_00001
      STS_CM_00003
      STS_CM_00004
      Shutdown
      Verify
package /apd/Machines/testSuiteEcu2WRSOMEIPMachine/FunctionGroupSets
  function group set testSuiteEcu2FunctionGroups
    function-groups:
      5 x mode declaration group prototype:
        MachineFG: type=testSuiteEcu2WRSOMEIPMachineState
        SystemTestFG: type=SystemTestFunctionGroup
        Lane_Change_Assistance: type=Lane_Change_Assistance
        Pedestrian_Protection: type=Pedestrian_Protection
        SystemTestFunctionGroup: type=SystemTestFunctionGroup
package /apd/Machines/testSuiteEcu2WRSOMEIPMachine/SoftwareClusters
  software cluster testSuiteCMCluster: category=PLATFORM_CORE, claimed-function-group=[MachineFG, Lane_Change_Assistance, Pedestrian_Protection, SystemTestFunctionGroup], contained-process=[ST_CMApp02Instance1, ST_CMApp09Instance1, ST_CMApp11Instance1, ST_CMApp14Instance1, StateManager, ST_DDSApp03Instance1], module-instantiation=Linux
package /apd/Machines/testSuiteEcu2WRSOMEIPMachine/dlt
  dlt ecu testSuiteEcu2WRSOMEIPMachineDltEcu
    6 x dlt application, all with contexts=DefaultDltContext:
      CMApp02Application: application-description=Diag App 02, application-id=DA02
      CMApp09Application: application-description=Cm App 09, application-id=CA09
      CMApp11Application: application-description=Cm App 11, application-id=CA11
      CMApp14Application: application-description=Cm App 14, application-id=CA14
      StateManagerApplication: application-description=State Manager, application-id=STMR
      DDSApp03Application: application-description=DDS App 03, application-id=DD03
  dlt log sink ConsoleDltSink: category=DLT_LOGSINK_CONSOLE, buffer-output=true, default-log-threshold=VERBOSE
