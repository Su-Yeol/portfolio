AUTOSAR XML (schema 00052)
package /apd/Machines/FusionMachine/DltLogChannelToProcessMappings
  dlt application to process mapping ControllerToLogChannelMapping: dlt-application=Controller, process=controller
  dlt log sink to port prototype mapping ControllerDltLogSinkToPortPrototypeMapping: dlt-context=DefaultDltContext, dlt-log-sink=[ControllerFileDltSink, ConsoleDltSink, RemoteDltSink], process=controller
package /apd/Machines/FusionMachine/ProcessToMachineMappings
  process to machine mapping set controller
    process to machine mapping controller: machine=FusionMachine, process=controller
package /apd/Machines/FusionMachine/ServiceInstanceToPortPrototypeMappings
  service instance to port prototype mapping RequiredControllerInstanceToPortMappingActor: port-prototype=ControllerRPortActor, process=controller, service-instance=RequiredSomeIpActorInstance
  service instance to port prototype mapping RequiredControllerInstanceToPortMappingLineSensor: port-prototype=ControllerRPortLineSensor, process=controller, service-instance=RequiredSomeIpLineSensorInstance
  service instance to port prototype mapping RequiredControllerInstanceToPortMappingUltraSonicSensor: port-prototype=ControllerRPortUltraSonicSensor, process=controller, service-instance=RequiredSomeIpUltraSonicSensorInstance
package /apd/Machines/FusionMachine/StartupConfigSets
  startup config controller_startup: scheduling-policy=SCHEDULING-POLICY-ROUND-ROBIN, scheduling-priority=12, termination-behavior=PROCESS-IS-NOT-SELF-TERMINATING
package /apd/Machines/FusionMachine/Processes
  process controller: executable=controller, state-dependent-startup-config{function-group-state=MachineFG.Driving, resource-group=ResourceGroup1, startup-config=controller_startup}
    process state machine state_machine: type=ProcessStateMachine
