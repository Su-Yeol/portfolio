AUTOSAR XML (schema 00052)
package /apd/Machines/FusionMachine/ProcessDesigns
  process design PersistencyDemo: executable=PersistencyDemo
