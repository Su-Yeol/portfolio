AUTOSAR XML (schema 00052)
package /apd/Machines/FusionMachine/ProcessToMachineMappings
  process to machine mapping set shmMaster
    process to machine mapping shmMaster: machine=FusionMachine, process=shmMaster
package /apd/Machines/FusionMachine/Processes
  process shmMaster: executable=shmMaster, state-dependent-startup-config{function-group-state=[MachineFG.Driving, MachineFG.Parking], resource-group=ResourceGroup1, startup-config=shmMasterStartup}
    process state machine state_machine: type=ProcessStateMachine
package /apd/Machines/FusionMachine/StartupConfigSets
  startup config shmMasterStartup: environment-variables=tag-with-optional-value={key=VSOMEIP_CONFIGURATION, value=/etc/vsomeip.json}, scheduling-policy=SCHEDULING-POLICY-ROUND-ROBIN, scheduling-priority=12, termination-behavior=PROCESS-IS-NOT-SELF-TERMINATING
package /apd/Machines/FusionMachine/ServiceInstanceToPortPrototypeMappings
  service instance to port prototype mapping healthInfo_RequiredServiceInstance_toPort: port-prototype=HealthInfo_RPort, process=shmMaster, service-instance=healthInfoRequiredSomeipServiceInstance
  service instance to port prototype mapping healthIndicator_ProvidedServiceInstance_toPort: port-prototype=HealthIndicator_PPort, process=shmMaster, service-instance=healthIndicatorProvidedSomeipServiceInstance
package /apd/Machines/FusionMachine/DltMappings
  dlt application to process mapping shmMasterDltApplicationToProcessMapping: dlt-application=shmMasterLogApplication, process=shmMaster
  dlt log sink to port prototype mapping shmMasterDltLogSinkToPortPrototypeMapping: dlt-context=DefaultDltContext, dlt-log-sink=[ConsoleDltSink, shmMasterFileDltSink, RemoteDltSink], process=shmMaster
