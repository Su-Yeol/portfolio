AUTOSAR XML (schema 00052)
package /apd/Machines/FusionMachine/ProcessToMachineMappings
  process to machine mapping set vehicle_state_manager_application
    process to machine mapping vehicle_state_manager_application: machine=FusionMachine, process=vehicle_state_manager_application
package /apd/Machines/FusionMachine/DltLogChannelToProcessMappings
  dlt application to process mapping vehicle_state_manager_appDltApplicationToProcessMapping: dlt-application=VehicleStateManagerIfApplication, process=vehicle_state_manager_application
  dlt log sink to port prototype mapping vehicle_state_manager_appDltLogSinkToPortPrototypeMapping: dlt-context=DefaultDltContext, dlt-log-sink=[ConsoleDltSink, RemoteDltSink, VehicleStateManagerIfFileDltSink], process=vehicle_state_manager_application
package /apd/Machines/FusionMachine/Processes
  process vehicle_state_manager_application: executable=vehicle_state_manager_application, state-dependent-startup-config{function-group-state=MachineFG.Driving, resource-group=ResourceGroup1, startup-config=vehicle_state_manager_application}
    process state machine state_machine: type=ProcessStateMachine
package /apd/Machines/FusionMachine/ServiceInstanceToPortPrototypeMappings
  service instance to port prototype mapping RequiredVehiclePackageManagementInstanceToPortMappingVSM: port-prototype=VehicleStateManagerInterfaceRPort, process=vehicle_state_manager_application, service-instance=RequiredSomeIpVehicleStateManagerInterfaceInstance
package /apd/Machines/FusionMachine/StartupConfigSets
  startup config vehicle_state_manager_application: scheduling-policy=SCHEDULING-POLICY-ROUND-ROBIN, scheduling-priority=12, termination-behavior=PROCESS-IS-NOT-SELF-TERMINATING
