AUTOSAR XML (schema 00052)
package /apd/Machines/FusionMachine/ServiceInstanceToMachineMappings
  someip service instance to machine mapping RequiredVehicleStateManagerInterfaceInstanceToMachineMapping: communication-connector=FusionConnector, service-instance=RequiredSomeIpVehicleStateManagerInterfaceInstance, udp-port=UpdateRequestApplicationEndpoint
package /apd/Machines/FusionMachine/ServiceInstances
  required someip service instance RequiredSomeIpVehicleStateManagerInterfaceInstance: service-interface-deployment=VehicleStateManagerInterfaceSomeIp, required-minor-version=0, required-service-instance-id=ANY, sd-client-config=SomeipSdClientServiceInstanceConfig
    someip required event group VehicleConditionCollection_required_eventgroup: event-group=VehicleConditionCollection_eventgroup
