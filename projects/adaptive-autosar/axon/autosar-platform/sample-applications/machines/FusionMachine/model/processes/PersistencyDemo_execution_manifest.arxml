AUTOSAR XML (schema 00052)
package /apd/Machines/FusionMachine/PersistencyKeyValueDatabases
  persistency key value storage PersistencyKvsDemo: persistency-deployment-uri=/opt/PersistencyDemo/var/PerKvsDemo.json
package /apd/Machines/FusionMachine/PersistentPortPrototypeToKeyValueDatabaseMappings
  persistency port prototype to key value storage mapping PersistencyDemo: port-prototype=PersistencyKvsDemo_RPPort, process=PersistencyDemo, key-value-storage=PersistencyKvsDemo
package /apd/Machines/FusionMachine/ProcessToMachineMappings
  process to machine mapping set PersistencyDemo
    process to machine mapping ProcessToMachineMapping: machine=FusionMachine, process=PersistencyDemo
package /apd/Machines/FusionMachine/Processes
  process PersistencyDemo: executable=PersistencyDemo, state-dependent-startup-config{function-group-state=[MachineFG.Driving, MachineFG.Parking], resource-group=ResourceGroup2, startup-config=PersistencyDemo}
    process state machine state_machine: type=ProcessStateMachine
package /apd/Machines/FusionMachine/StartupConfigSets
  startup config PersistencyDemo: scheduling-policy=SCHEDULING-POLICY-ROUND-ROBIN, scheduling-priority=12, termination-behavior=PROCESS-IS-SELF-TERMINATING
