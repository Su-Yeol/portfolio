AUTOSAR XML (schema 00052)
package /apd/Machines/testSuiteEcu1WRSOMEIPMachine/ProcessToMachineMappings
  process to machine mapping set DIAGApp01ProcessToMachineMapping
    process to machine mapping DIAGApp01SwcInstance1TotestSuiteEcu1WRSOMEIPMachine: machine=testSuiteEcu1WRSOMEIPMachine, process=ST_DIAGApp01Instance1
package /apd/Machines/testSuiteEcu1WRSOMEIPMachine/Processes
  process ST_DIAGApp01Instance1: design=ST_DIAGApp01Instance1, executable=ST_DIAGApp01, state-dependent-startup-config{function-group-state=CMTestCase1FG.On, resource-group=ResourceGroup1, startup-config=ST_DIAGApp01Startup}
    process state machine state_machine: type=ProcessStateMachine
package /apd/Machines/testSuiteEcu1WRSOMEIPMachine/ServiceInstanceToPortPrototypeMappings
  service instance to port prototype mapping DiagDataServicePPortToCMApp01: port-prototype=DiagDataServicePport, process=ST_DIAGApp01Instance1, service-instance=ST_DIAGApp01DiagDataServiceProvidedSomeipServiceInstance
package /apd/Machines/testSuiteEcu1WRSOMEIPMachine/StartupConfigSets
  startup config ST_DIAGApp01Startup: environment-variables=[{key=VSOMEIP_CONFIGURATION, value=/opt/DIAGApp01/etc/vsomeip.json}, {key=DLT_LOG_MODE, value=3}], scheduling-policy=SCHEDULING-POLICY-ROUND-ROBIN, scheduling-priority=12
package /apd/Machines/testSuiteEcu1WRSOMEIPMachine/DltLogChannelToProcessMappings
  dlt application to process mapping ST_DIAGApp01Instance1DltApplicationToProcessMapping: dlt-application=DIAGApp01Application, process=ST_DIAGApp01Instance1
  dlt log sink to port prototype mapping ST_DIAGApp01Instance1DltLogSinkToPortPrototypeMapping: dlt-context=DefaultDltContext, dlt-log-sink=[ConsoleDltSink, RemoteDltSink, DIAGApp01FileDltSink], process=ST_DIAGApp01Instance1
