AUTOSAR XML (schema 00052)
package /apd/Machines/testSuiteEcu1WRSOMEIPMachine/PersistencyKeyValueStorages
  persistency key value storage SwPackageCurrentStatusDatabase: persistency-deployment-uri=/opt/package_manager/var/swpackage_current_status_database.json
  persistency key value storage SwPackageTransferStatusStorage: persistency-deployment-uri=/opt/package_manager/var/swpackage_transfer_status_database.json
package /apd/Machines/testSuiteEcu1WRSOMEIPMachine/PersistentPortPrototypeToKeyValueStorageMappings
  persistency port prototype to key value storage mapping SwPackageCurrentStatusToPortMapping: port-prototype=SwPackageCurrentStatusPRPort, process=package_manager, key-value-storage=SwPackageCurrentStatusDatabase
  persistency port prototype to key value storage mapping SwPackageTransferStatusStorageToPortMapping: port-prototype=SwPackageTransferStatusPRPort, process=package_manager, key-value-storage=SwPackageTransferStatusStorage
package /apd/Machines/testSuiteEcu1WRSOMEIPMachine/ProcessToMachineMappings
  process to machine mapping set package_manager
    process to machine mapping package_manager: machine=testSuiteEcu1WRSOMEIPMachine, process=package_manager
package /apd/Machines/testSuiteEcu1WRSOMEIPMachine/Processes
  process package_manager: executable=package_manager, state-dependent-startup-config{execution-dependency=state_machine.Running, function-group-state=MachineFG.Driving, resource-group=ResourceGroup1, startup-config=package_manager_startup}
    process state machine state_machine: type=ProcessStateMachine
package /apd/Machines/testSuiteEcu1WRSOMEIPMachine/ServiceInstanceToPortPrototypeMappings
  service instance to port prototype mapping PackageManagementInstanceToPortMapping: port-prototype=PackageManagementPPort, process=package_manager, service-instance=SomeIpPackageManagementInstance
  service instance to port prototype mapping RequiredUpdateRequestPortMapping: port-prototype=UpdateRequestRPort, process=package_manager, service-instance=UpdateRequest_RequiredSomeipServiceInstance
package /apd/Machines/testSuiteEcu1WRSOMEIPMachine/startup_configs
  startup config package_manager_startup: scheduling-policy=SCHEDULING-POLICY-ROUND-ROBIN, scheduling-priority=12, termination-behavior=PROCESS-IS-NOT-SELF-TERMINATING
