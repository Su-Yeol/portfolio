AUTOSAR XML (schema 00052)
package /apd/Machines/testSuiteEcu1WRSOMEIPMachine/ProcessDesigns
  4 x process design:
    STC1_EMOApp{02..05}Instance: executable=STC1_EMOApp{02..05}
