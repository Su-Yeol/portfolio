AUTOSAR XML (schema 00052)
package /apd/Machines/RadarFusionMachine/ProcessToMachineMappings
  process to machine mapping set ultrasonicsensor
    process to machine mapping ultrasonicsensor: machine=RadarFusionMachine, process=ultrasonicsensor
package /apd/Machines/RadarFusionMachine/ServiceInstanceToPortPrototypeMappings
  service instance to port prototype mapping ProvidedUltraSonicSensorToPortMapping: port-prototype=UltraSonicSensorPPort, process=ultrasonicsensor, service-instance=ProvidedSomeIpUltraSonicSensorInstance
  dlt application to process mapping UltraSonicSensorToLogChannelMapping: dlt-application=UltrasonicSensor, process=ultrasonicsensor
  dlt log sink to port prototype mapping UltrasonicSensorDltLogSinkToPortPrototypeMapping: dlt-context=DefaultDltContext, dlt-log-sink=[UltrasonicSensorFileDltSink, ConsoleDltSink, RemoteDltSink], process=ultrasonicsensor
package /apd/Machines/RadarFusionMachine/StartupConfigSets
  startup config ultrasonic_startup: scheduling-policy=SCHEDULING-POLICY-ROUND-ROBIN, scheduling-priority=12, termination-behavior=PROCESS-IS-NOT-SELF-TERMINATING
package /apd/Machines/RadarFusionMachine/Processes
  process ultrasonicsensor: executable=ultrasonicSensor
    process state machine state_machine: type=ProcessStateMachine
    state-dependent-startup-configs:
      function-group-state=UltrasonicsensorApplicationFG.Running, resource-group=ResourceGroup1, startup-config=ultrasonic_startup
      function-group-state=UltrasonicsensorApplicationFG.Verify, resource-group=ResourceGroup1, startup-config=ultrasonic_startup
