AUTOSAR XML (schema 00052)
package /apd/Machines/RadarFusionMachine/ServiceInstanceToMachineMappings
  someip service instance to machine mapping RequiredVehPackageManagementInstanceToMachineMapping: communication-connector=RadarFusionConnector, service-instance=RequiredSomeIpVehiclePackageManagementInstance
package /apd/Machines/RadarFusionMachine/ServiceInstances
  required someip service instance RequiredSomeIpVehiclePackageManagementInstance: service-interface-deployment=VehiclePackageManagementSomeIp, required-minor-version=0, required-service-instance-id=ANY, sd-client-config=SomeipSdClientServiceInstanceConfig
    someip required event group RequestedPackage_required_eventgroup: event-group=RequestedPackage_eventgroup
    someip required event group VehicleConditionCollection_required_eventgroup: event-group=VehicleConditionCollection_eventgroup
    someip required event group TransferState_required_eventgroup: event-group=TransferState_eventgroup
