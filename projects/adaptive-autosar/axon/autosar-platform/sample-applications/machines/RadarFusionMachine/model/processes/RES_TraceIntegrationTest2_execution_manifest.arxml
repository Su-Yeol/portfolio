AUTOSAR XML (schema 00052)
package /apd/Machines/RadarFusionMachine/ProcessToMachineMappings
  process to machine mapping set RES_TraceIntegrationTest2
    process to machine mapping RES_TraceIntegrationTest2: machine=RadarFusionMachine, process=RES_TraceIntegrationTest2
package /apd/Machines/RadarFusionMachine/DltLogChannelToProcessMappings
  dlt application to process mapping RES_TraceIntegrationTest2DltApplicationToProcessMapping: dlt-application=RES_TraceIntegrationTest2, process=RES_TraceIntegrationTest2
  dlt log sink to port prototype mapping RES_TraceIntegrationTest2DltLogSinkToPortPrototypeMapping: dlt-context=DefaultDltContext, dlt-log-sink=[ConsoleDltSink, RemoteDltSink, RES_TraceIntegrationTest2FileDltSink], process=RES_TraceIntegrationTest2
package /apd/Machines/RadarFusionMachine/Processes
  process RES_TraceIntegrationTest2: design=RES_TraceIntegrationTest2, executable=RES_TraceIntegrationTest2, state-dependent-startup-config{function-group-state=MachineFG.Driving, resource-group=ResourceGroup1, startup-config=RES_TraceIntegrationTest2}
    process state machine state_machine: type=ProcessStateMachine
package /apd/Machines/RadarFusionMachine/ServiceInstanceToPortPrototypeMappings
  service instance to port prototype mapping TIT_ProvidedServiceInstance_toPort: port-prototype=SensorData_ActuatorPort, process=RES_TraceIntegrationTest2, service-instance=TIT_ProvidedSomeipServiceInstance
package /apd/Machines/RadarFusionMachine/StartupConfigSets
  startup config RES_TraceIntegrationTest2: environment-variables=tag-with-optional-value={key=VSOMEIP_CONFIGURATION, value=/etc/vsomeip.json}, scheduling-policy=SCHEDULING-POLICY-ROUND-ROBIN, scheduling-priority=12, termination-behavior=PROCESS-IS-SELF-TERMINATING
