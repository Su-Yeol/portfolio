AUTOSAR XML (schema 00052)
package /apd/Machines/RadarFusionMachine/ServiceInstanceToMachineMappings
  someip service instance to machine mapping FlashingAdapterPackageManagementInstanceToMachineMapping: communication-connector=RadarFusionConnector, service-instance=FlashingAdapterSomeIpPackageManagementInstance, tcp-port=FlashingAdapterApplicationEndpoint
package /apd/Machines/RadarFusionMachine/ServiceInstances
  provided someip service instance FlashingAdapterSomeIpPackageManagementInstance: service-interface-deployment=PackageManagementSomeIp, sd-server-config=SomeipSdServerServiceInstanceConfig, service-instance-id=819
    someip provided event group CurrentStatus_provided_eventgroup: event-group=CurrentStatus_eventgroup, multicast-threshold=0
