AUTOSAR XML (schema 00052)
package /apd/Machines/RadarFusionMachine/ServiceInstanceToMachineMappings
  someip service instance to machine mapping tlv_RequiredServiceInstance_toMachine: communication-connector=RadarFusionConnector, service-instance=TlvRequiredSomeipServiceInstance, udp-port=TriggerApplicationEndpoint
package /apd/Machines/RadarFusionMachine/ServiceInstances
  required someip service instance TlvRequiredSomeipServiceInstance: service-interface-deployment=Tlv_Someip, required-minor-version=0, required-service-instance-id=ANY, sd-client-config=SomeipSdClientServiceInstanceConfig, version-driven-find-behavior=MINIMUM-MINOR-VERSION
