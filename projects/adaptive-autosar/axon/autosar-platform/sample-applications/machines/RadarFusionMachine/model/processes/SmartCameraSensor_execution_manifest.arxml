AUTOSAR XML (schema 00052)
package /apd/Machines/RadarFusionMachine/ProcessToMachineMappings
  process to machine mapping set SmartCameraSensor
    process to machine mapping SmartCameraSensor: machine=RadarFusionMachine, process=SmartCameraSensor
package /apd/Machines/RadarFusionMachine/DltLogChannelToProcessMappings
  dlt application to process mapping SmartCameraSensorDltApplicationToProcessMapping: dlt-application=SmartCameraSensorApplication, process=SmartCameraSensor
  dlt log sink to port prototype mapping SmartCameraSensorDltLogSinkToPortPrototypeMapping: dlt-context=DefaultDltContext, dlt-log-sink=[ConsoleDltSink, RemoteDltSink, SmartCameraSensorFileDltSink], process=SmartCameraSensor
package /apd/Machines/RadarFusionMachine/Processes
  process SmartCameraSensor: design=SmartCameraSensor, executable=SmartCameraSensor, state-dependent-startup-config{function-group-state=[MachineFG.Driving, MachineFG.Parking], resource-group=ResourceGroup1, startup-config=SmartCameraSensorStartup}
    process state machine state_machine: type=ProcessStateMachine
package /apd/Machines/RadarFusionMachine/ServiceInstanceToPortPrototypeMappings
  9 x service instance to port prototype mapping, all with process=SmartCameraSensor:
    SmartCameraSensor_ProvidedServiceInstance_toPort: port-prototype=SmartCameraSensor_PPort, service-instance=SmartCameraSensorProvidedSomeipServiceInstance
    SmartCameraSensor_ProvidedServiceInstance{2..9}_toPort: port-prototype=SmartCameraSensor_PPort{2..9}, service-instance=SmartCameraSensorProvidedSomeipServiceInstance{2..9}
package /apd/Machines/RadarFusionMachine/StartupConfigSets
  startup config SmartCameraSensorStartup: environment-variables=tag-with-optional-value={key=VSOMEIP_CONFIGURATION, value=/etc/vsomeip.json}, scheduling-policy=SCHEDULING-POLICY-ROUND-ROBIN, scheduling-priority=12, termination-behavior=PROCESS-IS-NOT-SELF-TERMINATING
