AUTOSAR XML (schema 00052)
package /apd/Machines/RadarFusionMachine/ProcessDesigns
  process design TimeSyncProvider: executable=TimeSyncProvider
