AUTOSAR XML (schema 00052)
package /apd/Machines/RadarFusionMachine
  process design UpdatableAppDesign: executable=UpdatableApp
