AUTOSAR XML (schema 00052)
package /apd/Machines/RadarMachine/ProcessDesigns
  process design PersistencyDemo: executable=PersistencyDemo
