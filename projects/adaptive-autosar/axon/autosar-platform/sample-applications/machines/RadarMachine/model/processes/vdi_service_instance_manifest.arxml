AUTOSAR XML (schema 00052)
package /apd/Machines/RadarMachine/ServiceInstanceToMachineMappings
  someip service instance to machine mapping RequiredVehicleDriverApplicationInstanceToMachineMapping: communication-connector=RadarConnector, service-instance=RequiredSomeIpVehicleDriverApplicationInstance
package /apd/Machines/RadarMachine/ServiceInstances
  required someip service instance RequiredSomeIpVehicleDriverApplicationInstance: service-interface-deployment=VehicleDriverApplicationInterfaceSomeIp, required-minor-version=0, required-service-instance-id=910, sd-client-config=SomeipSdClientServiceInstanceConfig
    someip required event group ApprovalRequired_required_eventgroup: event-group=ApprovalRequired_eventgroup
    someip required event group CampaignState_required_eventgroup: event-group=CampaignState_eventgroup
    someip required event group VehicleConditionCollection_required_eventgroup: event-group=VehicleConditionCollection_eventgroup
