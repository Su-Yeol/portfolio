AUTOSAR XML (schema 00052)
package /apd/Machines/RadarFusionDDSMachine/ProcessDesigns
  process design radar: executable=radar
