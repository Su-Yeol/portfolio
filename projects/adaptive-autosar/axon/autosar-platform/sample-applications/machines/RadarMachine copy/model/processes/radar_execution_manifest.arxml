AUTOSAR XML (schema 00052)
package /apd/Machines/RadarMachine/ProcessToMachineMappings
  process to machine mapping set radar
    process to machine mapping radar: machine=RadarMachine, process=radar
package /apd/Machines/RadarMachine/DltLogChannelToProcessMappings
  dlt application to process mapping radarDltApplicationToProcessMapping: dlt-application=RadarApplication, process=radar
  dlt log sink to port prototype mapping radarDltLogSinkToPortPrototypeMapping: dlt-context=DefaultDltContext, dlt-log-sink=[ConsoleDltSink, RemoteDltSink, RadarFileDltSink], process=radar
package /apd/Machines/RadarMachine/Processes
  process radar: design=radar, executable=radar, state-dependent-startup-config{function-group-state=[MachineFG.Driving, MachineFG.Parking], resource-group=ResourceGroup1, startup-config=RadarStartup}
    process state machine state_machine: type=ProcessStateMachine
package /apd/Machines/RadarMachine/ServiceInstanceToPortPrototypeMappings
  service instance to port prototype mapping radar_ProvidedServiceInstance_toPort: port-prototype=radar_PPort, process=radar, service-instance=RadarProvidedSomeipServiceInstance
package /apd/Machines/RadarMachine/StartupConfigSets
  startup config RadarStartup: environment-variables=tag-with-optional-value={key=VSOMEIP_CONFIGURATION, value=/etc/vsomeip.json}, scheduling-policy=SCHEDULING-POLICY-ROUND-ROBIN, scheduling-priority=12, termination-behavior=PROCESS-IS-NOT-SELF-TERMINATING
