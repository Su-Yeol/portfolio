AUTOSAR XML (schema 00052)
package /apd/Machines/RadarMachine/ServiceInstanceToMachineMappings
  someip service instance to machine mapping ProvidedActorInstanceToMachineMapping: communication-connector=RadarConnector, service-instance=ProvidedSomeIpActorInstance, udp-port=PicarApplicationEndpoint
package /apd/Machines/RadarMachine/ServiceInstances
  provided someip service instance ProvidedSomeIpActorInstance: service-interface-deployment=ActorServInterfaceSomeIp, sd-server-config=SomeipSdServerServiceInstanceConfig, service-instance-id=20545
