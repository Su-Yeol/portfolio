AUTOSAR XML (schema 00052)
package /apd/Machines/shmMachine/ServiceInstanceToMachineMappings
  someip service instance to machine mapping healthIndicator_RequiredServiceInstance_toMachine: communication-connector=shmClient2Connector, service-instance=healthIndicatorRequiredSomeipServiceInstance, udp-port=TriggerApplicationEndpoint
package /apd/Machines/shmMachine/ServiceInstances
  required someip service instance healthIndicatorRequiredSomeipServiceInstance: service-interface-deployment=HealthIndicator_Someip, required-minor-version=0, required-service-instance-id=120, sd-client-config=SomeipSdClientServiceInstanceConfig, version-driven-find-behavior=MINIMUM-MINOR-VERSION
    someip required event group RequiredEventgroup1: event-group=SomeipEventgroup1
