AUTOSAR XML (schema 00052)
package /apd/Machines/shmMachine/ProcessDesigns
  process design StateManager: executable=StateManager
