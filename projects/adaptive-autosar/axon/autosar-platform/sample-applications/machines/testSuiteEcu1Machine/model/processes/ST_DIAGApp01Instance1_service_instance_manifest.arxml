AUTOSAR XML (schema 00052)
package /apd/Machines/testSuiteEcu1Machine/ServiceInstanceToMachineMappings
  someip service instance to machine mapping DIAGApp01DiagDataServiceProvidedServiceInstanceToEcu1Machine: communication-connector=CommunicationConnector1, service-instance=ST_DIAGApp01DiagDataServiceProvidedSomeipServiceInstance, udp-port=ST_DIAGApp01DiagDataServiceApplicationEndpoint
package /apd/Machines/testSuiteEcu1Machine/ServiceInstances
  provided someip service instance ST_DIAGApp01DiagDataServiceProvidedSomeipServiceInstance: service-interface-deployment=DataIdentifier_Someip, sd-server-config=SomeipSdServerServiceInstanceConfig, service-instance-id=1811
