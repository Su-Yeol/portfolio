AUTOSAR XML (schema 00052)
package /apd/Machines/RadarFusionWRSOMEIPMachine/ProcessToMachineMappings
  process to machine mapping set RES_TraceIntegrationTest
    process to machine mapping RES_TraceIntegrationTest: machine=RadarFusionWRSOMEIPMachine, process=RES_TraceIntegrationTest
package /apd/Machines/RadarFusionWRSOMEIPMachine/DltLogChannelToProcessMappings
  dlt application to process mapping RES_TraceIntegrationTestDltApplicationToProcessMapping: dlt-application=RES_TraceIntegrationTest, process=RES_TraceIntegrationTest
  dlt log sink to port prototype mapping RES_TraceIntegrationTestDltLogSinkToPortPrototypeMapping: dlt-context=DefaultDltContext, dlt-log-sink=[ConsoleDltSink, RemoteDltSink, RES_TraceIntegrationTestFileDltSink], process=RES_TraceIntegrationTest
package /apd/Machines/RadarFusionWRSOMEIPMachine/Processes
  process RES_TraceIntegrationTest: design=RES_TraceIntegrationTest, executable=RES_TraceIntegrationTest, state-dependent-startup-config{function-group-state=[MachineFG.Driving, MachineFG.Parking], resource-group=ResourceGroup1, startup-config=RES_TraceIntegrationTest}
    process state machine state_machine: type=ProcessStateMachine
package /apd/Machines/RadarFusionWRSOMEIPMachine/ServiceInstanceToPortPrototypeMappings
  service instance to port prototype mapping TIT_RequiredServiceInstance_toPort: port-prototype=TitServicePort, process=RES_TraceIntegrationTest, service-instance=TIT_RequiredSomeipServiceInstance
package /apd/Machines/RadarFusionWRSOMEIPMachine/StartupConfigSets
  startup config RES_TraceIntegrationTest: environment-variables=tag-with-optional-value={key=WRSOMEIP_CONFIG_PATH, value=/etc/wrsomeip.json}, scheduling-policy=SCHEDULING-POLICY-ROUND-ROBIN, scheduling-priority=12, termination-behavior=PROCESS-IS-NOT-SELF-TERMINATING
