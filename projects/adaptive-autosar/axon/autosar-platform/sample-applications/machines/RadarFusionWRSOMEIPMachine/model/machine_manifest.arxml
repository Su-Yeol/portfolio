AUTOSAR XML (schema 00052)
package /apd/Machines/RadarFusionWRSOMEIPMachine
  machine RadarFusionWRSOMEIPMachine: default-application-timeout=exit-timeout-value=0.1, environment-variables=tag-with-optional-value={key=DLT_LOG_MODE, value=3}, machine-design=RadarFusionWRSOMEIPMachineDesign
    module-instantiations:
      log and trace instantiation LogAndTraceInstanciation: dlt-ecu=RadarFusionWRSOMEIPMachineDltEcu, log-sink=ConsoleDltSink
      os module instantiation Linux
        6 x resource group:
          ResourceGroup1: cpu-usage=95, mem-usage=2000000000
          ResourceGroup2: cpu-usage=95, mem-usage=2000000000
          ResourceGroupDB: cpu-usage=80, mem-usage=500000000
          ResourceGroupDIAG: cpu-usage=80, mem-usage=500000000
          ResourceGroupIAM: cpu-usage=80, mem-usage=500000000
          ResourceGroupSM: cpu-usage=80, mem-usage=500000000
      ucm subordinate module instantiation UcmInstance: identifier=RadarFusionWRSOMEIPMachineUCM
    processor DefaultProcessor
      processor core ProcessorCore0: core-id=0
      processor core ProcessorCore1: core-id=1
package /apd/Machines/RadarFusionWRSOMEIPMachine/E2E
  e 2 e profile configuration set e2eprofiles
    e 2 e profile configuration PROFILE_01: max-delta-counter=1, max-error-state-init=0, max-error-state-invalid=0, max-error-state-valid=0, min-ok-state-init=1, min-ok-state-invalid=1, min-ok-state-valid=1, profile-name=PROFILE_01, window-size-init=1, window-size-invalid=1, window-size-valid=1
package /apd/Machines/RadarFusionWRSOMEIPMachine/FunctionGroupSets
  function group set RadarFusionWRSOMEIPFunctionGroups
    function-groups:
      5 x mode declaration group prototype:
        MachineFG: type=MachineState
        Sensor: type=Sensor
        Lane_Change_Assistance: type=Lane_Change_Assistance
        Pedestrian_Protection: type=Pedestrian_Protection
        UpdatableApplicationFG: type=UpdatableApplicationFG
package /apd/Machines/RadarFusionWRSOMEIPMachine/SoftwareClusters
  software cluster RadarFusionCoreCluster:
    category=PLATFORM_CORE
    claimed-function-group=[MachineFG, Lane_Change_Assistance, Pedestrian_Protection, RadarFusionWRSOMEIPFunctionGroups/UpdatableApplicationFG, DevelopmentFunctionGroups/UpdatableApplicationFG]
    contained-process=[access_manager, CMValidatorPublisher, CMValidatorSubscriber, DemonstratorTutorial, EmoIntegrationTest, EmoSampleApplication, ExtendedTutorial, FaultyCalibrationApplication, FaultyProbingApplication, flashing_adapter, package_manager, fusion, PersistencyDemo, PersistencyRedundancyDemo, PhmDemo, pkgmgr_sample, radar, RES_TimingRefApp, RES_TimingRefServiceApp, RES_TraceIntegrationTest, RES_TraceIntegrationTest2, SecDemoFc, SecIamTestApp, SensorDemoApplication, smtool, StateManager, TimeSyncConsumer, TimeSyncProvider, update_adapter_agl, update_adapter_android]
    module-instantiation=Linux
package /apd/Machines/RadarFusionWRSOMEIPMachine/dlt
  dlt ecu RadarFusionWRSOMEIPMachineDltEcu
    27 x dlt application, all with contexts=DefaultDltContext:
      CMValidatorPublisherApplication: application-description=CM Validator Publisher Application, application-id=CMVP
      CMValidatorSubscriberApplication: application-description=CM Validator Subscriber Application, application-id=CMVS
      FusionApplication: application-description=example app. fusion, application-id=EXFU
      RadarApplication: application-description=example app. radar, application-id=EXRA
      StateManagerApplication: application-description=State Manager, application-id=STMR
      FaultyCalibrationApplication: application-description=Faulty Calibration Application, application-id=FCAP
      FaultyProbingApplication: application-description=Faulty Probing Application, application-id=FPAP
      SecDemoFcApplication: application-description=Sec Demo Fc Application, application-id=SDFC
      SecIamTestAppApplication: application-description=Sec Iam Test Application, application-id=SIT
      SensorDemoApplication: application-description=Sensor Demo Application, application-id=SDAP
      DemonstratorTutorialApplication: application-description=Demonstrator Tutorial Application, application-id=TTRL
      TimeSyncProviderApplication: application-description=Time Sync Provider Application, application-id=TSYP
      TimeSyncConsumerApplication: application-description=Time Sync Consumer Application, application-id=TSYC
      EmoIntegrationTestApplication: application-description=EMO Integration Test, application-id=EMIT
      EmoSampleApplicationLogChannel: application-description=Emo Sample Application, application-id=EMAP
      RES_TimingRefApp: application-description=Time Reference Application, application-id=RTRA
      RES_TimingRefServiceApp: application-description=Time Reference Application Service Provider, application-id=RTRS
      RES_TraceIntegrationTest: application-description=Trace Integration Test, application-id=RTIT
      RES_TraceIntegrationTest2: application-description=Trace Integration Test2, application-id=RTI2
      ExtendedTutorialApplication: application-description=Extended Tutorial Application, application-id=ETRL
      PhmDemoApplication: application-description=PhmDemo Application, application-id=PHMD
      UpdateAdapterAglApplication: application-description=Update Adapter for non-AUTOSAR platform, application-id=UAGL
      UpdateAdapterAndroidApplication: application-description=Update Adapter for non-AUTOSAR platform, application-id=UAND
      FlashingAdapterApplication: application-description=Flashing Adapter, application-id=FLAD
      PkgmgrApplication: application-description=UCM SAMPLE, application-id=UCMS
      PackageManager: application-description=UCM, application-id=UCM
      VehiclePackageManager: application-description=UCM Master, application-id=UCMM
  dlt log sink ConsoleDltSink: category=DLT_LOGSINK_CONSOLE, buffer-output=true, default-log-threshold=VERBOSE
package /ara/apd/function_group_modes
  mode declaration group UpdatableApplicationFG: initial-mode=Off
    mode Off
    mode Running
    mode Verify
package /ara/apd/function_group_sets
  function group set DevelopmentFunctionGroups
    function-groups:
      mode declaration group prototype UpdatableApplicationFG: type=UpdatableApplicationFG
