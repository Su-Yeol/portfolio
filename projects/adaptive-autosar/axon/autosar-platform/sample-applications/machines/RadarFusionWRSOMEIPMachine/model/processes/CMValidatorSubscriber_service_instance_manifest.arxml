AUTOSAR XML (schema 00052)
package /apd/Machines/RadarFusionWRSOMEIPMachine/ServiceInstanceToMachineMappings
  someip service instance to machine mapping CMValidatorSubscriber_RequiredServiceInstance_toMachine: communication-connector=RadarFusionWRSOMEIPConnector, service-instance=CMValidatorSubscriberRequiredSomeipServiceInstance, udp-port=TriggerApplicationEndpoint
package /apd/Machines/RadarFusionWRSOMEIPMachine/ServiceInstances
  required someip service instance CMValidatorSubscriberRequiredSomeipServiceInstance: service-interface-deployment=CMValidatorPublisher_Someip, required-minor-version=0, required-service-instance-id=88, sd-client-config=SomeipSdClientServiceInstanceConfig, version-driven-find-behavior=MINIMUM-MINOR-VERSION
    e-2-e-event-protection-propss:
      end 2 end event protection props End2EndEventProtectionProps: data-ids=4321, e-2-e-profile-configuration=PROFILE_01, event=Event1_Someip, max-data-length=4096, min-data-length=1
      end 2 end event protection props End2EndEventProtectionProps: data-ids=[4321, 4321], e-2-e-profile-configuration=PROFILE_01, event=Event2_Someip, max-data-length=4096, min-data-length=1
    someip required event group RequiredEventgroup1: event-group=SomeipEventgroup1
    someip required event group RequiredEventgroup2: event-group=SomeipEventgroup2
