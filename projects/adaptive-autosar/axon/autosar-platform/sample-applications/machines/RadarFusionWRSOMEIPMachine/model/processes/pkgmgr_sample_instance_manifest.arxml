AUTOSAR XML (schema 00052)
package /apd/Machines/RadarFusionWRSOMEIPMachine/ServiceInstanceToMachineMappings
  someip service instance to machine mapping RequiredPackageManagementInstanceToMachineMapping: communication-connector=RadarFusionWRSOMEIPConnector, service-instance=RequiredSomeIpPackageManagementInstance, udp-port=UpdateRequestApplicationEndpoint
package /apd/Machines/RadarFusionWRSOMEIPMachine/ServiceInstances
  required someip service instance RequiredSomeIpPackageManagementInstance: service-interface-deployment=PackageManagementSomeIp, required-minor-version=0, required-service-instance-id=812, sd-client-config=SomeipSdClientServiceInstanceConfig
    someip required event group CurrentStatus_required_eventgroup: event-group=CurrentStatus_eventgroup
