AUTOSAR XML (schema 00052)
package /apd/Machines/RadarFusionWRSOMEIPMachine/ServiceInstanceToMachineMappings
  someip service instance to machine mapping radar_ProvidedServiceInstance_toMachine: communication-connector=RadarFusionWRSOMEIPConnector, service-instance=RadarProvidedSomeipServiceInstance, udp-port=TriggerApplicationEndpoint
package /apd/Machines/RadarFusionWRSOMEIPMachine/ServiceInstances
  provided someip service instance RadarProvidedSomeipServiceInstance: service-interface-deployment=Radar_Someip, sd-server-config=SomeipSdServerServiceInstanceConfig, service-instance-id=19
    e-2-e-event-protection-propss:
      end 2 end event protection props End2EndEventProtectionProps: data-ids=4321, e-2-e-profile-configuration=PROFILE_01, event=Brake_Someip, max-data-length=4096, min-data-length=1
      end 2 end event protection props End2EndEventProtectionProps: data-ids=[4321, 4321], e-2-e-profile-configuration=PROFILE_01, event=ParkingBrake_Someip, max-data-length=4096, min-data-length=1
    someip provided event group RequiredEventgroup1: event-group=SomeipEventgroup1, multicast-threshold=0
    someip provided event group RequiredEventgroup2: event-group=SomeipEventgroup2, multicast-threshold=0
