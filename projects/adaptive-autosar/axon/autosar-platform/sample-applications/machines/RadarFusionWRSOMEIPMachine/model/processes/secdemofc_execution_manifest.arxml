AUTOSAR XML (schema 00052)
package /apd/Machines/RadarFusionWRSOMEIPMachine/Processes
  process SecDemoFc: executable=SecDemoFc
    process state machine state_machine: type=ProcessStateMachine
    state-dependent-startup-configs:
      execution-dependency=state_machine.Running, function-group-state=MachineFG.Driving, resource-group=ResourceGroup1, startup-config=SecDemoFc
      execution-dependency=state_machine.Running, function-group-state=MachineFG.Parking, resource-group=ResourceGroup1, startup-config=SecDemoFc
package /apd/Machines/RadarFusionWRSOMEIPMachine/ProcessToMachineMappings
  process to machine mapping set SecDemoFc
    process to machine mapping SecDemoFc: machine=RadarFusionWRSOMEIPMachine, process=SecDemoFc
package /apd/Machines/RadarFusionWRSOMEIPMachine/DltLogChannelToProcessMappings
  dlt application to process mapping SecDemoFcDltApplicationToProcessMapping: dlt-application=SecDemoFcApplication, process=SecDemoFc
  dlt log sink to port prototype mapping SecDemoFcDltLogSinkToPortPrototypeMapping: dlt-context=DefaultDltContext, dlt-log-sink=[ConsoleDltSink, RemoteDltSink, SecDemoFcFileDltSink], process=SecDemoFc
package /apd/Machines/RadarFusionWRSOMEIPMachine/StartupConfigSets
  startup config SecDemoFc: environment-variables=tag-with-optional-value={key=DLT_LOG_MODE, value=3}, scheduling-policy=SCHEDULING-POLICY-ROUND-ROBIN, scheduling-priority=12
