AUTOSAR XML (schema 00052)
package /apd/Machines/RadarFusionWRSOMEIPMachine/ProcessToMachineMappings
  process to machine mapping set CMValidatorSubscriber
    process to machine mapping CMValidatorSubscriber: machine=RadarFusionWRSOMEIPMachine, process=CMValidatorSubscriber
package /apd/Machines/RadarFusionWRSOMEIPMachine/Dlt
  dlt application to process mapping CMValidatorSubscriberDltApplicationToProcessMapping: dlt-application=CMValidatorSubscriberApplication, process=CMValidatorSubscriber
  dlt log sink to port prototype mapping CMValidatorSubscriberDltLogSinkToPortPrototypeMapping: dlt-context=DefaultDltContext, dlt-log-sink=[ConsoleDltSink, RemoteDltSink, CMValidatorSubscriberFileDltSink], process=CMValidatorSubscriber
package /apd/Machines/RadarFusionWRSOMEIPMachine/Processes
  process CMValidatorSubscriber: executable=CMValidatorSubscriber, state-dependent-startup-config{function-group-state=[MachineFG.Driving, MachineFG.Parking], resource-group=ResourceGroup1, startup-config=CMValidatorSubscriber}
    process state machine state_machine: type=ProcessStateMachine
package /apd/Machines/RadarFusionWRSOMEIPMachine/ServiceInstanceToPortPrototypeMappings
  service instance to port prototype mapping CMValidatorSubscriber_RequiredServiceInstance_toPort: port-prototype=CMValidatorSubscriber_RPort, process=CMValidatorSubscriber, service-instance=CMValidatorSubscriberRequiredSomeipServiceInstance
package /apd/Machines/RadarFusionWRSOMEIPMachine/StartupConfigSets
  startup config CMValidatorSubscriber: environment-variables=tag-with-optional-value={key=WRSOMEIP_CONFIG_PATH, value=/etc/wrsomeip.json}, scheduling-policy=SCHEDULING-POLICY-ROUND-ROBIN, scheduling-priority=12, termination-behavior=PROCESS-IS-NOT-SELF-TERMINATING
