AUTOSAR XML (schema 00052)
package /katech/AdaptiveApplicationSwComponentTypes
  adaptive application sw component type TimeSyncProvider
package /katech/Executables
  executable TimeSyncProvider: category=APPLICATION_LEVEL, minimum-timer-granularity=1000
    root sw component prototype TimeSyncProviderRoot: application-type=TimeSyncProvider
