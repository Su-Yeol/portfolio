AUTOSAR XML (schema 00052)
package /katech/Machines/AdaptiveMachine/ProcessToMachineMappings
  process to machine mapping set Perception_Lidar
    process to machine mapping Perception_Lidar: machine=AdaptiveMachine, process=Perception_Lidar
package /katech/Machines/AdaptiveMachine/DltLogChannelToProcessMappings
  dlt application to process mapping PerceptionLidarDltApplicationToProcessMapping: dlt-application=Perception_Lidar, process=Perception_Lidar
  dlt log sink to port prototype mapping PerceptionLidarDltLogSinkToPortPrototypeMapping: dlt-context=DefaultDltContext, dlt-log-sink=[ConsoleDltSink, RemoteDltSink, PerceptionLidarFileDltSink], process=Perception_Lidar
package /katech/Machines/AdaptiveMachine/Processes
  process Perception_Lidar: executable=Perception_Lidar, state-dependent-startup-config{function-group-state=MachineFG.Driving, resource-group=ResourceGroupKATECH, startup-config=Perception_Lidar}
    process state machine state_machine: type=ProcessStateMachine
package /katech/Machines/AdaptiveMachine/ServiceInstanceToPortPrototypeMappings
  4 x service instance to port prototype mapping, all with process=Perception_Lidar:
    ProvidedServiceInstance_toPort_perception_lidar_collect_fault_perception_lidar: port-prototype=PPort_collect_fault_perception_lidar, service-instance=ProvidedSomeipServiceInstance_collect_fault_perception_lidar
    ProvidedServiceInstance_toPort_perception_lidar_emergency_braking: port-prototype=PPort_emergency_braking, service-instance=ProvidedSomeipServiceInstance_emergency_braking
    ProvidedServiceInstance_toPort_perception_lidar_perception_obstacles: port-prototype=PPort_perception_obstacles, service-instance=ProvidedSomeipServiceInstance_perception_obstacles
    RequiredServiceInstance_toPort_perception_lidar_v2x_data: port-prototype=RPort_v2x_data, service-instance=RequiredSomeipServiceInstance_v2x_data
package /katech/Machines/AdaptiveMachine/StartupConfigSets
  startup config Perception_Lidar: environment-variables=tag-with-optional-value={key=VSOMEIP_CONFIGURATION, value=/etc/vsomeip.json}, scheduling-policy=SCHEDULING-POLICY-ROUND-ROBIN, scheduling-priority=12, termination-behavior=PROCESS-IS-NOT-SELF-TERMINATING
