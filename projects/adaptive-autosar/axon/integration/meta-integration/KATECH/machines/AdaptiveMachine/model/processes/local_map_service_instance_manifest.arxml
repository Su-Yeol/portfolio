AUTOSAR XML (schema 00052)
package /katech/Machines/AdaptiveMachine/ServiceInstanceToMachineMappings
  someip service instance to machine mapping ProvidedServiceInstance_toMachine_local_map: communication-connector=AdaptiveMachineConnector, service-instance=ProvidedSomeipServiceInstance_local_map, udp-port=LocalMapProviderEndpoint
  someip service instance to machine mapping RequiredServiceInstance_toMachine_local_map: communication-connector=AdaptiveMachineConnector, service-instance=RequiredSomeipServiceInstance_local_map, udp-port=LocalMapSubscriberEndpoint
package /katech/Machines/AdaptiveMachine/ServiceInstances
  provided someip service instance ProvidedSomeipServiceInstance_local_map: service-interface-deployment=someip_local_map, sd-server-config=SomeipSdServerServiceInstanceConfig, service-instance-id=801
    someip provided event group ProvidedEventgroup1: event-group=SomeipEventgroup1, multicast-threshold=0
    someip provided event group ProvidedEventgroup2: event-group=SomeipEventgroup2, multicast-threshold=0
  required someip service instance RequiredSomeipServiceInstance_local_map: service-interface-deployment=someip_local_map, required-minor-version=0, required-service-instance-id=801, sd-client-config=SomeipSdClientServiceInstanceConfig, version-driven-find-behavior=MINIMUM-MINOR-VERSION
    someip required event group RequiredEventgroup1: event-group=SomeipEventgroup1
    someip required event group RequiredEventgroup2: event-group=SomeipEventgroup2
