AUTOSAR XML (schema 00052)
package /katech/Machines/AdaptiveMachine/ServiceInstanceToMachineMappings
  someip service instance to machine mapping ProvidedServiceInstance_toMachine_routing_result: communication-connector=AdaptiveMachineConnector, service-instance=ProvidedSomeipServiceInstance_routing_result, udp-port=RoutingResultProviderEndpoint
  someip service instance to machine mapping RequiredServiceInstance_toMachine_routing_result: communication-connector=AdaptiveMachineConnector, service-instance=RequiredSomeipServiceInstance_routing_result, udp-port=RoutingResultSubscriberEndpoint
package /katech/Machines/AdaptiveMachine/ServiceInstances
  provided someip service instance ProvidedSomeipServiceInstance_routing_result: service-interface-deployment=someip_routing_result, sd-server-config=SomeipSdServerServiceInstanceConfig, service-instance-id=1401
    someip provided event group ProvidedEventgroup1: event-group=SomeipEventgroup1, multicast-threshold=0
  required someip service instance RequiredSomeipServiceInstance_routing_result: service-interface-deployment=someip_routing_result, required-minor-version=0, required-service-instance-id=1401, sd-client-config=SomeipSdClientServiceInstanceConfig
    someip required event group RequiredEventgroup1: event-group=SomeipEventgroup1
