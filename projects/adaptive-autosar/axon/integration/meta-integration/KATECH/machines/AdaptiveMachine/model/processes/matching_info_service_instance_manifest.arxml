AUTOSAR XML (schema 00052)
package /katech/Machines/AdaptiveMachine/ServiceInstanceToMachineMappings
  someip service instance to machine mapping ProvidedServiceInstance_toMachine_matching_info: communication-connector=AdaptiveMachineConnector, service-instance=ProvidedSomeipServiceInstance_matching_info, udp-port=MatchingInfoProviderEndpoint
  someip service instance to machine mapping RequiredServiceInstance_toMachine_matching_info: communication-connector=AdaptiveMachineConnector, service-instance=RequiredSomeipServiceInstance_matching_info, udp-port=MatchingInfoSubscriberEndpoint
package /katech/Machines/AdaptiveMachine/ServiceInstances
  provided someip service instance ProvidedSomeipServiceInstance_matching_info: service-interface-deployment=someip_matching_info, sd-server-config=SomeipSdServerServiceInstanceConfig, service-instance-id=901
    someip provided event group ProvidedEventgroup1: event-group=SomeipEventgroup1, multicast-threshold=0
  required someip service instance RequiredSomeipServiceInstance_matching_info: service-interface-deployment=someip_matching_info, required-minor-version=0, required-service-instance-id=901, sd-client-config=SomeipSdClientServiceInstanceConfig, version-driven-find-behavior=MINIMUM-MINOR-VERSION
    someip required event group RequiredEventgroup1: event-group=SomeipEventgroup1
