AUTOSAR XML (schema 00052)
package /katech/Machines/AdaptiveMachine/ProcessToMachineMappings
  process to machine mapping set Perception_Camera
    process to machine mapping Perception_Camera: machine=AdaptiveMachine, process=Perception_Camera
package /katech/Machines/AdaptiveMachine/DltLogChannelToProcessMappings
  dlt application to process mapping PerceptionCameraDltApplicationToProcessMapping: dlt-application=Perception_Camera, process=Perception_Camera
  dlt log sink to port prototype mapping PerceptionCameraDltLogSinkToPortPrototypeMapping: dlt-context=DefaultDltContext, dlt-log-sink=[ConsoleDltSink, RemoteDltSink, PerceptionCameraFileDltSink], process=Perception_Camera
package /katech/Machines/AdaptiveMachine/Processes
  process Perception_Camera: executable=Perception_Camera, state-dependent-startup-config{function-group-state=MachineFG.Driving, resource-group=ResourceGroupKATECH, startup-config=Perception_Camera}
    process state machine state_machine: type=ProcessStateMachine
package /katech/Machines/AdaptiveMachine/ServiceInstanceToPortPrototypeMappings
  4 x service instance to port prototype mapping, all with process=Perception_Camera:
    ProvidedServiceInstance_toPort_perception_camera_collect_fault_perception_camera: port-prototype=PPort_collect_fault_perception_camera, service-instance=ProvidedSomeipServiceInstance_collect_fault_perception_camera
    ProvidedServiceInstance_toPort_perception_camera_lane_detection: port-prototype=PPort_lane_detection, service-instance=ProvidedSomeipServiceInstance_lane_detection
    ProvidedServiceInstance_toPort_perception_camera_traffic_light: port-prototype=PPort_traffic_light, service-instance=ProvidedSomeipServiceInstance_traffic_light
    RequiredServiceInstance_toPort_perception_camera_v2x_data: port-prototype=RPort_v2x_data, service-instance=RequiredSomeipServiceInstance_v2x_data
package /katech/Machines/AdaptiveMachine/StartupConfigSets
  startup config Perception_Camera: environment-variables=tag-with-optional-value={key=VSOMEIP_CONFIGURATION, value=/etc/vsomeip.json}, scheduling-policy=SCHEDULING-POLICY-ROUND-ROBIN, scheduling-priority=12, termination-behavior=PROCESS-IS-NOT-SELF-TERMINATING
