AUTOSAR XML (schema 00052)
package /katech/Machines/AdaptiveMachine/ServiceInstanceToMachineMappings
  someip service instance to machine mapping ProvidedServiceInstance_toMachine_can_data: communication-connector=AdaptiveMachineConnector, service-instance=ProvidedSomeipServiceInstance_can_data, udp-port=CanDataProviderEndpoint
  someip service instance to machine mapping RequiredServiceInstance_toMachine_can_data: communication-connector=AdaptiveMachineConnector, service-instance=RequiredSomeipServiceInstance_can_data, udp-port=CanDataSubscriberEndpoint
package /katech/Machines/AdaptiveMachine/ServiceInstances
  provided someip service instance ProvidedSomeipServiceInstance_can_data: service-interface-deployment=someip_can_data, sd-server-config=SomeipSdServerServiceInstanceConfig, service-instance-id=101
    someip provided event group ProvidedEventgroup1: event-group=SomeipEventgroup1, multicast-threshold=0
  required someip service instance RequiredSomeipServiceInstance_can_data: service-interface-deployment=someip_can_data, required-minor-version=0, required-service-instance-id=101, sd-client-config=SomeipSdClientServiceInstanceConfig, version-driven-find-behavior=MINIMUM-MINOR-VERSION
    someip required event group RequiredEventgroup1: event-group=SomeipEventgroup1
