AUTOSAR XML (schema 00052)
package /katech/Machines/AdaptiveMachine/ServiceInstanceToMachineMappings
  someip service instance to machine mapping ProvidedServiceInstance_toMachine_traffic_light: communication-connector=AdaptiveMachineConnector, service-instance=ProvidedSomeipServiceInstance_traffic_light, udp-port=TrafficLightProviderEndpoint
  someip service instance to machine mapping RequiredServiceInstance_toMachine_traffic_light: communication-connector=AdaptiveMachineConnector, service-instance=RequiredSomeipServiceInstance_traffic_light, udp-port=TrafficLightSubscriberEndpoint
package /katech/Machines/AdaptiveMachine/ServiceInstances
  provided someip service instance ProvidedSomeipServiceInstance_traffic_light: service-interface-deployment=someip_traffic_light, sd-server-config=SomeipSdServerServiceInstanceConfig, service-instance-id=1701
    someip provided event group ProvidedEventgroup1: event-group=SomeipEventgroup1, multicast-threshold=0
  required someip service instance RequiredSomeipServiceInstance_traffic_light: service-interface-deployment=someip_traffic_light, required-minor-version=0, required-service-instance-id=1701, sd-client-config=SomeipSdClientServiceInstanceConfig, version-driven-find-behavior=MINIMUM-MINOR-VERSION
    someip required event group RequiredEventgroup1: event-group=SomeipEventgroup1
