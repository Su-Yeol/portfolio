AUTOSAR XML (schema 00052)
package /katech/Machines/AdaptiveMachine/ProcessToMachineMappings
  process to machine mapping set Localization
    process to machine mapping Localization: machine=AdaptiveMachine, process=Localization
package /katech/Machines/AdaptiveMachine/DltLogChannelToProcessMappings
  dlt application to process mapping LocalizationDltApplicationToProcessMapping: dlt-application=Localization, process=Localization
  dlt log sink to port prototype mapping LocalizationDltLogSinkToPortPrototypeMapping: dlt-context=DefaultDltContext, dlt-log-sink=[ConsoleDltSink, RemoteDltSink, LocalizationFileDltSink], process=Localization
package /katech/Machines/AdaptiveMachine/Processes
  process Localization: executable=Localization, state-dependent-startup-config{execution-dependencys=[state_machine.Running, state_machine.Running], function-group-state=MachineFG.Driving, resource-group=ResourceGroupKATECH, startup-config=Localization}
    process state machine state_machine: type=ProcessStateMachine
package /katech/Machines/AdaptiveMachine/ServiceInstanceToPortPrototypeMappings
  13 x service instance to port prototype mapping, all with process=Localization:
    ProvidedServiceInstance_toPort_localization_collect_fault_localization: port-prototype=PPort_collect_fault_localization, service-instance=ProvidedSomeipServiceInstance_collect_fault_localization
    ProvidedServiceInstance_toPort_localization_matching_info: port-prototype=PPort_matching_info, service-instance=ProvidedSomeipServiceInstance_matching_info
    ProvidedServiceInstance_toPort_localization_vehicle_location: port-prototype=PPort_vehicle_location, service-instance=ProvidedSomeipServiceInstance_vehicle_location
    RequiredServiceInstance_toPort_localization_can_data: port-prototype=RPort_can_data, service-instance=RequiredSomeipServiceInstance_can_data
    RequiredServiceInstance_toPort_localization_can_data_etc: port-prototype=RPort_can_data_etc, service-instance=RequiredSomeipServiceInstance_can_data_etc
    RequiredServiceInstance_toPort_localization_lane_detection: port-prototype=RPort_lane_detection, service-instance=RequiredSomeipServiceInstance_lane_detection
    RequiredServiceInstance_toPort_localization_local_map: port-prototype=RPort_local_map, service-instance=RequiredSomeipServiceInstance_local_map
    RequiredServiceInstance_toPort_localization_perception_obstacles: port-prototype=RPort_perception_obstacles, service-instance=RequiredSomeipServiceInstance_perception_obstacles
    RequiredServiceInstance_toPort_localization_point_map: port-prototype=RPort_point_map, service-instance=RequiredSomeipServiceInstance_point_map
    RequiredServiceInstance_toPort_localization_routing_result: port-prototype=RPort_routing_result, service-instance=RequiredSomeipServiceInstance_routing_result
    RequiredServiceInstance_toPort_localization_routing_search: port-prototype=RPort_routing_search, service-instance=RequiredSomeipServiceInstance_routing_search
    RequiredServiceInstance_toPort_localization_traffic_light: port-prototype=RPort_traffic_light, service-instance=RequiredSomeipServiceInstance_traffic_light
    RequiredServiceInstance_toPort_localization_v2x_data: port-prototype=RPort_v2x_data, service-instance=RequiredSomeipServiceInstance_v2x_data
package /katech/Machines/AdaptiveMachine/StartupConfigSets
  startup config Localization: environment-variables=tag-with-optional-value={key=VSOMEIP_CONFIGURATION, value=/etc/vsomeip.json}, scheduling-policy=SCHEDULING-POLICY-ROUND-ROBIN, scheduling-priority=12, termination-behavior=PROCESS-IS-NOT-SELF-TERMINATING
