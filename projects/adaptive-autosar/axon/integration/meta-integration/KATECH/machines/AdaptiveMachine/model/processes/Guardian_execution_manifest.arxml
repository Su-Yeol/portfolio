AUTOSAR XML (schema 00052)
package /katech/Machines/AdaptiveMachine/ProcessToMachineMappings
  process to machine mapping set Guardian
    process to machine mapping Guardian: machine=AdaptiveMachine, process=Guardian
package /katech/Machines/AdaptiveMachine/DltLogChannelToProcessMappings
  dlt application to process mapping GuardianDltApplicationToProcessMapping: dlt-application=Guardian, process=Guardian
  dlt log sink to port prototype mapping GuardianDltLogSinkToPortPrototypeMapping: dlt-context=DefaultDltContext, dlt-log-sink=[ConsoleDltSink, RemoteDltSink, GuardianFileDltSink], process=Guardian
package /katech/Machines/AdaptiveMachine/Processes
  process Guardian: executable=Guardian, state-dependent-startup-config{function-group-state=MachineFG.Driving, resource-group=ResourceGroupKATECH, startup-config=Guardian}
    process state machine state_machine: type=ProcessStateMachine
package /katech/Machines/AdaptiveMachine/ServiceInstanceToPortPrototypeMappings
  10 x service instance to port prototype mapping, all with process=Guardian:
    ProvidedServiceInstance_toPort_guardian_report_fault: port-prototype=PPort_report_fault, service-instance=ProvidedSomeipServiceInstance_report_fault
    RequiredServiceInstance_toPort_guardian_collect_fault_control: port-prototype=RPort_collect_fault_control, service-instance=RequiredSomeipServiceInstance_collect_fault_control
    RequiredServiceInstance_toPort_guardian_collect_fault_hdmap: port-prototype=RPort_collect_fault_hdmap, service-instance=RequiredSomeipServiceInstance_collect_fault_hdmap
    RequiredServiceInstance_toPort_guardian_collect_fault_hmi: port-prototype=RPort_collect_fault_hmi, service-instance=RequiredSomeipServiceInstance_collect_fault_hmi
    RequiredServiceInstance_toPort_guardian_collect_fault_localization: port-prototype=RPort_collect_fault_localization, service-instance=RequiredSomeipServiceInstance_collect_fault_localization
    RequiredServiceInstance_toPort_guardian_collect_fault_perception_camera: port-prototype=RPort_collect_fault_perception_camera, service-instance=RequiredSomeipServiceInstance_collect_fault_perception_camera
    RequiredServiceInstance_toPort_guardian_collect_fault_perception_lidar: port-prototype=RPort_collect_fault_perception_lidar, service-instance=RequiredSomeipServiceInstance_collect_fault_perception_lidar
    RequiredServiceInstance_toPort_guardian_collect_fault_planning: port-prototype=RPort_collect_fault_planning, service-instance=RequiredSomeipServiceInstance_collect_fault_planning
    RequiredServiceInstance_toPort_guardian_collect_fault_routing: port-prototype=RPort_collect_fault_routing, service-instance=RequiredSomeipServiceInstance_collect_fault_routing
    RequiredServiceInstance_toPort_guardian_collect_fault_v2x: port-prototype=RPort_collect_fault_v2x, service-instance=RequiredSomeipServiceInstance_collect_fault_v2x
package /katech/Machines/AdaptiveMachine/StartupConfigSets
  startup config Guardian: environment-variables=tag-with-optional-value={key=VSOMEIP_CONFIGURATION, value=/etc/vsomeip.json}, scheduling-policy=SCHEDULING-POLICY-ROUND-ROBIN, scheduling-priority=12, termination-behavior=PROCESS-IS-NOT-SELF-TERMINATING
