AUTOSAR XML (schema 00052)
package /katech/Machines/AdaptiveMachine/ServiceInstanceToMachineMappings
  someip service instance to machine mapping ProvidedServiceInstance_toMachine_report_fault: communication-connector=AdaptiveMachineConnector, service-instance=ProvidedSomeipServiceInstance_report_fault, udp-port=ReportFaultProviderEndpoint
  someip service instance to machine mapping RequiredServiceInstance_toMachine_report_fault: communication-connector=AdaptiveMachineConnector, service-instance=RequiredSomeipServiceInstance_report_fault, udp-port=ReportFaultSubscriberEndpoint
package /katech/Machines/AdaptiveMachine/ServiceInstances
  provided someip service instance ProvidedSomeipServiceInstance_report_fault: service-interface-deployment=someip_report_fault, sd-server-config=SomeipSdServerServiceInstanceConfig, service-instance-id=1201
    someip provided event group ProvidedEventgroup1: event-group=SomeipEventgroup1, multicast-threshold=0
  required someip service instance RequiredSomeipServiceInstance_report_fault: service-interface-deployment=someip_report_fault, required-minor-version=0, required-service-instance-id=1201, sd-client-config=SomeipSdClientServiceInstanceConfig, version-driven-find-behavior=MINIMUM-MINOR-VERSION
    someip required event group RequiredEventgroup1: event-group=SomeipEventgroup1
