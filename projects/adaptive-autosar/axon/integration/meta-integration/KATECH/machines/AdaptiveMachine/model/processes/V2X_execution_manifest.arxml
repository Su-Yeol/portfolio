AUTOSAR XML (schema 00052)
package /katech/Machines/AdaptiveMachine/ProcessToMachineMappings
  process to machine mapping set V2X
    process to machine mapping V2X: machine=AdaptiveMachine, process=V2X
package /katech/Machines/AdaptiveMachine/DltLogChannelToProcessMappings
  dlt application to process mapping V2XDltApplicationToProcessMapping: dlt-application=V2X, process=V2X
  dlt log sink to port prototype mapping V2XDltLogSinkToPortPrototypeMapping: dlt-context=DefaultDltContext, dlt-log-sink=[ConsoleDltSink, RemoteDltSink, V2XFileDltSink], process=V2X
package /katech/Machines/AdaptiveMachine/Processes
  process V2X: executable=V2X, state-dependent-startup-config{execution-dependency=state_machine.Running, function-group-state=MachineFG.Driving, resource-group=ResourceGroupKATECH, startup-config=V2X}
    process state machine state_machine: type=ProcessStateMachine
package /katech/Machines/AdaptiveMachine/ServiceInstanceToPortPrototypeMappings
  service instance to port prototype mapping ProvidedServiceInstance_toPort_v2x_collect_fault_v2x: port-prototype=PPort_collect_fault_v2x, process=V2X, service-instance=ProvidedSomeipServiceInstance_collect_fault_v2x
  service instance to port prototype mapping ProvidedServiceInstance_toPort_v2x_v2x_data: port-prototype=PPort_v2x_data, process=V2X, service-instance=ProvidedSomeipServiceInstance_v2x_data
package /katech/Machines/AdaptiveMachine/StartupConfigSets
  startup config V2X: environment-variables=tag-with-optional-value={key=VSOMEIP_CONFIGURATION, value=/etc/vsomeip.json}, scheduling-policy=SCHEDULING-POLICY-ROUND-ROBIN, scheduling-priority=12, termination-behavior=PROCESS-IS-NOT-SELF-TERMINATING
