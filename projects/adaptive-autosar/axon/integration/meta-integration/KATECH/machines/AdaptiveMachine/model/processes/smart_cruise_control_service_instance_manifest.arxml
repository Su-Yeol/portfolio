AUTOSAR XML (schema 00052)
package /katech/Machines/AdaptiveMachine/ServiceInstanceToMachineMappings
  someip service instance to machine mapping ProvidedServiceInstance_toMachine_smart_cruise_control: communication-connector=AdaptiveMachineConnector, service-instance=ProvidedSomeipServiceInstance_smart_cruise_control, udp-port=SmartCruiseControlProviderEndpoint
  someip service instance to machine mapping RequiredServiceInstance_toMachine_smart_cruise_control: communication-connector=AdaptiveMachineConnector, service-instance=RequiredSomeipServiceInstance_smart_cruise_control, udp-port=SmartCruiseControlSubscriberEndpoint
package /katech/Machines/AdaptiveMachine/ServiceInstances
  provided someip service instance ProvidedSomeipServiceInstance_smart_cruise_control: service-interface-deployment=someip_smart_cruise_control, sd-server-config=SomeipSdServerServiceInstanceConfig, service-instance-id=3401
    someip provided event group ProvidedEventgroup1: event-group=SomeipEventgroup1, multicast-threshold=0
  required someip service instance RequiredSomeipServiceInstance_smart_cruise_control: service-interface-deployment=someip_smart_cruise_control, required-minor-version=0, required-service-instance-id=3401, sd-client-config=SomeipSdClientServiceInstanceConfig, version-driven-find-behavior=MINIMUM-MINOR-VERSION
    someip required event group RequiredEventgroup1: event-group=SomeipEventgroup1
