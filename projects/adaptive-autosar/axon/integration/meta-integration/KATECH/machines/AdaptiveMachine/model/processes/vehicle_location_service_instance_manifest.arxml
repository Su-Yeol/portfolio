AUTOSAR XML (schema 00052)
package /katech/Machines/AdaptiveMachine/ServiceInstanceToMachineMappings
  someip service instance to machine mapping ProvidedServiceInstance_toMachine_vehicle_location: communication-connector=AdaptiveMachineConnector, service-instance=ProvidedSomeipServiceInstance_vehicle_location, udp-port=VehicleLocationProviderEndpoint
  someip service instance to machine mapping RequiredServiceInstance_toMachine_vehicle_location: communication-connector=AdaptiveMachineConnector, service-instance=RequiredSomeipServiceInstance_vehicle_location, udp-port=VehicleLocationSubscriberEndpoint
package /katech/Machines/AdaptiveMachine/ServiceInstances
  provided someip service instance ProvidedSomeipServiceInstance_vehicle_location: service-interface-deployment=someip_vehicle_location, sd-server-config=SomeipSdServerServiceInstanceConfig, service-instance-id=1901
    someip provided event group ProvidedEventgroup1: event-group=SomeipEventgroup1, multicast-threshold=0
  required someip service instance RequiredSomeipServiceInstance_vehicle_location: service-interface-deployment=someip_vehicle_location, required-minor-version=0, required-service-instance-id=1901, sd-client-config=SomeipSdClientServiceInstanceConfig, version-driven-find-behavior=MINIMUM-MINOR-VERSION
    someip required event group RequiredEventgroup1: event-group=SomeipEventgroup1
