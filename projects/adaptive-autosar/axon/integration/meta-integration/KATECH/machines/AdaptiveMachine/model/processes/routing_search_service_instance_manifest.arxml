AUTOSAR XML (schema 00052)
package /katech/Machines/AdaptiveMachine/ServiceInstanceToMachineMappings
  someip service instance to machine mapping ProvidedServiceInstance_toMachine_routing_search: communication-connector=AdaptiveMachineConnector, service-instance=ProvidedSomeipServiceInstance_routing_search, udp-port=RoutingSearchProviderEndpoint
  someip service instance to machine mapping RequiredServiceInstance_toMachine_routing_search: communication-connector=AdaptiveMachineConnector, service-instance=RequiredSomeipServiceInstance_routing_search, udp-port=RoutingSearchSubscriberEndpoint
package /katech/Machines/AdaptiveMachine/ServiceInstances
  provided someip service instance ProvidedSomeipServiceInstance_routing_search: service-interface-deployment=someip_routing_search, sd-server-config=SomeipSdServerServiceInstanceConfig, service-instance-id=1501
    someip provided event group ProvidedEventgroup1: event-group=SomeipEventgroup1, multicast-threshold=0
  required someip service instance RequiredSomeipServiceInstance_routing_search: service-interface-deployment=someip_routing_search, required-minor-version=0, required-service-instance-id=1501, sd-client-config=SomeipSdClientServiceInstanceConfig, version-driven-find-behavior=MINIMUM-MINOR-VERSION
    someip required event group RequiredEventgroup1: event-group=SomeipEventgroup1
