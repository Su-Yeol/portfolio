AUTOSAR XML (schema 00052)
package /katech/ModeDeclarationGroups
  mode declaration group MachineState: initial-mode=Off
    8 x mode:
      Off: value=0
      Verify: value=1
      Startup: value=2
      Shutdown: value=3
      Restart: value=4
      Driving: value=5
      Parking: value=6
      Leaving: value=7
