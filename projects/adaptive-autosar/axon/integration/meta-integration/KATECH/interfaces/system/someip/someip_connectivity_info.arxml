AUTOSAR XML (schema 00052)
package /katech/deployment
  someip service interface deployment someip_connectivity_info: service-interface=connectivity_info, service-interface-id=4001, service-interface-version={major-version=1, minor-version=0}
    someip event deployment SomeipEventConnectivityInfo: event=connectivityInfoEvent, event-id=1, transport-protocol=UDP
    someip event group SomeipEventgroup1: event-group-id=1, event=SomeipEventConnectivityInfo
