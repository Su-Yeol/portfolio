AUTOSAR XML (schema 00052)
package /katech/deployment
  someip service interface deployment someip_can_data: service-interface=can_data, service-interface-id=1001, service-interface-version={major-version=1, minor-version=0}
    someip event deployment SomeipEventCanData: event=canDataEvent, event-id=1, transport-protocol=UDP
    someip event group SomeipEventgroup1: event-group-id=1, event=SomeipEventCanData
