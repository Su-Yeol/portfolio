AUTOSAR XML (schema 00052)
package /katech/deployment
  someip service interface deployment someip_smart_cruise_control: service-interface=smart_cruise_control, service-interface-id=34001, service-interface-version={major-version=1, minor-version=0}
    someip event deployment SomeipEventSmartCruiseControl: event=smartCruiseControlEvent, event-id=1, transport-protocol=UDP
    someip event group SomeipEventgroup1: event-group-id=1, event=SomeipEventSmartCruiseControl
