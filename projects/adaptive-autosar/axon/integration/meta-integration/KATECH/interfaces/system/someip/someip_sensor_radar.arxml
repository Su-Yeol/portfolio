AUTOSAR XML (schema 00052)
package /katech/deployment
  someip service interface deployment someip_sensor_radar: service-interface=sensor_radar, service-interface-id=31001, service-interface-version={major-version=1, minor-version=0}
    someip event deployment SomeipEventSensorRadar: event=sensorRadarEvent, event-id=1, transport-protocol=UDP
    someip event group SomeipEventgroup1: event-group-id=1, event=SomeipEventSensorRadar
