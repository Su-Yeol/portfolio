AUTOSAR XML (schema 00052)
package /katech/deployment
  someip service interface deployment someip_planning_hmi_data: service-interface=planning_hmi_data, service-interface-id=30001, service-interface-version={major-version=1, minor-version=0}
    someip event deployment SomeipEventCanData: event=planningHmiDataEvent, event-id=1, transport-protocol=UDP
    someip event group SomeipEventgroup1: event-group-id=1, event=SomeipEventCanData
