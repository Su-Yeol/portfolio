AUTOSAR XML (schema 00052)
package /katech/deployment
  someip service interface deployment someip_driving_trajectory: service-interface=driving_trajectory, service-interface-id=5001, service-interface-version={major-version=1, minor-version=0}
    someip event deployment SomeipEventdrivingTrajectory: event=drivingTrajectoryEvent, event-id=1, transport-protocol=UDP
    someip event group SomeipEventgroup1: event-group-id=1, event=SomeipEventdrivingTrajectory
