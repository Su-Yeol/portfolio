AUTOSAR XML (schema 00052)
package /katech/deployment
  someip service interface deployment someip_lane_detection: service-interface=lane_detection, service-interface-id=7001, service-interface-version={major-version=1, minor-version=0}
    someip event deployment SomeipEventlaneDetection: event=laneDetectionEvent, event-id=1, transport-protocol=UDP
    someip event group SomeipEventgroup1: event-group-id=1, event=SomeipEventlaneDetection
