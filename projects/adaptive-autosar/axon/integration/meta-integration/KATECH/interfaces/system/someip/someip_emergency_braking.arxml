AUTOSAR XML (schema 00052)
package /katech/deployment
  someip service interface deployment someip_emergency_braking: service-interface=emergency_braking, service-interface-id=6001, service-interface-version={major-version=1, minor-version=0}
    someip event deployment SomeipEventEmgergencyBraking: event=emergencyBrakingEvent, event-id=1, transport-protocol=UDP
    someip event group SomeipEventgroup1: event-group-id=1, event=SomeipEventEmgergencyBraking
