AUTOSAR XML (schema 00052)
package /katech/deployment
  someip service interface deployment someip_control_bridge: service-interface=control_bridge, service-interface-id=35001, service-interface-version={major-version=1, minor-version=0}
    someip event deployment SomeipEventControlBridge: event=controlBridgeEvent, event-id=1, transport-protocol=UDP
    someip event group SomeipEventgroup1: event-group-id=1, event=SomeipEventControlBridge
