AUTOSAR XML (schema 00052)
package /katech/deployment
  someip service interface deployment someip_traffic_light: service-interface=traffic_light, service-interface-id=17001, service-interface-version={major-version=1, minor-version=0}
    someip event deployment SomeipEventtrafficLight: event=trafficLightEvent, event-id=1, transport-protocol=UDP
    someip event group SomeipEventgroup1: event-group-id=1, event=SomeipEventtrafficLight
