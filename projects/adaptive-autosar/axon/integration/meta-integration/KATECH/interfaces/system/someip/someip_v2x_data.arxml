AUTOSAR XML (schema 00052)
package /katech/deployment
  someip service interface deployment someip_v2x_data: service-interface=v2x_data, service-interface-id=18001, service-interface-version={major-version=1, minor-version=0}
    someip event deployment SomeipEventV2XData: event=v2xDataEvent, event-id=1, transport-protocol=UDP
    someip event group SomeipEventgroup1: event-group-id=1, event=SomeipEventV2XData
