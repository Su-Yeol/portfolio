AUTOSAR XML (schema 00052)
package /katech
  service interface v2x_data
    namespaces:
      symbol props katech
    events:
      data v2xDataEvent: type=v2x_data_Objects
package /katech/events
  5 x std cpp implementation data type, all with type-emitter=TYPE_EMITTER_ARA:
    v2x_data_Objects: category=STRUCTURE
      namespaces:
        symbol props katech
      cpp implementation data type element intersections: type-reference={inplace=false, type-reference=IntersectionState}
    IntersectionState: category=STRUCTURE
      namespaces:
        symbol props katech
      6 x cpp implementation data type element:
        id: type-reference={inplace=false, type-reference=int64_t}
        revision: type-reference={inplace=false, type-reference=uint8_t}
        status: type-reference={inplace=false, type-reference=uint64_t}
        moy: type-reference={inplace=false, type-reference=uint64_t}
        timeStamp: type-reference={inplace=false, type-reference=uint64_t}
        states: type-reference={inplace=false, type-reference=stateStruct}
    stateStruct: category=STRUCTURE
      namespaces:
        symbol props katech
      cpp implementation data type element MovementState: type-reference={inplace=false, type-reference=movementStateVector}
    movementStateVector: category=VECTOR, cpp-template-argument=movementState
    movementState: category=STRUCTURE
      namespaces:
        symbol props katech
      5 x cpp implementation data type element:
        movementName: type-reference={inplace=false, type-reference=String}
        signalGroup: type-reference={inplace=false, type-reference=uint8_t}
        eventState: type-reference={inplace=false, type-reference=String}
        timing_minEndTime: type-reference={inplace=false, type-reference=uint16_t}
        timing_maxEndTime: type-reference={inplace=false, type-reference=uint16_t}
