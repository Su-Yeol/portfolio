AUTOSAR XML (schema 00052)
package /katech
  service interface matching_info
    namespaces:
      symbol props katech
    events:
      data matchingInfoEvent: type=matching_info_Objects
package /katech/events
  std cpp implementation data type matching_info_Objects: category=STRUCTURE, type-emitter=TYPE_EMITTER_ARA
    namespaces:
      symbol props katech
    9 x cpp implementation data type element:
      dStartX: type-reference={inplace=false, type-reference=double}
      dStartY: type-reference={inplace=false, type-reference=double}
      dEndX: type-reference={inplace=false, type-reference=double}
      dEndY: type-reference={inplace=false, type-reference=double}
      nS_ClosestRoadID: type-reference={inplace=false, type-reference=int64_t}
      nE_ClosestRoadID: type-reference={inplace=false, type-reference=int64_t}
      nS_ClosestLaneID: type-reference={inplace=false, type-reference=int64_t}
      nE_ClosestLaneID: type-reference={inplace=false, type-reference=int64_t}
      roadIdVector: type-reference={inplace=false, type-reference=int64Vector}
