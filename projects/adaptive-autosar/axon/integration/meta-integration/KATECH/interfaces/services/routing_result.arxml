AUTOSAR XML (schema 00052)
package /katech
  service interface routing_result
    namespaces:
      symbol props katech
    events:
      data routingResultEvent: type=routing_result_Objects
package /katech/events
  5 x std cpp implementation data type, all with type-emitter=TYPE_EMITTER_ARA:
    routing_result_Objects: category=STRUCTURE
      namespaces:
        symbol props katech
      cpp implementation data type element vRoute: type-reference={inplace=false, type-reference=RoadListVector}
    RoadListVector: category=VECTOR, cpp-template-argument=ROAD_LIST
    ROAD_LIST: category=STRUCTURE
      namespaces:
        symbol props katech
      cpp implementation data type element nRoadID: type-reference={inplace=false, type-reference=int64_t}
      cpp implementation data type element vLinks: type-reference={inplace=false, type-reference=LinkListVector}
    LinkListVector: category=VECTOR, cpp-template-argument=LINK_LIST
    LINK_LIST: category=STRUCTURE
      namespaces:
        symbol props katech
      cpp implementation data type element nBest: type-reference={inplace=false, type-reference=int8_t}
      cpp implementation data type element nLinkID: type-reference={inplace=false, type-reference=int64_t}
