AUTOSAR XML (schema 00052)
package /katech
  service interface can_data
    namespaces:
      symbol props katech
    events:
      data canDataEvent: type=can_data_Objects
package /katech/events
  6 x std cpp implementation data type, all with category=STRUCTURE, type-emitter=TYPE_EMITTER_ARA:
    can_data_Objects
      namespaces:
        symbol props katech
      23 x cpp implementation data type element:
        WheelSpeed_FL: type-reference={inplace=false, type-reference=double}
        WheelSpeed_FR: type-reference={inplace=false, type-reference=double}
        WheelSpeed_RL: type-reference={inplace=false, type-reference=double}
        WheelSpeed_RR: type-reference={inplace=false, type-reference=double}
        ClusterSpeed: type-reference={inplace=false, type-reference=double}
        GearState: type-reference={inplace=false, type-reference=uint8_t}
        LateralAcceleration: type-reference={inplace=false, type-reference=double}
        LongitudinalAcceleration: type-reference={inplace=false, type-reference=double}
        Angular_Acceleration: type-reference={inplace=false, type-reference=double}
        Turn_Signal: type-reference={inplace=false, type-reference=uint8_t}
        SteeringWheelAngle: type-reference={inplace=false, type-reference=double}
        ControlSteering: type-reference={inplace=false, type-reference=int32_t}
        LaneInfo: type-reference={inplace=false, type-reference=LaneInfoStruct}
        AutoDrivingMode: type-reference={inplace=false, type-reference=bool}
        Emergency_Light: type-reference={inplace=false, type-reference=uint8_t}
        No_Autonomous_Driving: type-reference={inplace=false, type-reference=bool}
        WheelTick_FL: type-reference={inplace=false, type-reference=uint32_t}
        WheelTick_FR: type-reference={inplace=false, type-reference=uint32_t}
        WheelTick_RL: type-reference={inplace=false, type-reference=uint32_t}
        WheelTick_RR: type-reference={inplace=false, type-reference=uint32_t}
        Accel_Pedal: type-reference={inplace=false, type-reference=double}
        Brake_Pedal: type-reference={inplace=false, type-reference=double}
        RPM: type-reference={inplace=false, type-reference=double}
    LaneInfoStruct
      namespaces:
        symbol props katech
      4 x cpp implementation data type element:
        LanePosition: type-reference={inplace=false, type-reference=Lane_Position}
        LaneHeadingAngle: type-reference={inplace=false, type-reference=Lane_HeadingAngle}
        LaneCurvature: type-reference={inplace=false, type-reference=Lane_Curvature}
        LaneCurvatureRate: type-reference={inplace=false, type-reference=Lane_CurvatureRate}
    Lane_Position
      namespaces:
        symbol props katech
      cpp implementation data type element Left: type-reference={inplace=false, type-reference=double}
      cpp implementation data type element Right: type-reference={inplace=false, type-reference=double}
    Lane_HeadingAngle
      namespaces:
        symbol props katech
      cpp implementation data type element Left: type-reference={inplace=false, type-reference=double}
      cpp implementation data type element Right: type-reference={inplace=false, type-reference=double}
    Lane_Curvature
      namespaces:
        symbol props katech
      cpp implementation data type element Left: type-reference={inplace=false, type-reference=double}
      cpp implementation data type element Right: type-reference={inplace=false, type-reference=double}
    Lane_CurvatureRate
      namespaces:
        symbol props katech
      cpp implementation data type element Left: type-reference={inplace=false, type-reference=double}
      cpp implementation data type element Right: type-reference={inplace=false, type-reference=double}
