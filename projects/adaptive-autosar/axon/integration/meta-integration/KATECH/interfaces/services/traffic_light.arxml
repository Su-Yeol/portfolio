AUTOSAR XML (schema 00052)
package /katech
  service interface traffic_light
    namespaces:
      symbol props katech
    events:
      data trafficLightEvent: type=traffic_light_Objects
package /katech/events
  4 x std cpp implementation data type, all with type-emitter=TYPE_EMITTER_ARA:
    traffic_light_Objects: category=STRUCTURE
      namespaces:
        symbol props katech
      cpp implementation data type element PerceptionTrafficlightVector: type-reference={inplace=false, type-reference=perception_trafficlight_Array}
      cpp implementation data type element Camera_Status: type-reference={inplace=false, type-reference=bool}
      cpp implementation data type element TL_CAM_Status: type-reference={inplace=false, type-reference=bool}
    perception_trafficlight_Array: category=VECTOR, cpp-template-argument=Perception_trafficlight
    Perception_trafficlight: category=STRUCTURE
      namespaces:
        symbol props katech
      4 x cpp implementation data type element:
        Id: type-reference={inplace=false, type-reference=String}
        Color: type-reference={inplace=false, type-reference=trafficLightColor}
        Position: type-reference={inplace=false, type-reference=BBox2D}
        CameraID: type-reference={inplace=false, type-reference=int16_t}
    trafficLightColor: compu {0x00=UNKNOWN, 0x50=GREEN, 0x51=GREEN_LEFT_GREEN_ARROW, 0x52=RED, 0x53=RED_LEFT_GREEN_ARROW, 0x55=YELLOW, 0x56=LEFT_GREEN_ARROW, 0x57=RED_YELLOW, 0x58=GREEN_YELLOW, 0x59=YELLOW_GREEN_LEFT_ARROW, 0x5A=OFF}, type-reference=uint16_t
      namespaces:
        symbol props katech
