AUTOSAR XML (schema 00052)
package /katech
  service interface can_data_etc
    namespaces:
      symbol props katech
    events:
      data canDataEtcEvent: type=can_data_etc_Objects
package /katech/events
  std cpp implementation data type can_data_etc_Objects: category=STRUCTURE, type-emitter=TYPE_EMITTER_ARA
    namespaces:
      symbol props katech
    13 x cpp implementation data type element:
      SeatBelt: type-reference={inplace=false, type-reference=uint8_t}
      Radar_Status: type-reference={inplace=false, type-reference=uint8_t}
      Head_Light: type-reference={inplace=false, type-reference=bool}
      High_Beam: type-reference={inplace=false, type-reference=bool}
      Fog_Lights: type-reference={inplace=false, type-reference=bool}
      Backup_Lamp: type-reference={inplace=false, type-reference=bool}
      Wiper: type-reference={inplace=false, type-reference=bool}
      Horn: type-reference={inplace=false, type-reference=bool}
      Battery_Status: type-reference={inplace=false, type-reference=uint8_t}
      Battery_Gauge: type-reference={inplace=false, type-reference=uint8_t}
      Odometer: type-reference={inplace=false, type-reference=int64_t}
      Driving_Distance: type-reference={inplace=false, type-reference=int64_t}
      Avg_Elec_Consum: type-reference={inplace=false, type-reference=double}
