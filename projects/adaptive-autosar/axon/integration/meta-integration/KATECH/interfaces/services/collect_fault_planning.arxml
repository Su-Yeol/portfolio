AUTOSAR XML (schema 00052)
package /katech
  service interface collect_fault_planning
    namespaces:
      symbol props katech
    events:
      data collectFaultPlanningEvent: type=collect_fault_planning_Objects
package /katech/events
  std cpp implementation data type collect_fault_planning_Objects: category=STRUCTURE, type-emitter=TYPE_EMITTER_ARA
    namespaces:
      symbol props katech
    cpp implementation data type element AP: type-reference={inplace=false, type-reference=uint8_t}
    cpp implementation data type element Fault_Planning: type-reference={inplace=false, type-reference=uint8Vector}
