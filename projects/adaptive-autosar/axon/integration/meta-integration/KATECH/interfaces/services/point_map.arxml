AUTOSAR XML (schema 00052)
package /katech
  service interface point_map
    namespaces:
      symbol props katech
    events:
      data pointMapEvent: type=point_map_Objects
package /katech/events
  5 x std cpp implementation data type, all with type-emitter=TYPE_EMITTER_ARA:
    point_map_Objects: category=STRUCTURE
      namespaces:
        symbol props katech
      cpp implementation data type element PointMap: type-reference={inplace=false, type-reference=point_object_info}
    point_object_info: category=VECTOR, cpp-template-argument=pointinfo
    pointinfo: category=STRUCTURE
      namespaces:
        symbol props katech
      cpp implementation data type element ID: type-reference={inplace=false, type-reference=int64_t}
      cpp implementation data type element Roads: type-reference={inplace=false, type-reference=MMRoadVector}
    MMRoadVector: category=VECTOR, cpp-template-argument=MMRoadStruct
    MMRoadStruct: category=STRUCTURE
      namespaces:
        symbol props katech
      5 x cpp implementation data type element:
        ID: type-reference={inplace=false, type-reference=int64_t}
        Predecessor: type-reference={inplace=false, type-reference=int64Vector}
        Successor: type-reference={inplace=false, type-reference=int64Vector}
        Lanes: type-reference={inplace=false, type-reference=LaneVector}
        Lines: type-reference={inplace=false, type-reference=LineVector}
