AUTOSAR XML (schema 00052)
package /katech
  service interface semantic_map
    namespaces:
      symbol props katech
    events:
      data semanticMapEvent: type=semantic_map_Objects
package /katech/events
  8 x std cpp implementation data type, all with type-emitter=TYPE_EMITTER_ARA:
    semantic_map_Objects: category=STRUCTURE
      namespaces:
        symbol props katech
      5 x cpp implementation data type element:
        Prediction_obstacles: type-reference={inplace=false, type-reference=predictionObstacle}
        Intent: type-reference={inplace=false, type-reference=drivingIntent}
        Scenario: type-reference={inplace=false, type-reference=drivingScenario}
        Start_timestamp: type-reference={inplace=false, type-reference=double}
        End_timestamp: type-reference={inplace=false, type-reference=double}
    predictionObstacle: category=STRUCTURE
      namespaces:
        symbol props katech
      5 x cpp implementation data type element:
        PerceptionObstacleVector: type-reference={inplace=false, type-reference=perceptionobstacleArray}
        TrajectoryVector: type-reference={inplace=false, type-reference=trajectoryArray}
        Intent: type-reference={inplace=false, type-reference=int16_t}
        Priority: type-reference={inplace=false, type-reference=int16_t}
        FeatureVector: type-reference={inplace=false, type-reference=featureArray}
    perceptionobstacleArray: category=VECTOR, cpp-template-argument=PerceptionObstacles
    trajectoryArray: category=VECTOR, cpp-template-argument=Trajectory
    featureArray: category=VECTOR, cpp-template-argument=Feature
    PerceptionObstacles: category=STRUCTURE
      namespaces:
        symbol props katech
      10 x cpp implementation data type element:
        ID: type-reference={inplace=false, type-reference=int32_t}
        Position: type-reference={inplace=false, type-reference=Vector3D}
        Length: type-reference={inplace=false, type-reference=double}
        Width: type-reference={inplace=false, type-reference=double}
        Height: type-reference={inplace=false, type-reference=double}
        Timestamp: type-reference={inplace=false, type-reference=double}
        Position2D: type-reference={inplace=false, type-reference=BBox2D}
        Velocity: type-reference={inplace=false, type-reference=double}
        Acceleration: type-reference={inplace=false, type-reference=double}
        LightStatus: type-reference={inplace=false, type-reference=int16_t}
    Feature: category=STRUCTURE
      namespaces:
        symbol props katech
      13 x cpp implementation data type element:
        Id: type-reference={inplace=false, type-reference=int32_t}
        Position: type-reference={inplace=false, type-reference=Vector3D}
        Velocity: type-reference={inplace=false, type-reference=Vector3D}
        Raw_velocity: type-reference={inplace=false, type-reference=Vector3D}
        Acceleration: type-reference={inplace=false, type-reference=Vector3D}
        Speed: type-reference={inplace=false, type-reference=double}
        Width: type-reference={inplace=false, type-reference=double}
        Height: type-reference={inplace=false, type-reference=double}
        Type: type-reference={inplace=false, type-reference=int16_t}
        Priority: type-reference={inplace=false, type-reference=int16_t}
        Feature_trajectory_pointsVector: type-reference={inplace=false, type-reference=trajectoryArray}
        Predicted_trajectory_pointsVector: type-reference={inplace=false, type-reference=trajectoryArray}
        Surrounding_lane_id: type-reference={inplace=false, type-reference=String}
    drivingIntent: compu {0x00=UNKNOWN, 0x01=STOP, 0x02=STATIONARY, 0x03=MOVING, 0x04=CHANGE_LANE, 0x05=LOW_ACCELERATION, 0x06=HIGH_ACCELERATION, 0x07=LOW_DECELERATION, 0x08=HIGH_DECELERATION}, type-reference=int16_t
      namespaces:
        symbol props katech
  std cpp implementation data type drivingScenario: compu {0x00=UNKNOWN, 0x3e8=CRUISE, 0x3e9=CRUISE_URBAN, 0x3ea=CRUISE_HIGHWAY, 0x7d0=JUNCTION, 0x7d1=JUNCTION_TRAFFIC_LIGHT, 0x7d2=JUNCTION_STOP_SIGN}, type-emitter=TYPE_EMITTER_ARA, type-reference=int16_t
    namespaces:
      symbol props katech
