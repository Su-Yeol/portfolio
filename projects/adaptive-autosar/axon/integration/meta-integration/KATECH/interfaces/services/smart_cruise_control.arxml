AUTOSAR XML (schema 00052)
package /katech
  service interface smart_cruise_control
    namespaces:
      symbol props katech
    events:
      data smartCruiseControlEvent: type=smart_cruise_control_Objects
package /katech/events
  std cpp implementation data type smart_cruise_control_Objects: category=STRUCTURE, type-emitter=TYPE_EMITTER_ARA
    namespaces:
      symbol props katech
    cpp implementation data type element TargetVelocity: type-reference={inplace=false, type-reference=double}
    cpp implementation data type element ObjectRelSpeed: type-reference={inplace=false, type-reference=double}
    cpp implementation data type element ObjectDistance: type-reference={inplace=false, type-reference=double}
