AUTOSAR XML (schema 00052)
package /katech
  service interface routing_search
    namespaces:
      symbol props katech
    events:
      data routingSearchEvent: type=routing_search_Objects
package /katech/events
  std cpp implementation data type routing_search_Objects: category=STRUCTURE, type-emitter=TYPE_EMITTER_ARA
    namespaces:
      symbol props katech
    4 x cpp implementation data type element:
      preset: type-reference={inplace=false, type-reference=uint8_t}
      StartPoint: type-reference={inplace=false, type-reference=PointStruct}
      EndPoint: type-reference={inplace=false, type-reference=PointStruct}
      StopPoint: type-reference={inplace=false, type-reference=StopPointVector}
