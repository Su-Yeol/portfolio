AUTOSAR XML (schema 00052)
package /katech
  service interface planning_hmi_data
    namespaces:
      symbol props katech
    events:
      data planningHmiDataEvent: type=planning_hmi_data_Objects
package /katech/events
  std cpp implementation data type planning_hmi_data_Objects: category=STRUCTURE, type-emitter=TYPE_EMITTER_ARA
    namespaces:
      symbol props katech
    cpp implementation data type element No_Autonomous_Driving: type-reference={inplace=false, type-reference=bool}
    cpp implementation data type element Noti_Autonomous_Driving_Mode: type-reference={inplace=false, type-reference=uint8_t}
    cpp implementation data type element AutoDrivingMode: type-reference={inplace=false, type-reference=bool}
