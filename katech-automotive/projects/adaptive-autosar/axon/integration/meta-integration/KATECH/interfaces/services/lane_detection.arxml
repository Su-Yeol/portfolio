AUTOSAR XML (schema 00052)
package /katech
  service interface lane_detection
    namespaces:
      symbol props katech
    events:
      data laneDetectionEvent: type=lane_detection_Objects
package /katech/events
  std cpp implementation data type lane_detection_Objects: category=STRUCTURE, type-emitter=TYPE_EMITTER_ARA
    namespaces:
      symbol props katech
    cpp implementation data type element LaneLineDetection_LeftVector: type-reference={inplace=false, type-reference=lane_detection_Array}
    cpp implementation data type element LaneLineDetection_RightVector: type-reference={inplace=false, type-reference=lane_detection_Array}
  std cpp implementation data type lane_detection_Array: category=VECTOR, cpp-template-argument=Vector2D, type-emitter=TYPE_EMITTER_ARA
  std cpp implementation data type Vector2D: category=STRUCTURE, type-emitter=TYPE_EMITTER_ARA
    namespaces:
      symbol props katech
    cpp implementation data type element X: type-reference={inplace=false, type-reference=double}
    cpp implementation data type element Y: type-reference={inplace=false, type-reference=double}
