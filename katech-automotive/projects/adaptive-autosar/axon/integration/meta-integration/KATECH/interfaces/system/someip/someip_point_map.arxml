AUTOSAR XML (schema 00052)
package /katech/deployment
  someip service interface deployment someip_point_map: service-interface=point_map, service-interface-id=11001, service-interface-version={major-version=1, minor-version=0}
    someip event deployment SomeipEventPointMap: event=pointMapEvent, event-id=1, transport-protocol=UDP
    someip event group SomeipEventgroup1: event-group-id=1, event=SomeipEventPointMap
