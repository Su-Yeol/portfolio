AUTOSAR XML (schema 00052)
package /katech/deployment
  someip service interface deployment someip_local_map: service-interface=local_map, service-interface-id=8001, service-interface-version={major-version=1, minor-version=0}
    someip event deployment SomeipEventlocalMap: event=localMapEvent, event-id=1, transport-protocol=UDP
    someip field deployment ServiceFlag_SomeIp: field=ServiceFlag
      get getter: method-id=3007, transport-protocol=UDP
      notifier notifier: event-id=3008, transport-protocol=UDP
      set setter: method-id=3009, transport-protocol=UDP
    someip method deployment GetMapDataSomeipMethod: method=GetMapData, method-id=32000, transport-protocol=UDP
    someip event group SomeipEventgroup1: event-group-id=1, event=SomeipEventlocalMap
    someip event group SomeipEventgroup2: event-group-id=2, event=notifier
