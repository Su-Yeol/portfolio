AUTOSAR XML (schema 00052)
package /katechErrors
  ap application error InvalidConfigString: error-code=5, error-domain=SpecificErrors  # Configuration string is invalid.
  ap application error InvalidParameter: error-code=6, error-domain=SpecificErrors  # Parameter is invalid.
  ap application error GenericFailure: error-code=12, error-domain=GenericErrors  # Generic failure.
  ap application error domain SpecificErrors: value=44
    namespaces:
      symbol props katech
  ap application error domain GenericErrors: value=45
    namespaces:
      symbol props katech
