AUTOSAR XML (schema 00052)
package /katech/deployment
  someip service interface deployment someip_vehicle_location: service-interface=vehicle_location, service-interface-id=19001, service-interface-version={major-version=1, minor-version=0}
    someip event deployment SomeipEventvehicleLocation: event=vehicleLocationEvent, event-id=1, transport-protocol=UDP
    someip event group SomeipEventgroup1: event-group-id=1, event=SomeipEventvehicleLocation
