AUTOSAR XML (schema 00052)
package /katech/deployment
  someip service interface deployment someip_collect_fault_hdmap: service-interface=collect_fault_hdmap, service-interface-id=21001, service-interface-version={major-version=1, minor-version=0}
    someip event deployment SomeipEventCollectFaultHdmap: event=collectFaultHdmapEvent, event-id=1, transport-protocol=UDP
    someip event group SomeipEventgroup1: event-group-id=1, event=SomeipEventCollectFaultHdmap
