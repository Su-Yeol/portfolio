AUTOSAR XML (schema 00052)
package /katech
  service interface vehicle_location
    namespaces:
      symbol props katech
    events:
      data vehicleLocationEvent: type=vehicle_location_Objects
package /katech/events
  std cpp implementation data type vehicle_location_Objects: category=STRUCTURE, type-emitter=TYPE_EMITTER_ARA
    namespaces:
      symbol props katech
    12 x cpp implementation data type element:
      MeasurementTime: type-reference={inplace=false, type-reference=float}
      CurrentLane_id: type-reference={inplace=false, type-reference=int64_t}
      PositionX: type-reference={inplace=false, type-reference=double}
      PositionY: type-reference={inplace=false, type-reference=double}
      PositionZ: type-reference={inplace=false, type-reference=double}
      GNSS: type-reference={inplace=false, type-reference=GNSSStruct}
      IMU: type-reference={inplace=false, type-reference=IMUStruct}
      GridID: type-reference={inplace=false, type-reference=uint64_t}
      CellID: type-reference={inplace=false, type-reference=uint64_t}
      Accuracy: type-reference={inplace=false, type-reference=double}
      Fix_type: type-reference={inplace=false, type-reference=uint8_t}
      GPS_Status: type-reference={inplace=false, type-reference=bool}
  std cpp implementation data type GNSSStruct: category=STRUCTURE, type-emitter=TYPE_EMITTER_ARA
    namespaces:
      symbol props katech
    cpp implementation data type element Heading: type-reference={inplace=false, type-reference=double}
    cpp implementation data type element Speed: type-reference={inplace=false, type-reference=double}
  std cpp implementation data type IMUStruct: category=STRUCTURE, type-emitter=TYPE_EMITTER_ARA
    namespaces:
      symbol props katech
    5 x cpp implementation data type element, all with type-reference={inplace=false, type-reference=double}:
      Roll
      Pitch
      Yaw
      Linear_acceleration
      Angular_velocity
