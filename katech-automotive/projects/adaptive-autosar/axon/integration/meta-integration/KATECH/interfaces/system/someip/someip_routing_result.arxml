AUTOSAR XML (schema 00052)
package /katech/deployment
  someip service interface deployment someip_routing_result: service-interface=routing_result, service-interface-id=14001, service-interface-version={major-version=1, minor-version=0}
    someip event deployment SomeipEventRoutingResult: event=routingResultEvent, event-id=1, transport-protocol=UDP
    someip event group SomeipEventgroup1: event-group-id=1, event=SomeipEventRoutingResult
