AUTOSAR XML (schema 00052)
package /katech/deployment
  someip service interface deployment Someip_semantic_map: service-interface=semantic_map, service-interface-id=16001, service-interface-version={major-version=1, minor-version=0}
    someip event deployment SomeipEventsemanticMap: event=semanticMapEvent, event-id=1, transport-protocol=UDP
    someip event group SomeipEventgroup1: event-group-id=1, event=SomeipEventsemanticMap
