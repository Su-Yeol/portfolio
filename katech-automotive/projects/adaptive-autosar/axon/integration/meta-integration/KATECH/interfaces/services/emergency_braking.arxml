AUTOSAR XML (schema 00052)
package /katech
  service interface emergency_braking
    namespaces:
      symbol props katech
    events:
      data emergencyBrakingEvent: type=emergency_braking_Objects
package /katech/events
  std cpp implementation data type emergency_braking_Objects: category=STRUCTURE, type-emitter=TYPE_EMITTER_ARA
    namespaces:
      symbol props katech
    cpp implementation data type element EmergencyLidarData: type-reference={inplace=false, type-reference=emergency_lidar_Array}
  std cpp implementation data type emergency_lidar_Array: category=VECTOR, cpp-template-argument=uint8_t, type-emitter=TYPE_EMITTER_ARA
