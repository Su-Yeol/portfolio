AUTOSAR XML (schema 00052)
package /katech/deployment
  someip service interface deployment someip_report_fault: service-interface=report_fault, service-interface-id=12001, service-interface-version={major-version=1, minor-version=0}
    someip event deployment SomeipEventReportFault: event=reportFaultEvent, event-id=1, transport-protocol=UDP
    someip event group SomeipEventgroup1: event-group-id=1, event=SomeipEventReportFault
