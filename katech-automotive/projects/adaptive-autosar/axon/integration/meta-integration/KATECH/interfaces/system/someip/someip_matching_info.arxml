AUTOSAR XML (schema 00052)
package /katech/deployment
  someip service interface deployment someip_matching_info: service-interface=matching_info, service-interface-id=9001, service-interface-version={major-version=1, minor-version=0}
    someip event deployment SomeipEventMatchingInfo: event=matchingInfoEvent, event-id=1, transport-protocol=UDP
    someip event group SomeipEventgroup1: event-group-id=1, event=SomeipEventMatchingInfo
