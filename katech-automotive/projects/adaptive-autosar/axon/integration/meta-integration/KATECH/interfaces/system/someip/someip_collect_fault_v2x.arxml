AUTOSAR XML (schema 00052)
package /katech/deployment
  someip service interface deployment someip_collect_fault_v2x: service-interface=collect_fault_v2x, service-interface-id=28001, service-interface-version={major-version=1, minor-version=0}
    someip event deployment SomeipEventCollectFaultV2X: event=collectFaultV2XEvent, event-id=1, transport-protocol=UDP
    someip event group SomeipEventgroup1: event-group-id=1, event=SomeipEventCollectFaultV2X
