AUTOSAR XML (schema 00052)
package /katech
  service interface local_map
    namespaces:
      symbol props katech
    events:
      data localMapEvent: type=local_map_Objects
    field ServiceFlag: type=String, has-getter=true, has-notifier=true, has-setter=true
    methods:
      operation GetMapData
        arg grid_id: type=uint64_t, direction=IN
        arg cell_id: type=uint64_t, direction=IN
        arg map_data: type=local_map_Objects, direction=OUT
package /katech/events
  std cpp implementation data type local_map_Objects: category=STRUCTURE, type-emitter=TYPE_EMITTER_ARA
    namespaces:
      symbol props katech
    8 x cpp implementation data type element:
      GridID: type-reference={inplace=false, type-reference=uint64_t}
      CellID: type-reference={inplace=false, type-reference=uint64_t}
      Roads: type-reference={inplace=false, type-reference=RoadVector}
      Junctions: type-reference={inplace=false, type-reference=JunctionVector}
      StopLines: type-reference={inplace=false, type-reference=StopLineVector}
      Borders: type-reference={inplace=false, type-reference=BorderVector}
      ParkingLots: type-reference={inplace=false, type-reference=ParkingLotVector}
      CrossWalks: type-reference={inplace=false, type-reference=CrossWalkVector}
