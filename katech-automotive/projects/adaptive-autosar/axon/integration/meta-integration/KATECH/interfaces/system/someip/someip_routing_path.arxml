AUTOSAR XML (schema 00052)
package /katech/deployment
  someip service interface deployment Someip_routing_path: service-interface=routing_path, service-interface-id=13001, service-interface-version={major-version=1, minor-version=0}
    someip event deployment SomeipEventRoutingPath: event=routingPathEvent, event-id=1, transport-protocol=UDP
    someip event group SomeipEventgroup1: event-group-id=1, event=SomeipEventRoutingPath
