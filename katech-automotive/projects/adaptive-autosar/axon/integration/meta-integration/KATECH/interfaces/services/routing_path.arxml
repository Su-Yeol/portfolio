AUTOSAR XML (schema 00052)
package /katech
  service interface routing_path
    namespaces:
      symbol props katech
    events:
      data routingPathEvent: type=routing_path_Objects
package /katech/events
  5 x std cpp implementation data type, all with type-emitter=TYPE_EMITTER_ARA:
    routing_path_Objects: category=STRUCTURE
      namespaces:
        symbol props katech
      cpp implementation data type element Roadsegment: type-reference={inplace=false, type-reference=structure_Roadsegment}
      cpp implementation data type element Distance: type-reference={inplace=false, type-reference=double}
      cpp implementation data type element Map_version: type-reference={inplace=false, type-reference=vector_byte}
    structure_Roadsegment: category=STRUCTURE
      namespaces:
        symbol props katech
      cpp implementation data type element ID: type-reference={inplace=false, type-reference=String}
      cpp implementation data type element Passage: type-reference={inplace=false, type-reference=structure_Passage}
    structure_Passage: category=STRUCTURE
      namespaces:
        symbol props katech
      cpp implementation data type element LaneSegment: type-reference={inplace=false, type-reference=structure_LaneSegment}
      cpp implementation data type element ChangeLaneType: type-reference={inplace=false, type-reference=int16_t}
      cpp implementation data type element CanExit: type-reference={inplace=false, type-reference=bool}
    structure_LaneSegment: category=STRUCTURE
      namespaces:
        symbol props katech
      cpp implementation data type element Id: type-reference={inplace=false, type-reference=String}
      cpp implementation data type element Start_s: type-reference={inplace=false, type-reference=double}
      cpp implementation data type element End_s: type-reference={inplace=false, type-reference=double}
    vector_byte: category=VECTOR, cpp-template-argument=uint8_t
