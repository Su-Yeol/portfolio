AUTOSAR XML (schema 00052)
package /katech/deployment
  someip service interface deployment someip_routing_search: service-interface=routing_search, service-interface-id=15001, service-interface-version={major-version=1, minor-version=0}
    someip event deployment SomeipEventRoutingSearch: event=routingSearchEvent, event-id=1, transport-protocol=UDP
    someip event group SomeipEventgroup1: event-group-id=1, event=SomeipEventRoutingSearch
