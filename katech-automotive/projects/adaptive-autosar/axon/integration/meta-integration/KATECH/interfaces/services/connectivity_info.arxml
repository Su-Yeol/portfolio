AUTOSAR XML (schema 00052)
package /katech
  service interface connectivity_info
    namespaces:
      symbol props katech
    events:
      data connectivityInfoEvent: type=connectivity_info_Objects
package /katech/events
  std cpp implementation data type connectivity_info_Objects: category=STRUCTURE, type-emitter=TYPE_EMITTER_ARA
    namespaces:
      symbol props katech
    cpp implementation data type element nID: type-reference={inplace=false, type-reference=int64_t}
    cpp implementation data type element vRoads: type-reference={inplace=false, type-reference=ROAD_CONNECTIVITY_VECTOR}
