AUTOSAR XML (schema 00052)
package /katech/CppImplementationDataTypes
  51 x std cpp implementation data type, all with type-emitter=TYPE_EMITTER_ARA:
    String: category=STRING
    doubleVector: category=VECTOR, cpp-template-argument=double
    uint8Vector: category=VECTOR, cpp-template-argument=uint8_t
    StopPointVector: category=VECTOR, cpp-template-argument=PointStruct
    RadarPointVector: category=VECTOR, cpp-template-argument=PointStruct
    PointStruct: category=STRUCTURE
      namespaces:
        symbol props katech
      cpp implementation data type element X: type-reference={inplace=false, type-reference=double}
      cpp implementation data type element Y: type-reference={inplace=false, type-reference=double}
    BBox2D: category=STRUCTURE
      namespaces:
        symbol props katech
      4 x cpp implementation data type element, all with type-reference={inplace=false, type-reference=double}:
        Xmin
        Ymin
        Xmax
        Ymax
    Vector2D_F: category=STRUCTURE
      namespaces:
        symbol props katech
      cpp implementation data type element X: type-reference={inplace=false, type-reference=float}
      cpp implementation data type element Y: type-reference={inplace=false, type-reference=float}
    Vector3D: category=STRUCTURE
      namespaces:
        symbol props katech
      cpp implementation data type element X: type-reference={inplace=false, type-reference=double}
      cpp implementation data type element Y: type-reference={inplace=false, type-reference=double}
      cpp implementation data type element Z: type-reference={inplace=false, type-reference=double}
    Vector4D: category=STRUCTURE
      namespaces:
        symbol props katech
      4 x cpp implementation data type element, all with type-reference={inplace=false, type-reference=double}:
        X
        Y
        Z
        W
    Trajectory: category=STRUCTURE
      namespaces:
        symbol props katech
      6 x cpp implementation data type element, all with type-reference={inplace=false, type-reference=double}:
        X
        Y
        Z
        V
        A
        Steer
    PathPoint: category=STRUCTURE
      namespaces:
        symbol props katech
      11 x cpp implementation data type element, all with type-reference={inplace=false, type-reference=double}:
        X
        Y
        Z
        Theta
        Kappa
        S
        Dkappa
        Ddkappa
        Lane_id
        X_derivative
        Y_derivative
    TrajectoryPoint: category=STRUCTURE
      namespaces:
        symbol props katech
      6 x cpp implementation data type element:
        Path_point: type-reference={inplace=false, type-reference=PathPoint}
        V: type-reference={inplace=false, type-reference=double}
        A: type-reference={inplace=false, type-reference=double}
        Relative_time: type-reference={inplace=false, type-reference=double}
        Da: type-reference={inplace=false, type-reference=double}
        Steer: type-reference={inplace=false, type-reference=double}
    ConnectivityStruct: category=STRUCTURE
      namespaces:
        symbol props katech
      cpp implementation data type element nID: type-reference={inplace=false, type-reference=int64_t}
      cpp implementation data type element vRoads: type-reference={inplace=false, type-reference=ROAD_CONNECTIVITY_VECTOR}
    ROAD_CONNECTIVITY: category=STRUCTURE
      namespaces:
        symbol props katech
      11 x cpp implementation data type element:
        nDirection: type-reference={inplace=false, type-reference=int16_t}
        nMaxSpeed: type-reference={inplace=false, type-reference=int8_t}
        fLength: type-reference={inplace=false, type-reference=float}
        dStartX: type-reference={inplace=false, type-reference=double}
        dStartY: type-reference={inplace=false, type-reference=double}
        dEndX: type-reference={inplace=false, type-reference=double}
        dEndY: type-reference={inplace=false, type-reference=double}
        nID: type-reference={inplace=false, type-reference=int64_t}
        vPredecessor: type-reference={inplace=false, type-reference=RPConnectionVector}
        vSuccessor: type-reference={inplace=false, type-reference=RPConnectionVector}
        vLanes: type-reference={inplace=false, type-reference=LANE_CONNECTIVITY_VECTOR}
    LANE_CONNECTIVITY: category=STRUCTURE
      namespaces:
        symbol props katech
      15 x cpp implementation data type element:
        nLaneIndex: type-reference={inplace=false, type-reference=int8_t}
        nMaxSpeed: type-reference={inplace=false, type-reference=int8_t}
        nDirection: type-reference={inplace=false, type-reference=int16_t}
        fLength: type-reference={inplace=false, type-reference=float}
        dStartX: type-reference={inplace=false, type-reference=double}
        dStartY: type-reference={inplace=false, type-reference=double}
        dEndX: type-reference={inplace=false, type-reference=double}
        dEndY: type-reference={inplace=false, type-reference=double}
        nID: type-reference={inplace=false, type-reference=int64_t}
        nR_LinkID: type-reference={inplace=false, type-reference=int64_t}
        nL_LinkID: type-reference={inplace=false, type-reference=int64_t}
        vLeftLine: type-reference={inplace=false, type-reference=int64Vector}
        vRightLine: type-reference={inplace=false, type-reference=int64Vector}
        vPrevLane: type-reference={inplace=false, type-reference=RPConnectionVector}
        vNextLane: type-reference={inplace=false, type-reference=RPConnectionVector}
    RPConnectionStruct: category=STRUCTURE
      namespaces:
        symbol props katech
      cpp implementation data type element nIndex: type-reference={inplace=false, type-reference=int8_t}
      cpp implementation data type element nDirection: type-reference={inplace=false, type-reference=int16_t}
      cpp implementation data type element nID: type-reference={inplace=false, type-reference=int64_t}
    ROAD_CONNECTIVITY_VECTOR: category=VECTOR, cpp-template-argument=ROAD_CONNECTIVITY
    LANE_CONNECTIVITY_VECTOR: category=VECTOR, cpp-template-argument=LANE_CONNECTIVITY
    RPConnectionVector: category=VECTOR, cpp-template-argument=RPConnectionStruct
    int64Vector: category=VECTOR, cpp-template-argument=int64_t
    RoadVector: category=VECTOR, cpp-template-argument=RoadStruct
    JunctionVector: category=VECTOR, cpp-template-argument=JunctionStruct
    StopLineVector: category=VECTOR, cpp-template-argument=StopLineStruct
    BorderVector: category=VECTOR, cpp-template-argument=BorderStruct
    ParkingLotVector: category=VECTOR, cpp-template-argument=ParkingLotStruct
    CrossWalkVector: category=VECTOR, cpp-template-argument=CrossWalkStruct
    LaneVector: category=VECTOR, cpp-template-argument=LaneStruct
    LineVector: category=VECTOR, cpp-template-argument=LineStruct
    TrafficLightVector: category=VECTOR, cpp-template-argument=TrafficLightStruct
    StopSignVector: category=VECTOR, cpp-template-argument=StopSignStruct
    YieldSignVector: category=VECTOR, cpp-template-argument=YieldSignStruct
    SpeedBumpVector: category=VECTOR, cpp-template-argument=SpeedBumpStruct
    ConnectionVector: category=VECTOR, cpp-template-argument=ConnectionStruct
    LaneLinkVector: category=VECTOR, cpp-template-argument=LaneLinkStruct
    VertexVector: category=VECTOR, cpp-template-argument=VertexStruct
    RoadStruct: category=STRUCTURE
      namespaces:
        symbol props katech
      13 x cpp implementation data type element:
        ID: type-reference={inplace=false, type-reference=int64_t}
        JunctionID: type-reference={inplace=false, type-reference=int64_t}
        Predecessor: type-reference={inplace=false, type-reference=int64Vector}
        Successor: type-reference={inplace=false, type-reference=int64Vector}
        Length: type-reference={inplace=false, type-reference=double}
        LaneCnt: type-reference={inplace=false, type-reference=int8_t}
        Lanes: type-reference={inplace=false, type-reference=LaneVector}
        Lines: type-reference={inplace=false, type-reference=LineVector}
        CrossWalks: type-reference={inplace=false, type-reference=CrossWalkVector}
        TrafficLights: type-reference={inplace=false, type-reference=TrafficLightVector}
        StopSigns: type-reference={inplace=false, type-reference=StopSignVector}
        YieldSigns: type-reference={inplace=false, type-reference=YieldSignVector}
        SpeedBumps: type-reference={inplace=false, type-reference=SpeedBumpVector}
    JunctionStruct: category=STRUCTURE
      namespaces:
        symbol props katech
      cpp implementation data type element ID: type-reference={inplace=false, type-reference=int64_t}
      cpp implementation data type element Type: type-reference={inplace=false, type-reference=int8_t}
      cpp implementation data type element Connections: type-reference={inplace=false, type-reference=ConnectionVector}
    ConnectionStruct: category=STRUCTURE
      namespaces:
        symbol props katech
      6 x cpp implementation data type element:
        ID: type-reference={inplace=false, type-reference=int8_t}
        IncomingRoadID: type-reference={inplace=false, type-reference=int64_t}
        ConnectingRoadID: type-reference={inplace=false, type-reference=int64_t}
        ContactPoint: type-reference={inplace=false, type-reference=int8_t}
        Type: type-reference={inplace=false, type-reference=int8_t}
        LaneLinks: type-reference={inplace=false, type-reference=LaneLinkVector}
    LaneLinkStruct: category=STRUCTURE
      namespaces:
        symbol props katech
      cpp implementation data type element From: type-reference={inplace=false, type-reference=int8_t}
      cpp implementation data type element To: type-reference={inplace=false, type-reference=int8_t}
    VertexStruct: category=STRUCTURE
      namespaces:
        symbol props katech
      cpp implementation data type element x: type-reference={inplace=false, type-reference=double}
      cpp implementation data type element y: type-reference={inplace=false, type-reference=double}
      cpp implementation data type element z: type-reference={inplace=false, type-reference=double}
    LaneStruct: category=STRUCTURE
      namespaces:
        symbol props katech
      16 x cpp implementation data type element:
        ID: type-reference={inplace=false, type-reference=int64_t}
        LaneIndex: type-reference={inplace=false, type-reference=int8_t}
        LaneNo: type-reference={inplace=false, type-reference=int8_t}
        RoadRank: type-reference={inplace=false, type-reference=int8_t}
        RoadType: type-reference={inplace=false, type-reference=int8_t}
        LinkType: type-reference={inplace=false, type-reference=int8_t}
        MaxSpeed: type-reference={inplace=false, type-reference=int8_t}
        SectionKind: type-reference={inplace=false, type-reference=int8_t}
        RoadDirection: type-reference={inplace=false, type-reference=int8_t}
        Direction: type-reference={inplace=false, type-reference=int8_t}
        R_LinkID: type-reference={inplace=false, type-reference=int64_t}
        L_LinkID: type-reference={inplace=false, type-reference=int64_t}
        Length: type-reference={inplace=false, type-reference=double}
        Predecessor: type-reference={inplace=false, type-reference=int64Vector}
        Successor: type-reference={inplace=false, type-reference=int64Vector}
        Geometry: type-reference={inplace=false, type-reference=VertexVector}
    LineStruct: category=STRUCTURE
      namespaces:
        symbol props katech
      6 x cpp implementation data type element:
        ID: type-reference={inplace=false, type-reference=int64_t}
        Type: type-reference={inplace=false, type-reference=int16_t}
        Kind: type-reference={inplace=false, type-reference=int16_t}
        R_LinkID: type-reference={inplace=false, type-reference=int64_t}
        L_LinkID: type-reference={inplace=false, type-reference=int64_t}
        Geometry: type-reference={inplace=false, type-reference=VertexVector}
    BorderStruct: category=STRUCTURE
      namespaces:
        symbol props katech
      6 x cpp implementation data type element:
        ID: type-reference={inplace=false, type-reference=int64_t}
        Type: type-reference={inplace=false, type-reference=int16_t}
        IsCentral: type-reference={inplace=false, type-reference=int16_t}
        LowHigh: type-reference={inplace=false, type-reference=int16_t}
        Ref_FID: type-reference={inplace=false, type-reference=int64_t}
        Geometry: type-reference={inplace=false, type-reference=VertexVector}
    StopLineStruct: category=STRUCTURE
      namespaces:
        symbol props katech
      6 x cpp implementation data type element:
        ID: type-reference={inplace=false, type-reference=int64_t}
        Type: type-reference={inplace=false, type-reference=int16_t}
        Kind: type-reference={inplace=false, type-reference=int16_t}
        R_LinkID: type-reference={inplace=false, type-reference=int64_t}
        L_LinkID: type-reference={inplace=false, type-reference=int64_t}
        Geometry: type-reference={inplace=false, type-reference=VertexVector}
    CrossWalkStruct: category=STRUCTURE
      namespaces:
        symbol props katech
      5 x cpp implementation data type element:
        ID: type-reference={inplace=false, type-reference=int64_t}
        Type: type-reference={inplace=false, type-reference=int8_t}
        Kind: type-reference={inplace=false, type-reference=int16_t}
        LinkID: type-reference={inplace=false, type-reference=int64_t}
        Geometry: type-reference={inplace=false, type-reference=VertexVector}
    TrafficLightStruct: category=STRUCTURE
      namespaces:
        symbol props katech
      6 x cpp implementation data type element:
        ID: type-reference={inplace=false, type-reference=int64_t}
        Type: type-reference={inplace=false, type-reference=int16_t}
        LinkID: type-reference={inplace=false, type-reference=int64_t}
        PostID: type-reference={inplace=false, type-reference=int64_t}
        Ref_Lane: type-reference={inplace=false, type-reference=int16_t}
        Geometry: type-reference={inplace=false, type-reference=VertexVector}
    StopSignStruct: category=STRUCTURE
      namespaces:
        symbol props katech
      5 x cpp implementation data type element:
        ID: type-reference={inplace=false, type-reference=int64_t}
        LinkID: type-reference={inplace=false, type-reference=int64_t}
        PostID: type-reference={inplace=false, type-reference=int64_t}
        Ref_Lane: type-reference={inplace=false, type-reference=int16_t}
        Geometry: type-reference={inplace=false, type-reference=VertexVector}
    YieldSignStruct: category=STRUCTURE
      namespaces:
        symbol props katech
      5 x cpp implementation data type element:
        ID: type-reference={inplace=false, type-reference=int64_t}
        LinkID: type-reference={inplace=false, type-reference=int64_t}
        PostID: type-reference={inplace=false, type-reference=int64_t}
        Ref_Lane: type-reference={inplace=false, type-reference=int16_t}
        Geometry: type-reference={inplace=false, type-reference=VertexVector}
    SpeedBumpStruct: category=STRUCTURE
      namespaces:
        symbol props katech
      5 x cpp implementation data type element:
        ID: type-reference={inplace=false, type-reference=int64_t}
        Type: type-reference={inplace=false, type-reference=int16_t}
        LinkID: type-reference={inplace=false, type-reference=int64_t}
        Ref_Lane: type-reference={inplace=false, type-reference=int16_t}
        Geometry: type-reference={inplace=false, type-reference=VertexVector}
    ParkingLotStruct: category=STRUCTURE
      namespaces:
        symbol props katech
      cpp implementation data type element ID: type-reference={inplace=false, type-reference=int64_t}
      cpp implementation data type element Type: type-reference={inplace=false, type-reference=int16_t}
      cpp implementation data type element Geometry: type-reference={inplace=false, type-reference=VertexVector}
