AUTOSAR XML (schema 00052)
package /katech/deployment
  someip service interface deployment someip_collect_fault_control: service-interface=collect_fault_control, service-interface-id=20001, service-interface-version={major-version=1, minor-version=0}
    someip event deployment SomeipEventCollectFaultControl: event=collectFaultControlEvent, event-id=1, transport-protocol=UDP
    someip event group SomeipEventgroup1: event-group-id=1, event=SomeipEventCollectFaultControl
