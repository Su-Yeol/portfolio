AUTOSAR XML (schema 00052)
package /katech/deployment
  someip service interface deployment someip_perception_obstacles: service-interface=perception_obstacles, service-interface-id=10001, service-interface-version={major-version=1, minor-version=0}
    someip event deployment SomeipEventPerceptionObstacles: event=perceptionObstaclesEvent, event-id=1, transport-protocol=UDP
    someip event group SomeipEventgroup1: event-group-id=1, event=SomeipEventPerceptionObstacles
