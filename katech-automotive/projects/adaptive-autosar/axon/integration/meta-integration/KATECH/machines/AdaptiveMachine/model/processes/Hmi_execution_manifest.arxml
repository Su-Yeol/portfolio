AUTOSAR XML (schema 00052)
package /katech/Machines/AdaptiveMachine/ProcessToMachineMappings
  process to machine mapping set Hmi
    process to machine mapping Hmi: machine=AdaptiveMachine, process=Hmi
package /katech/Machines/AdaptiveMachine/DltLogChannelToProcessMappings
  dlt application to process mapping HmiDltApplicationToProcessMapping: dlt-application=Hmi, process=Hmi
  dlt log sink to port prototype mapping HmiDltLogSinkToPortPrototypeMapping: dlt-context=DefaultDltContext, dlt-log-sink=[ConsoleDltSink, RemoteDltSink, HmiFileDltSink], process=Hmi
package /katech/Machines/AdaptiveMachine/Processes
  process Hmi: executable=Hmi, state-dependent-startup-config{execution-dependencys=[state_machine.Running, state_machine.Running], function-group-state=MachineFG.Driving, resource-group=ResourceGroupKATECH, startup-config=Hmi}
    process state machine state_machine: type=ProcessStateMachine
package /katech/Machines/AdaptiveMachine/ServiceInstanceToPortPrototypeMappings
  11 x service instance to port prototype mapping, all with process=Hmi:
    ProvidedServiceInstance_toPort_hmi_collect_fault_hmi: port-prototype=PPort_collect_fault_hmi, service-instance=ProvidedSomeipServiceInstance_collect_fault_hmi
    ProvidedServiceInstance_toPort_hmi_routing_search: port-prototype=PPort_routing_search, service-instance=ProvidedSomeipServiceInstance_routing_search
    RequiredServiceInstance_toPort_hmi_can_data: port-prototype=RPort_can_data, service-instance=RequiredSomeipServiceInstance_can_data
    RequiredServiceInstance_toPort_hmi_can_data_etc: port-prototype=RPort_can_data_etc, service-instance=RequiredSomeipServiceInstance_can_data_etc
    RequiredServiceInstance_toPort_hmi_driving_trajectory: port-prototype=RPort_driving_trajectory, service-instance=RequiredSomeipServiceInstance_driving_trajectory
    RequiredServiceInstance_toPort_hmi_local_map: port-prototype=RPort_local_map, service-instance=RequiredSomeipServiceInstance_local_map
    RequiredServiceInstance_toPort_hmi_perception_obstacles: port-prototype=RPort_perception_obstacles, service-instance=RequiredSomeipServiceInstance_perception_obstacles
    RequiredServiceInstance_toPort_hmi_planning_hmi_data: port-prototype=RPort_planning_hmi_data, service-instance=RequiredSomeipServiceInstance_planning_hmi_data
    RequiredServiceInstance_toPort_hmi_routing_result: port-prototype=RPort_routing_result, service-instance=RequiredSomeipServiceInstance_routing_result
    RequiredServiceInstance_toPort_hmi_traffic_light: port-prototype=RPort_traffic_light, service-instance=RequiredSomeipServiceInstance_traffic_light
    RequiredServiceInstance_toPort_hmi_vehicle_location: port-prototype=RPort_vehicle_location, service-instance=RequiredSomeipServiceInstance_vehicle_location
package /katech/Machines/AdaptiveMachine/StartupConfigSets
  startup config Hmi: environment-variables=tag-with-optional-value={key=VSOMEIP_CONFIGURATION, value=/etc/vsomeip.json}, scheduling-policy=SCHEDULING-POLICY-ROUND-ROBIN, scheduling-priority=12, termination-behavior=PROCESS-IS-NOT-SELF-TERMINATING
