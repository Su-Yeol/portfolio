AUTOSAR XML (schema 00052)
package /katech/Machines/AdaptiveMachine/ServiceInstanceToMachineMappings
  someip service instance to machine mapping ProvidedServiceInstance_toMachine_perception_obstacles: communication-connector=AdaptiveMachineConnector, service-instance=ProvidedSomeipServiceInstance_perception_obstacles, udp-port=PerceptionObstaclesProviderEndpoint
  someip service instance to machine mapping RequiredServiceInstance_toMachine_perception_obstacles: communication-connector=AdaptiveMachineConnector, service-instance=RequiredSomeipServiceInstance_perception_obstacles, udp-port=PerceptionObstaclesSubscriberEndpoint
package /katech/Machines/AdaptiveMachine/ServiceInstances
  provided someip service instance ProvidedSomeipServiceInstance_perception_obstacles: service-interface-deployment=someip_perception_obstacles, sd-server-config=SomeipSdServerServiceInstanceConfig, service-instance-id=1001
    someip provided event group ProvidedEventgroup1: event-group=SomeipEventgroup1, multicast-threshold=0
  required someip service instance RequiredSomeipServiceInstance_perception_obstacles: service-interface-deployment=someip_perception_obstacles, required-minor-version=0, required-service-instance-id=1001, sd-client-config=SomeipSdClientServiceInstanceConfig, version-driven-find-behavior=MINIMUM-MINOR-VERSION
    someip required event group RequiredEventgroup1: event-group=SomeipEventgroup1
