AUTOSAR XML (schema 00052)
package /katech/Machines/AdaptiveMachine/ProcessToMachineMappings
  process to machine mapping set Routing
    process to machine mapping Routing: machine=AdaptiveMachine, process=Routing
package /katech/Machines/AdaptiveMachine/DltLogChannelToProcessMappings
  dlt application to process mapping RoutingDltApplicationToProcessMapping: dlt-application=Routing, process=Routing
  dlt log sink to port prototype mapping RoutingDltLogSinkToPortPrototypeMapping: dlt-context=DefaultDltContext, dlt-log-sink=[ConsoleDltSink, RemoteDltSink, RoutingFileDltSink], process=Routing
package /katech/Machines/AdaptiveMachine/Processes
  process Routing: executable=Routing, state-dependent-startup-config{execution-dependencys=[state_machine.Running, state_machine.Running], function-group-state=MachineFG.Driving, resource-group=ResourceGroupKATECH, startup-config=Routing}
    process state machine state_machine: type=ProcessStateMachine
package /katech/Machines/AdaptiveMachine/ServiceInstanceToPortPrototypeMappings
  5 x service instance to port prototype mapping, all with process=Routing:
    ProvidedServiceInstance_toPort_routing_collect_fault_routing: port-prototype=PPort_collect_fault_routing, service-instance=ProvidedSomeipServiceInstance_collect_fault_routing
    ProvidedServiceInstance_toPort_routing_routing_result: port-prototype=PPort_routing_result, service-instance=ProvidedSomeipServiceInstance_routing_result
    RequiredServiceInstance_toPort_routing_local_map: port-prototype=RPort_local_map, service-instance=RequiredSomeipServiceInstance_local_map
    RequiredServiceInstance_toPort_routing_matching_info: port-prototype=RPort_matching_info, service-instance=RequiredSomeipServiceInstance_matching_info
    RequiredServiceInstance_toPort_routing_routing_search: port-prototype=RPort_routing_search, service-instance=RequiredSomeipServiceInstance_routing_search
package /katech/Machines/AdaptiveMachine/StartupConfigSets
  startup config Routing: environment-variables=tag-with-optional-value={key=VSOMEIP_CONFIGURATION, value=/etc/vsomeip.json}, scheduling-policy=SCHEDULING-POLICY-ROUND-ROBIN, scheduling-priority=12, termination-behavior=PROCESS-IS-NOT-SELF-TERMINATING
