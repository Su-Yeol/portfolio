AUTOSAR XML (schema 00052)
package /katech/Machines/AdaptiveMachine/ServiceInstanceToMachineMappings
  someip service instance to machine mapping ProvidedServiceInstance_toMachine_collect_fault_hmi: communication-connector=AdaptiveMachineConnector, service-instance=ProvidedSomeipServiceInstance_collect_fault_hmi, udp-port=CollectFaultHmiProviderEndpoint
  someip service instance to machine mapping RequiredServiceInstance_toMachine_collect_fault_hmi: communication-connector=AdaptiveMachineConnector, service-instance=RequiredSomeipServiceInstance_collect_fault_hmi, udp-port=CollectFaultHmiSubscriberEndpoint
package /katech/Machines/AdaptiveMachine/ServiceInstances
  provided someip service instance ProvidedSomeipServiceInstance_collect_fault_hmi: service-interface-deployment=someip_collect_fault_hmi, sd-server-config=SomeipSdServerServiceInstanceConfig, service-instance-id=2201
    someip provided event group ProvidedEventgroup1: event-group=SomeipEventgroup1, multicast-threshold=0
  required someip service instance RequiredSomeipServiceInstance_collect_fault_hmi: service-interface-deployment=someip_collect_fault_hmi, required-minor-version=0, required-service-instance-id=2201, sd-client-config=SomeipSdClientServiceInstanceConfig, version-driven-find-behavior=MINIMUM-MINOR-VERSION
    someip required event group RequiredEventgroup1: event-group=SomeipEventgroup1
