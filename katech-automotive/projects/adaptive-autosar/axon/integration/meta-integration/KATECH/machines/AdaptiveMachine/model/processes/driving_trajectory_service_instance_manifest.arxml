AUTOSAR XML (schema 00052)
package /katech/Machines/AdaptiveMachine/ServiceInstanceToMachineMappings
  someip service instance to machine mapping ProvidedServiceInstance_toMachine_driving_trajectory: communication-connector=AdaptiveMachineConnector, service-instance=ProvidedSomeipServiceInstance_driving_trajectory, udp-port=DrivingTrajectoryProviderEndpoint
  someip service instance to machine mapping RequiredServiceInstance_toMachine_driving_trajectory: communication-connector=AdaptiveMachineConnector, service-instance=RequiredSomeipServiceInstance_driving_trajectory, udp-port=DrivingTrajectorySubscriberEndpoint
package /katech/Machines/AdaptiveMachine/ServiceInstances
  provided someip service instance ProvidedSomeipServiceInstance_driving_trajectory: service-interface-deployment=someip_driving_trajectory, sd-server-config=SomeipSdServerServiceInstanceConfig, service-instance-id=501
    someip provided event group ProvidedEventgroup1: event-group=SomeipEventgroup1, multicast-threshold=0
  required someip service instance RequiredSomeipServiceInstance_driving_trajectory: service-interface-deployment=someip_driving_trajectory, required-minor-version=0, required-service-instance-id=501, sd-client-config=SomeipSdClientServiceInstanceConfig, version-driven-find-behavior=MINIMUM-MINOR-VERSION
    someip required event group RequiredEventgroup1: event-group=SomeipEventgroup1
