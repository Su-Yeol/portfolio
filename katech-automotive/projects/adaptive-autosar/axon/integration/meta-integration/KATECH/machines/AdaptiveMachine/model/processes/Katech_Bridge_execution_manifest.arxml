AUTOSAR XML (schema 00052)
package /katech/Machines/AdaptiveMachine/ProcessToMachineMappings
  process to machine mapping set Katech_Bridge
    process to machine mapping Katech_Bridge: machine=AdaptiveMachine, process=Katech_Bridge
package /katech/Machines/AdaptiveMachine/DltLogChannelToProcessMappings
  dlt application to process mapping KatechBridgeDltApplicationToProcessMapping: dlt-application=Katech_Bridge, process=Katech_Bridge
  dlt log sink to port prototype mapping KatechBridgeDltLogSinkToPortPrototypeMapping: dlt-context=DefaultDltContext, dlt-log-sink=[ConsoleDltSink, RemoteDltSink, KatechBridgeFileDltSink], process=Katech_Bridge
package /katech/Machines/AdaptiveMachine/Processes
  process Katech_Bridge: executable=Katech_Bridge, state-dependent-startup-config{function-group-state=MachineFG.Driving, resource-group=ResourceGroupKATECH, startup-config=Katech_Bridge}
    process state machine state_machine: type=ProcessStateMachine
package /katech/Machines/AdaptiveMachine/ServiceInstanceToPortPrototypeMappings
  service instance to port prototype mapping ProvidedServiceInstance_toPort_katech_bridge_bridge_control: port-prototype=PPort_bridge_control, process=Katech_Bridge, service-instance=ProvidedSomeipServiceInstance_bridge_control
  service instance to port prototype mapping RequiredServiceInstance_toPort_katech_bridge_control_bridge: port-prototype=RPort_control_bridge, process=Katech_Bridge, service-instance=RequiredSomeipServiceInstance_control_bridge
package /katech/Machines/AdaptiveMachine/StartupConfigSets
  startup config Katech_Bridge: environment-variables=tag-with-optional-value={key=VSOMEIP_CONFIGURATION, value=/etc/vsomeip.json}, scheduling-policy=SCHEDULING-POLICY-ROUND-ROBIN, scheduling-priority=12, termination-behavior=PROCESS-IS-NOT-SELF-TERMINATING
