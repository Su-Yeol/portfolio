AUTOSAR XML (schema 00052)
package /katech/Machines/AdaptiveMachine/ServiceInstanceToMachineMappings
  someip service instance to machine mapping ProvidedServiceInstance_toMachine_semantic_map: communication-connector=AdaptiveMachineConnector, service-instance=ProvidedSomeipServiceInstance_semantic_map, udp-port=SemanticMapProviderEndpoint
  someip service instance to machine mapping RequiredServiceInstance_toMachine_semantic_map: communication-connector=AdaptiveMachineConnector, service-instance=RequiredSomeipServiceInstance_semantic_map, udp-port=SemanticMapSubscriberEndpoint
package /katech/Machines/AdaptiveMachine/ServiceInstances
  provided someip service instance ProvidedSomeipServiceInstance_semantic_map: service-interface-deployment=Someip_semantic_map, sd-server-config=SomeipSdServerServiceInstanceConfig, service-instance-id=1601
    someip provided event group ProvidedEventgroup1: event-group=SomeipEventgroup1, multicast-threshold=0
  required someip service instance RequiredSomeipServiceInstance_semantic_map: service-interface-deployment=Someip_semantic_map, required-minor-version=0, required-service-instance-id=1601, sd-client-config=SomeipSdClientServiceInstanceConfig, version-driven-find-behavior=MINIMUM-MINOR-VERSION
    someip required event group RequiredEventgroup1: event-group=SomeipEventgroup1
