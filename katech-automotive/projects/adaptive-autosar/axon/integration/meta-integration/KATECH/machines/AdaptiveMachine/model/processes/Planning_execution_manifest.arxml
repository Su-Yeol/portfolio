AUTOSAR XML (schema 00052)
package /katech/Machines/AdaptiveMachine/ProcessToMachineMappings
  process to machine mapping set Planning
    process to machine mapping Planning: machine=AdaptiveMachine, process=Planning
package /katech/Machines/AdaptiveMachine/DltLogChannelToProcessMappings
  dlt application to process mapping PlanningDltApplicationToProcessMapping: dlt-application=Planning, process=Planning
  dlt log sink to port prototype mapping PlanningDltLogSinkToPortPrototypeMapping: dlt-context=DefaultDltContext, dlt-log-sink=[ConsoleDltSink, RemoteDltSink, PlanningFileDltSink], process=Planning
package /katech/Machines/AdaptiveMachine/Processes
  process Planning: executable=Planning, state-dependent-startup-config{execution-dependencys=[state_machine.Running, state_machine.Running], function-group-state=MachineFG.Driving, resource-group=ResourceGroupKATECH, startup-config=Planning}
    process state machine state_machine: type=ProcessStateMachine
package /katech/Machines/AdaptiveMachine/ServiceInstanceToPortPrototypeMappings
  15 x service instance to port prototype mapping, all with process=Planning:
    ProvidedServiceInstance_toPort_planning_collect_fault_planning: port-prototype=PPort_collect_fault_planning, service-instance=ProvidedSomeipServiceInstance_collect_fault_planning
    ProvidedServiceInstance_toPort_planning_driving_trajectory: port-prototype=PPort_driving_trajectory, service-instance=ProvidedSomeipServiceInstance_driving_trajectory
    ProvidedServiceInstance_toPort_planning_planning_hmi_data: port-prototype=PPort_planning_hmi_data, service-instance=ProvidedSomeipServiceInstance_planning_hmi_data
    ProvidedServiceInstance_toPort_planning_smart_cruise_control: port-prototype=PPort_smart_cruise_control, service-instance=ProvidedSomeipServiceInstance_smart_cruise_control
    RequiredServiceInstance_toPort_planning_can_data: port-prototype=RPort_can_data, service-instance=RequiredSomeipServiceInstance_can_data
    RequiredServiceInstance_toPort_planning_can_data_etc: port-prototype=RPort_can_data_etc, service-instance=RequiredSomeipServiceInstance_can_data_etc
    RequiredServiceInstance_toPort_planning_emergency_braking: port-prototype=RPort_emergency_braking, service-instance=RequiredSomeipServiceInstance_emergency_braking
    RequiredServiceInstance_toPort_planning_local_map: port-prototype=RPort_local_map, service-instance=RequiredSomeipServiceInstance_local_map
    RequiredServiceInstance_toPort_planning_perception_obstacles: port-prototype=RPort_perception_obstacles, service-instance=RequiredSomeipServiceInstance_perception_obstacles
    RequiredServiceInstance_toPort_planning_report_fault: port-prototype=RPort_report_fault, service-instance=RequiredSomeipServiceInstance_report_fault
    RequiredServiceInstance_toPort_planning_routing_result: port-prototype=RPort_routing_result, service-instance=RequiredSomeipServiceInstance_routing_result
    RequiredServiceInstance_toPort_planning_sensor_radar: port-prototype=RPort_sensor_radar, service-instance=RequiredSomeipServiceInstance_sensor_radar
    RequiredServiceInstance_toPort_planning_traffic_light: port-prototype=RPort_traffic_light, service-instance=RequiredSomeipServiceInstance_traffic_light
    RequiredServiceInstance_toPort_planning_v2x_data: port-prototype=RPort_v2x_data, service-instance=RequiredSomeipServiceInstance_v2x_data
    RequiredServiceInstance_toPort_planning_vehicle_location: port-prototype=RPort_vehicle_location, service-instance=RequiredSomeipServiceInstance_vehicle_location
package /katech/Machines/AdaptiveMachine/StartupConfigSets
  startup config Planning: environment-variables=tag-with-optional-value={key=VSOMEIP_CONFIGURATION, value=/etc/vsomeip.json}, scheduling-policy=SCHEDULING-POLICY-ROUND-ROBIN, scheduling-priority=12, termination-behavior=PROCESS-IS-NOT-SELF-TERMINATING
