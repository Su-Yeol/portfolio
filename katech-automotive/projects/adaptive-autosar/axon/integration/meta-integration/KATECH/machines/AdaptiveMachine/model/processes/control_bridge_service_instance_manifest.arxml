AUTOSAR XML (schema 00052)
package /katech/Machines/AdaptiveMachine/ServiceInstanceToMachineMappings
  someip service instance to machine mapping ProvidedServiceInstance_toMachine_control_bridge: communication-connector=AdaptiveMachineConnector, service-instance=ProvidedSomeipServiceInstance_control_bridge, udp-port=ControlBridgeProviderEndpoint
  someip service instance to machine mapping RequiredServiceInstance_toMachine_control_bridge: communication-connector=AdaptiveMachineConnector, service-instance=RequiredSomeipServiceInstance_control_bridge, udp-port=ControlBridgeSubscriberEndpoint
package /katech/Machines/AdaptiveMachine/ServiceInstances
  provided someip service instance ProvidedSomeipServiceInstance_control_bridge: service-interface-deployment=someip_control_bridge, sd-server-config=SomeipSdServerServiceInstanceConfig, service-instance-id=3501
    someip provided event group ProvidedEventgroup1: event-group=SomeipEventgroup1, multicast-threshold=0
  required someip service instance RequiredSomeipServiceInstance_control_bridge: service-interface-deployment=someip_control_bridge, required-minor-version=0, required-service-instance-id=3501, sd-client-config=SomeipSdClientServiceInstanceConfig, version-driven-find-behavior=MINIMUM-MINOR-VERSION
    someip required event group RequiredEventgroup1: event-group=SomeipEventgroup1
