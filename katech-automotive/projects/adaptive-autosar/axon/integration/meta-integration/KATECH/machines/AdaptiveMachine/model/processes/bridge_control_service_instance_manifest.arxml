AUTOSAR XML (schema 00052)
package /katech/Machines/AdaptiveMachine/ServiceInstanceToMachineMappings
  someip service instance to machine mapping ProvidedServiceInstance_toMachine_bridge_control: communication-connector=AdaptiveMachineConnector, service-instance=ProvidedSomeipServiceInstance_bridge_control, udp-port=BridgeControlProviderEndpoint
  someip service instance to machine mapping RequiredServiceInstance_toMachine_bridge_control: communication-connector=AdaptiveMachineConnector, service-instance=RequiredSomeipServiceInstance_bridge_control, udp-port=BridgeControlSubscriberEndpoint
package /katech/Machines/AdaptiveMachine/ServiceInstances
  provided someip service instance ProvidedSomeipServiceInstance_bridge_control: service-interface-deployment=someip_bridge_control, sd-server-config=SomeipSdServerServiceInstanceConfig, service-instance-id=3601
    someip provided event group ProvidedEventgroup1: event-group=SomeipEventgroup1, multicast-threshold=0
  required someip service instance RequiredSomeipServiceInstance_bridge_control: service-interface-deployment=someip_bridge_control, required-minor-version=0, required-service-instance-id=3601, sd-client-config=SomeipSdClientServiceInstanceConfig, version-driven-find-behavior=MINIMUM-MINOR-VERSION
    someip required event group RequiredEventgroup1: event-group=SomeipEventgroup1
