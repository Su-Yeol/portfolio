AUTOSAR XML (schema 00052)
package /katech/Machines/AdaptiveMachine/ServiceInstanceToMachineMappings
  someip service instance to machine mapping ProvidedServiceInstance_toMachine_routing_path: communication-connector=AdaptiveMachineConnector, service-instance=ProvidedSomeipServiceInstance_routing_path, udp-port=RoutingPathProviderEndpoint
  someip service instance to machine mapping RequiredServiceInstance_toMachine_routing_path: communication-connector=AdaptiveMachineConnector, service-instance=RequiredSomeipServiceInstance_routing_path, udp-port=RoutingPathSubscriberEndpoint
package /katech/Machines/AdaptiveMachine/ServiceInstances
  provided someip service instance ProvidedSomeipServiceInstance_routing_path: service-interface-deployment=Someip_routing_path, sd-server-config=SomeipSdServerServiceInstanceConfig, service-instance-id=1301
    someip provided event group ProvidedEventgroup1: event-group=SomeipEventgroup1, multicast-threshold=0
  required someip service instance RequiredSomeipServiceInstance_routing_path: service-interface-deployment=Someip_routing_path, required-minor-version=0, required-service-instance-id=1301, sd-client-config=SomeipSdClientServiceInstanceConfig, version-driven-find-behavior=MINIMUM-MINOR-VERSION
    someip required event group RequiredEventgroup1: event-group=SomeipEventgroup1
