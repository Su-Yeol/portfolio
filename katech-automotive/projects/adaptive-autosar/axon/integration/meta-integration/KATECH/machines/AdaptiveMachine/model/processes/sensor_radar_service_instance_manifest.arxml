AUTOSAR XML (schema 00052)
package /katech/Machines/AdaptiveMachine/ServiceInstanceToMachineMappings
  someip service instance to machine mapping ProvidedServiceInstance_toMachine_sensor_radar: communication-connector=AdaptiveMachineConnector, service-instance=ProvidedSomeipServiceInstance_sensor_radar, udp-port=SensorRadarProviderEndpoint
  someip service instance to machine mapping RequiredServiceInstance_toMachine_sensor_radar: communication-connector=AdaptiveMachineConnector, service-instance=RequiredSomeipServiceInstance_sensor_radar, udp-port=SensorRadarSubscriberEndpoint
package /katech/Machines/AdaptiveMachine/ServiceInstances
  provided someip service instance ProvidedSomeipServiceInstance_sensor_radar: service-interface-deployment=someip_sensor_radar, sd-server-config=SomeipSdServerServiceInstanceConfig, service-instance-id=3101
    someip provided event group ProvidedEventgroup1: event-group=SomeipEventgroup1, multicast-threshold=0
  required someip service instance RequiredSomeipServiceInstance_sensor_radar: service-interface-deployment=someip_sensor_radar, required-minor-version=0, required-service-instance-id=3101, sd-client-config=SomeipSdClientServiceInstanceConfig, version-driven-find-behavior=MINIMUM-MINOR-VERSION
    someip required event group RequiredEventgroup1: event-group=SomeipEventgroup1
