AUTOSAR XML (schema 00052)
package /katech/Machines/AdaptiveMachine/ProcessToMachineMappings
  process to machine mapping set Hdmap
    process to machine mapping Hdmap: machine=AdaptiveMachine, process=Hdmap
package /katech/Machines/AdaptiveMachine/DltLogChannelToProcessMappings
  dlt application to process mapping HdmapDltApplicationToProcessMapping: dlt-application=Hdmap, process=Hdmap
  dlt log sink to port prototype mapping HdmapDltLogSinkToPortPrototypeMapping: dlt-context=DefaultDltContext, dlt-log-sink=[ConsoleDltSink, RemoteDltSink, HdmapFileDltSink], process=Hdmap
package /katech/Machines/AdaptiveMachine/Processes
  process Hdmap: executable=Hdmap, state-dependent-startup-config{execution-dependency=state_machine.Running, function-group-state=MachineFG.Driving, resource-group=ResourceGroupKATECH, startup-config=Hdmap}
    process state machine state_machine: type=ProcessStateMachine
package /katech/Machines/AdaptiveMachine/ServiceInstanceToPortPrototypeMappings
  5 x service instance to port prototype mapping, all with process=Hdmap:
    ProvidedServiceInstance_toPort_hdmap_collect_fault_hdmap: port-prototype=PPort_collect_fault_hdmap, service-instance=ProvidedSomeipServiceInstance_collect_fault_hdmap
    ProvidedServiceInstance_toPort_hdmap_local_map: port-prototype=PPort_local_map, service-instance=ProvidedSomeipServiceInstance_local_map
    ProvidedServiceInstance_toPort_hdmap_point_map: port-prototype=PPort_point_map, service-instance=ProvidedSomeipServiceInstance_point_map
    RequiredServiceInstance_toPort_hdmap_routing_search: port-prototype=RPort_routing_search, service-instance=RequiredSomeipServiceInstance_routing_search
    RequiredServiceInstance_toPort_hdmap_vehicle_location: port-prototype=RPort_vehicle_location, service-instance=RequiredSomeipServiceInstance_vehicle_location
package /katech/Machines/AdaptiveMachine/StartupConfigSets
  startup config Hdmap: environment-variables=tag-with-optional-value={key=VSOMEIP_CONFIGURATION, value=/etc/vsomeip.json}, scheduling-policy=SCHEDULING-POLICY-ROUND-ROBIN, scheduling-priority=12, termination-behavior=PROCESS-IS-NOT-SELF-TERMINATING
