AUTOSAR XML (schema 00052)
package /katech/Machines/AdaptiveMachine/ServiceInstanceToMachineMappings
  someip service instance to machine mapping ProvidedServiceInstance_toMachine_emergency_braking: communication-connector=AdaptiveMachineConnector, service-instance=ProvidedSomeipServiceInstance_emergency_braking, udp-port=EmergencyBrakingProviderEndpoint
  someip service instance to machine mapping RequiredServiceInstance_toMachine_emergency_braking: communication-connector=AdaptiveMachineConnector, service-instance=RequiredSomeipServiceInstance_emergency_braking, udp-port=EmergencyBrakingSubscriberEndpoint
package /katech/Machines/AdaptiveMachine/ServiceInstances
  provided someip service instance ProvidedSomeipServiceInstance_emergency_braking: service-interface-deployment=someip_emergency_braking, sd-server-config=SomeipSdServerServiceInstanceConfig, service-instance-id=601
    someip provided event group ProvidedEventgroup1: event-group=SomeipEventgroup1, multicast-threshold=0
  required someip service instance RequiredSomeipServiceInstance_emergency_braking: service-interface-deployment=someip_emergency_braking, required-minor-version=0, required-service-instance-id=601, sd-client-config=SomeipSdClientServiceInstanceConfig, version-driven-find-behavior=MINIMUM-MINOR-VERSION
    someip required event group RequiredEventgroup1: event-group=SomeipEventgroup1
