AUTOSAR XML (schema 00052)
package /katech/Machines/AdaptiveMachine/ServiceInstanceToMachineMappings
  someip service instance to machine mapping ProvidedServiceInstance_toMachine_lane_detection: communication-connector=AdaptiveMachineConnector, service-instance=ProvidedSomeipServiceInstance_lane_detection, udp-port=LaneDetectionProviderEndpoint
  someip service instance to machine mapping RequiredServiceInstance_toMachine_lane_detection: communication-connector=AdaptiveMachineConnector, service-instance=RequiredSomeipServiceInstance_lane_detection, udp-port=LaneDetectionSubscriberEndpoint
package /katech/Machines/AdaptiveMachine/ServiceInstances
  provided someip service instance ProvidedSomeipServiceInstance_lane_detection: service-interface-deployment=someip_lane_detection, sd-server-config=SomeipSdServerServiceInstanceConfig, service-instance-id=701
    someip provided event group ProvidedEventgroup1: event-group=SomeipEventgroup1, multicast-threshold=0
  required someip service instance RequiredSomeipServiceInstance_lane_detection: service-interface-deployment=someip_lane_detection, required-minor-version=0, required-service-instance-id=701, sd-client-config=SomeipSdClientServiceInstanceConfig, version-driven-find-behavior=MINIMUM-MINOR-VERSION
    someip required event group RequiredEventgroup1: event-group=SomeipEventgroup1
