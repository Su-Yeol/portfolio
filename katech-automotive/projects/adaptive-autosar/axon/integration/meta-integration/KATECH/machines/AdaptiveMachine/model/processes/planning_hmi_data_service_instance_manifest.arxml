AUTOSAR XML (schema 00052)
package /katech/Machines/AdaptiveMachine/ServiceInstanceToMachineMappings
  someip service instance to machine mapping ProvidedServiceInstance_toMachine_planning_hmi_data: communication-connector=AdaptiveMachineConnector, service-instance=ProvidedSomeipServiceInstance_planning_hmi_data, udp-port=PlanningHmiDataProviderEndpoint
  someip service instance to machine mapping RequiredServiceInstance_toMachine_planning_hmi_data: communication-connector=AdaptiveMachineConnector, service-instance=RequiredSomeipServiceInstance_planning_hmi_data, udp-port=PlanningHmiDataSubscriberEndpoint
package /katech/Machines/AdaptiveMachine/ServiceInstances
  provided someip service instance ProvidedSomeipServiceInstance_planning_hmi_data: service-interface-deployment=someip_planning_hmi_data, sd-server-config=SomeipSdServerServiceInstanceConfig, service-instance-id=3001
    someip provided event group ProvidedEventgroup1: event-group=SomeipEventgroup1, multicast-threshold=0
  required someip service instance RequiredSomeipServiceInstance_planning_hmi_data: service-interface-deployment=someip_planning_hmi_data, required-minor-version=0, required-service-instance-id=3001, sd-client-config=SomeipSdClientServiceInstanceConfig, version-driven-find-behavior=MINIMUM-MINOR-VERSION
    someip required event group RequiredEventgroup1: event-group=SomeipEventgroup1
