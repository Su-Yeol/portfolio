AUTOSAR XML (schema 00052)
package /katech/Machines/AdaptiveMachine
  machine AdaptiveMachine: default-application-timeout=exit-timeout-value=0.5, environment-variables=tag-with-optional-value={key=DLT_LOG_MODE, value=3}, machine-design=AdaptiveMachineDesign
    module-instantiations:
      log and trace instantiation LogAndTraceInstanciation: log-sink=ConsoleDltSink
      os module instantiation Linux
        resource group ResourceGroupKATECH: cpu-usage=95, mem-usage=12000000000
      ucm master module instantiation UcmInstance: identifier=RadarFusionMachineUCM
    processor DefaultProcessor
      processor core ProcessorCore0: core-id=0
      processor core ProcessorCore1: core-id=1
package /katech/Machines/AdaptiveMachine/E2E
  e 2 e profile configuration set e2eprofiles
    e 2 e profile configuration PROFILE_01: max-delta-counter=1, max-error-state-init=0, max-error-state-invalid=0, max-error-state-valid=0, min-ok-state-init=1, min-ok-state-invalid=1, min-ok-state-valid=1, profile-name=PROFILE_01, window-size-init=1, window-size-invalid=1, window-size-valid=1
package /katech/Machines/AdaptiveMachine/Dlt
  dlt ecu KatechDltEcu
    19 x dlt application, all with contexts=DefaultDltContext:
      Control: application-description=KATECH Control Application, application-id=CONT
      Hdmap: application-description=KATECH Hdmap Application, application-id=HDMA
      Hmi: application-description=KATECH Hmi Application, application-id=HMI
      HubNetAP: application-description=KATECH HubNetAP Application, application-id=HUBN
      Localization: application-description=KATECH Localization Application, application-id=LOCA
      Perception_Camera: application-description=KATECH Perception_Camera Application, application-id=PERC
      Perception_Lidar: application-description=KATECH Perception_Lidar Application, application-id=PERL
      Planning: application-description=KATECH Planning Application, application-id=PLAN
      Prediction: application-description=KATECH Prediction Application, application-id=PRED
      Routing: application-description=KATECH Routing Application, application-id=ROUT
      OTA_Client: application-description=KATECH OTA Client Application, application-id=OTAC
      Control_Katech: application-description=KATECH Control_Katech Application, application-id=CONK
      Decision_Katech: application-description=KATECH Decision_Katech Application, application-id=ROUT
      Planning_Katech: application-description=KATECH Planning_Katech Application, application-id=PLAK
      V2X: application-description=KATECH V2X Application, application-id=V2X
      Guardian: application-description=KATECH Guardian Application, application-id=GUAR
      Katech_Bridge: application-description=KATECH Katech_Bridge Application, application-id=KABR
      TimeSyncProviderApplication: application-description=KATECH TimeSyncProvider Application, application-id=TSYP
      TimeSyncConsumerApplication: application-description=KATECH TimeSyncConsumer Application, application-id=TSYC
  dlt context DefaultDltContext
  22 x dlt log sink, all with default-log-threshold=VERBOSE:
    ConsoleDltSink: category=DLT_LOGSINK_CONSOLE, buffer-output=true
    RemoteDltSink: category=DLT_LOGSINK_REMOTE, log-channel-id=1
    ControlFileDltSink: category=DLT_LOGSINK_FILE, path=/var/redirected/Control
    HdmapFileDltSink: category=DLT_LOGSINK_FILE, path=/var/redirected/Hdmap
    HmiFileDltSink: category=DLT_LOGSINK_FILE, path=/var/redirected/Hmi
    HubNetAPFileDltSink: category=DLT_LOGSINK_FILE, path=/var/redirected/HubNetAP
    LocalizationFileDltSink: category=DLT_LOGSINK_FILE, path=/var/redirected/Localization
    PerceptionCameraFileDltSink: category=DLT_LOGSINK_FILE, path=/var/redirected/Perception_Camera
    PerceptionFileDltSink: category=DLT_LOGSINK_FILE, path=/var/redirected/Perception
    PerceptionLidarFileDltSink: category=DLT_LOGSINK_FILE, path=/var/redirected/Perception_Lidar
    PlanningFileDltSink: category=DLT_LOGSINK_FILE, path=/var/redirected/Planning
    PredictionFileDltSink: category=DLT_LOGSINK_FILE, path=/var/redirected/Prediction
    RoutingFileDltSink: category=DLT_LOGSINK_FILE, path=/var/redirected/Routing
    OTA_ClientFileDltSink: category=DLT_LOGSINK_FILE, path=/var/redirected/OTA_Client
    Control_KatechFileDltSink: category=DLT_LOGSINK_FILE, path=/var/redirected/Control_Katech
    Decision_KatechFileDltSink: category=DLT_LOGSINK_FILE, path=/var/redirected/Decision_Katech
    Planning_KatechFileDltSink: category=DLT_LOGSINK_FILE, path=/var/redirected/Planning_Katech
    V2XFileDltSink: category=DLT_LOGSINK_FILE, path=/var/redirected/V2X
    GuardianFileDltSink: category=DLT_LOGSINK_FILE, path=/var/redirected/Guardian
    KatechBridgeFileDltSink: category=DLT_LOGSINK_FILE, path=/var/redirected/Katech_Bridge
    TimeSyncProviderFileDltSink: category=DLT_LOGSINK_FILE, path=/var/redirected/TimeSyncProvider
    TimeSyncConsumerFileDltSink: category=DLT_LOGSINK_FILE, path=/var/redirected/TimeSyncConsumer
package /katech/Machines/AdaptiveMachine/FunctionGroupSets
  function group set AdaptiveFunctionGroups
    function-groups:
      mode declaration group prototype MachineFG: type=MachineState
package /katech/Machines/AdaptiveMachine/SoftwareClusters
  software cluster AdaptiveCoreCluster: category=PLATFORM_CORE, claimed-function-group=MachineFG, contained-process=[Control, Guardian, Hdmap, Hmi, Katech_Bridge, Localization, Planning, Routing, V2X, TimeSyncProvider, TimeSyncConsumer], module-instantiation=Linux
