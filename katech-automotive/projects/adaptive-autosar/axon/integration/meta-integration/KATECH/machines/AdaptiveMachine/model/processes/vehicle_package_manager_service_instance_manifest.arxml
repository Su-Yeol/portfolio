AUTOSAR XML (schema 00052)
package /katech/Machines/AdaptiveMachine/ServiceInstanceToMachineMappings
  someip service instance to machine mapping RequiredPackageManagementInstanceToMachineMapping: communication-connector=AdaptiveMachineConnector, service-instance=RequiredSomeIpVehiclePackageManagementInstance, udp-port=OTA_ClientEndpoint
package /katech/Machines/AdaptiveMachine/ServiceInstances
  required someip service instance RequiredSomeIpVehiclePackageManagementInstance: service-interface-deployment=VehiclePackageManagementSomeIp, required-minor-version=0, required-service-instance-id=ANY, sd-client-config=SomeipClientServiceInstanceConfig_vehicle_package_manager
    someip required event group RequestedPackage_required_eventgroup: event-group=RequestedPackage_eventgroup
    someip required event group SafetyState_required_eventgroup: event-group=SafetyState_eventgroup
    someip required event group TransferState_required_eventgroup: event-group=TransferState_eventgroup
