AUTOSAR XML (schema 00052)
package /katech/Executables
  4 x executable:
    ara_dlt_daemon
    ara_someip_routing_daemon
    ara_vehicle_package_manager
    ara_tsync_daemon: minimum-timer-granularity=1000
