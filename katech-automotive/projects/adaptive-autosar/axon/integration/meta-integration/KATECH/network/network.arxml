AUTOSAR XML (schema 00052)
package /katech/CommunicationClusters
  ethernet cluster KATECHNet
    ethernet physical channel KATECHChannel: comm-connectors=AdaptiveMachineConnector
      network endpoint AdaptiveMachineEndpoint: network-endpoint-addresses=ipv-4-configuration={default-gateway=192.168.7.1, ipv-4-address=192.168.7.2, network-mask=255.255.255.0}
      network endpoint SDNetworkEndpoint: network-endpoint-addresses=ipv-4-configuration=ipv-4-address=224.244.224.245
package /katech/MachineDesigns
  machine design AdaptiveMachineDesign: service-discovery-configs=someip-service-discovery={multicast-sd-ip-address=SDNetworkEndpoint, someip-service-discovery-port=30490}
    ethernet communication connector AdaptiveMachineConnector: unicast-network-endpoint=AdaptiveMachineEndpoint
      65 x ap application endpoint:
        CanDataProviderEndpoint: tp-configuration=udp-tp=udp-tp-port=port-number=30101
        CanDataSubscriberEndpoint: tp-configuration=udp-tp=udp-tp-port=port-number=30102
        CanDataEtcProviderEndpoint: tp-configuration=udp-tp=udp-tp-port=port-number=30201
        CanDataEtcSubscriberEndpoint: tp-configuration=udp-tp=udp-tp-port=port-number=30202
        ConnectivityInfoProviderEndpoint: tp-configuration=udp-tp=udp-tp-port=port-number=30401
        ConnectivityInfoSubscriberEndpoint: tp-configuration=udp-tp=udp-tp-port=port-number=30402
        DrivingTrajectoryProviderEndpoint: tp-configuration=udp-tp=udp-tp-port=port-number=30501
        DrivingTrajectorySubscriberEndpoint: tp-configuration=udp-tp=udp-tp-port=port-number=30502
        EmergencyBrakingProviderEndpoint: tp-configuration=udp-tp=udp-tp-port=port-number=30601
        EmergencyBrakingSubscriberEndpoint: tp-configuration=udp-tp=udp-tp-port=port-number=30602
        LaneDetectionProviderEndpoint: tp-configuration=udp-tp=udp-tp-port=port-number=30701
        LaneDetectionSubscriberEndpoint: tp-configuration=udp-tp=udp-tp-port=port-number=30702
        LocalMapProviderEndpoint: tp-configuration=udp-tp=udp-tp-port=port-number=30801
        LocalMapSubscriberEndpoint: tp-configuration=udp-tp=udp-tp-port=port-number=30802
        MatchingInfoProviderEndpoint: tp-configuration=udp-tp=udp-tp-port=port-number=30901
        MatchingInfoSubscriberEndpoint: tp-configuration=udp-tp=udp-tp-port=port-number=30902
        PerceptionObstaclesProviderEndpoint: tp-configuration=udp-tp=udp-tp-port=port-number=31001
        PerceptionObstaclesSubscriberEndpoint: tp-configuration=udp-tp=udp-tp-port=port-number=31002
        PointMapProviderEndpoint: tp-configuration=udp-tp=udp-tp-port=port-number=31101
        PointMapSubscriberEndpoint: tp-configuration=udp-tp=udp-tp-port=port-number=31102
        ReportFaultProviderEndpoint: tp-configuration=udp-tp=udp-tp-port=port-number=31201
        ReportFaultSubscriberEndpoint: tp-configuration=udp-tp=udp-tp-port=port-number=31202
        RoutingPathProviderEndpoint: tp-configuration=udp-tp=udp-tp-port=port-number=31301
        RoutingPathSubscriberEndpoint: tp-configuration=udp-tp=udp-tp-port=port-number=31302
        RoutingResultProviderEndpoint: tp-configuration=udp-tp=udp-tp-port=port-number=31401
        RoutingResultSubscriberEndpoint: tp-configuration=udp-tp=udp-tp-port=port-number=31402
        RoutingSearchProviderEndpoint: tp-configuration=udp-tp=udp-tp-port=port-number=31501
        RoutingSearchSubscriberEndpoint: tp-configuration=udp-tp=udp-tp-port=port-number=31502
        SemanticMapProviderEndpoint: tp-configuration=udp-tp=udp-tp-port=port-number=31601
        SemanticMapSubscriberEndpoint: tp-configuration=udp-tp=udp-tp-port=port-number=31602
        TrafficLightProviderEndpoint: tp-configuration=udp-tp=udp-tp-port=port-number=31701
        TrafficLightSubscriberEndpoint: tp-configuration=udp-tp=udp-tp-port=port-number=31702
        V2XProviderEndpoint: tp-configuration=udp-tp=udp-tp-port=port-number=31801
        V2XSubscriberEndpoint: tp-configuration=udp-tp=udp-tp-port=port-number=31802
        VehicleLocationProviderEndpoint: tp-configuration=udp-tp=udp-tp-port=port-number=31901
        VehicleLocationSubscriberEndpoint: tp-configuration=udp-tp=udp-tp-port=port-number=31902
        CollectFaultControlProviderEndpoint: tp-configuration=udp-tp=udp-tp-port=port-number=32001
        CollectFaultControlSubscriberEndpoint: tp-configuration=udp-tp=udp-tp-port=port-number=32002
        CollectFaultHdmapProviderEndpoint: tp-configuration=udp-tp=udp-tp-port=port-number=32101
        CollectFaultHdmapSubscriberEndpoint: tp-configuration=udp-tp=udp-tp-port=port-number=32102
        CollectFaultHmiProviderEndpoint: tp-configuration=udp-tp=udp-tp-port=port-number=32201
        CollectFaultHmiSubscriberEndpoint: tp-configuration=udp-tp=udp-tp-port=port-number=32202
        CollectFaultLocalizationProviderEndpoint: tp-configuration=udp-tp=udp-tp-port=port-number=32301
        CollectFaultLocalizationSubscriberEndpoint: tp-configuration=udp-tp=udp-tp-port=port-number=32302
        CollectFaultPerceptionCameraProviderEndpoint: tp-configuration=udp-tp=udp-tp-port=port-number=32401
        CollectFaultPerceptionCameraSubscriberEndpoint: tp-configuration=udp-tp=udp-tp-port=port-number=32402
        CollectFaultPerceptionLidarProviderEndpoint: tp-configuration=udp-tp=udp-tp-port=port-number=32501
        CollectFaultPerceptionLidarSubscriberEndpoint: tp-configuration=udp-tp=udp-tp-port=port-number=32502
        CollectFaultPlanningProviderEndpoint: tp-configuration=udp-tp=udp-tp-port=port-number=32601
        CollectFaultPlanningSubscriberEndpoint: tp-configuration=udp-tp=udp-tp-port=port-number=32602
        CollectFaultRoutingProviderEndpoint: tp-configuration=udp-tp=udp-tp-port=port-number=32701
        CollectFaultRoutingSubscriberEndpoint: tp-configuration=udp-tp=udp-tp-port=port-number=32702
        CollectFaultV2XProviderEndpoint: tp-configuration=udp-tp=udp-tp-port=port-number=32801
        CollectFaultV2XSubscriberEndpoint: tp-configuration=udp-tp=udp-tp-port=port-number=32802
        PlanningHmiDataProviderEndpoint: tp-configuration=udp-tp=udp-tp-port=port-number=33001
        PlanningHmiDataSubscriberEndpoint: tp-configuration=udp-tp=udp-tp-port=port-number=33002
        SensorRadarProviderEndpoint: tp-configuration=udp-tp=udp-tp-port=port-number=33101
        SensorRadarSubscriberEndpoint: tp-configuration=udp-tp=udp-tp-port=port-number=33102
        SmartCruiseControlProviderEndpoint: tp-configuration=udp-tp=udp-tp-port=port-number=33401
        SmartCruiseControlSubscriberEndpoint: tp-configuration=udp-tp=udp-tp-port=port-number=33402
        ControlBridgeProviderEndpoint: tp-configuration=udp-tp=udp-tp-port=port-number=33501
        ControlBridgeSubscriberEndpoint: tp-configuration=udp-tp=udp-tp-port=port-number=33502
        BridgeControlProviderEndpoint: tp-configuration=udp-tp=udp-tp-port=port-number=33601
        BridgeControlSubscriberEndpoint: tp-configuration=udp-tp=udp-tp-port=port-number=33602
        OTA_ClientEndpoint: tp-configuration=udp-tp=udp-tp-port=port-number=5000
