AUTOSAR XML (schema 00052)
package /apd/Dlt
  dlt context DefaultDltContext
