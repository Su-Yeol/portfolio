AUTOSAR XML (schema 00052)
package /apd/Dlt
  dlt context TraceIntegrationTest_DltContext: context-id=TIT_CX, dlt-messages=Test1Msg
