AUTOSAR XML (schema 00052)
package /apd/Dlt
  77 x dlt log sink, all with default-log-threshold=VERBOSE:
    RemoteDltSink: category=DLT_LOGSINK_REMOTE, log-channel-id=1
    AdiOsiAdapterLogFileDltSink: category=DLT_LOGSINK_FILE, path=/var/redirected/AdiOsiAdapter
    SmartCameraSensorFileDltSink: category=DLT_LOGSINK_FILE, path=/var/redirected/SmartCameraSensor
    OsiAdiAdapterFileDltSink: category=DLT_LOGSINK_FILE, path=/var/redirected/OsiAdiAdapter
    GenericAdasApplicationFileDltSink: category=DLT_LOGSINK_FILE, path=/var/redirected/GenericAdasApplication
    CMValidatorPublisherFileDltSink: category=DLT_LOGSINK_FILE, path=/var/redirected/cm_validator_publisher
    CMValidatorSubscriberFileDltSink: category=DLT_LOGSINK_FILE, path=/var/redirected/cm_validator_subsriber
    DemonstratorTutorialFileDltSink: category=DLT_LOGSINK_FILE, path=/var/redirected/demonstratortutorial
    TlvDemoReceiverFileDltSink: category=DLT_LOGSINK_FILE, path=/var/redirected/TlvDemoReceiver
    TlvDemoSenderFileDltSink: category=DLT_LOGSINK_FILE, path=/var/redirected/TlvDemoSender
    ExtendedTutorialFileDltSink: category=DLT_LOGSINK_FILE, path=/var/redirected/extendedtutorial
    TimeSyncProviderFileDltSink: category=DLT_LOGSINK_FILE, path=/var/redirected/TimeSyncProvider
    TimeSyncConsumerFileDltSink: category=DLT_LOGSINK_FILE, path=/var/redirected/TimeSyncConsumer
    TimeSyncFileDltSink: category=DLT_LOGSINK_FILE, path=/var/redirected/ara_tsync_daemon
    RES_TimingRefAppFileDltSink: category=DLT_LOGSINK_FILE, path=/var/redirected/RES_TimingRefApp
    RES_TraceIntegrationTestFileDltSink: category=DLT_LOGSINK_FILE, path=/var/redirected/RES_TraceIntegrationTest
    RES_TraceIntegrationTest2FileDltSink: category=DLT_LOGSINK_FILE, path=/var/redirected/RES_TraceIntegrationTest2
    RES_TimingRefServiceAppFileDltSink: category=DLT_LOGSINK_FILE, path=/var/redirected/RES_TimingRefServiceApp
    FaultyCalibrationFileDltSink: category=DLT_LOGSINK_FILE, path=/var/redirected/FaultyCalibrationApplication
    FaultyProbingFileDltSink: category=DLT_LOGSINK_FILE, path=/var/redirected/FaultyProbingApplication
    FaultyReportingFileDltSink: category=DLT_LOGSINK_FILE, path=/var/redirected/FaultyReportingApplication
    PhmDemoFileDltSink: category=DLT_LOGSINK_FILE, path=/var/redirected/PhmDemo
    FusionFileDltSink: category=DLT_LOGSINK_FILE, path=/var/redirected/fusion
    RadarFileDltSink: category=DLT_LOGSINK_FILE, path=/var/redirected/radar
    EmoSampleApplicationFileDltSink: category=DLT_LOGSINK_FILE, path=/var/redirected/emosampleapplication
    VehicleDriverIfFileDltSink: category=DLT_LOGSINK_FILE, path=/var/redirected/vehicle_driver_application
    SensorDemoFileDltSink: category=DLT_LOGSINK_FILE, path=/var/redirected/SensorDemoApplication
    StateManagerFileDltSink: category=DLT_LOGSINK_FILE, path=/var/redirected/StateManager
    OtaClientFileDltSink: category=DLT_LOGSINK_FILE, path=/var/redirected/ota_client
    FlashingAdapterFileDltSink: category=DLT_LOGSINK_FILE, path=/var/redirected/flashing_adapter
    UpdateAdapterAGLFileDltSink: category=DLT_LOGSINK_FILE, path=/var/redirected/update_adapter_agl
    UpdateAdapterAndroidFileDltSink: category=DLT_LOGSINK_FILE, path=/var/redirected/update_adapter_android
    PkgmgrFileDltSink: category=DLT_LOGSINK_FILE, path=/var/redirected/pkgmgr_sample
    PackageManagerFileDltSink: category=DLT_LOGSINK_FILE, path=/var/redirected/package_manager
    VehiclePackageManagerFileDltSink: category=DLT_LOGSINK_FILE, path=/var/redirected/vehicle_package_manager
    TransferPerformanceCheckFileDltSink: category=DLT_LOGSINK_FILE, path=/var/redirected/transfer_performance_check
    DriverIfFileDltSink: category=DLT_LOGSINK_FILE, path=/var/redirected/dif
    UpdatableAppFileDltSink: category=DLT_LOGSINK_FILE, path=/var/redirected/UpdatableApp
    EmoIntegrationTestLogFileDltSink: category=DLT_LOGSINK_FILE, path=/var/redirected/emointegrationtest
    EmoSampleApplicationLogFileDltSink: category=DLT_LOGSINK_FILE, path=/var/redirected/emosampleapplication
    SecDemoFcFileDltSink: category=DLT_LOGSINK_FILE, path=/var/redirected/secdemofc
    SecIamTestAppFileDltSink: category=DLT_LOGSINK_FILE, path=/var/redirected/seciamtestapp
    VehicleStateManagerIfFileDltSink: category=DLT_LOGSINK_FILE, path=/var/redirected/vehicle_state_manager_application
    ActorFileDltSink: category=DLT_LOGSINK_FILE, path=/var/redirected/actor
    ControllerFileDltSink: category=DLT_LOGSINK_FILE, path=/var/redirected/controller
    LineSensorFileDltSink: category=DLT_LOGSINK_FILE, path=/var/redirected/linesensor
    UltrasonicSensorFileDltSink: category=DLT_LOGSINK_FILE, path=/var/redirected/ultrasonicsensor
    shmMasterFileDltSink: category=DLT_LOGSINK_FILE, path=/var/redirected/shmMaster
    shmClient1FileDltSink: category=DLT_LOGSINK_FILE, path=/var/redirected/shmClient1
    shmClient2FileDltSink: category=DLT_LOGSINK_FILE, path=/var/redirected/shmClient2
    CMApp{01..03}FileDltSink: category=DLT_LOGSINK_FILE, path=/var/redirected/cmapp{01..03}
    CMApp{09..14}FileDltSink: category=DLT_LOGSINK_FILE, path=/var/redirected/cmapp{09..14}
    DDSApp{01..03}FileDltSink: category=DLT_LOGSINK_FILE, path=/var/redirected/ddsapp{01..03}
    DIAGApp01FileDltSink: category=DLT_LOGSINK_FILE, path=/var/redirected/diagapp01
    STBG_EMOAppSysFGFileDltSink: category=DLT_LOGSINK_FILE, path=/var/redirected/stbg_emoappsysfg
    STBG_EMOAppSysFG1FileDltSink: category=DLT_LOGSINK_FILE, path=/var/redirected/stbg_emoappsysfg1
    STBG_EMOAppSysFG2FileDltSink: category=DLT_LOGSINK_FILE, path=/var/redirected/stbg_emoappsysfg2
    STC1_EMOApp{02..05}FileDltSink: category=DLT_LOGSINK_FILE, path=/var/redirected/stc1_emoapp{02..05}
    STC2_EMOApp{02..06}FileDltSink: category=DLT_LOGSINK_FILE, path=/var/redirected/stc2_emoapp{02..06}
    OEMAppFileDltSink: category=DLT_LOGSINK_FILE, path=/var/redirected/OEMApp
    FCFirewallFileDltSink: category=DLT_LOGSINK_FILE, path=/var/redirected/fc_firewall
