AUTOSAR XML (schema 00052)
package /apd/TraceIntegrationTest
  5 x lt message collection to port prototype mapping:
    ModeledMsgs_Mapping: log-and-trace-message-collection-set=ModeledMsgs, r-port-prototype=TraceIntegrationTest_RPort
    CommunicationMsgs_to_TitClientComponent: log-and-trace-message-collection-set=CommunicationMsgs, r-port-prototype=TraceIntegrationTest_RPort
    OSMsgs_Mapping: log-and-trace-message-collection-set=log, r-port-prototype=TraceIntegrationTest_RPort
    ModeledMsgs_to_TitServiceComponent: log-and-trace-message-collection-set=ModeledMsgs, r-port-prototype=LogAndTrace_RPort
    CommunicationMsgs_to_TitServiceComponent: log-and-trace-message-collection-set=CommunicationMsgs, r-port-prototype=LogAndTrace_RPort
  log and trace message collection set ModeledMsgs
    dlt message Test1Msg: message-id=0x00123002, message-line-number=0, message-source-file=source_file_path, message-type-info=DLT_TRACE_STATE
      dlt argument Argument: length=1, network-representation={base-type=uint8_t, unit=NoUnit}
  log and trace message collection set CommunicationMsgs
    4 x dlt message, all with message-line-number=0, message-source-file=source_file_path, message-type-info=DLT_TRACE_STATE:
      RequestCalculation: message-id=0x00123003
        dlt argument Argument: length=1, network-representation={base-type=uint32_t, unit=NoUnit}
      StartCalculation: message-id=0x00123004
        dlt argument Argument: length=1, network-representation={base-type=uint32_t, unit=NoUnit}
      EndCalculation: message-id=0x00123005
        dlt argument Result: length=1, network-representation={base-type=uint32_t, unit=NoUnit}
      FinishedCalculation: message-id=0x00123006
        dlt argument Result: length=1, network-representation={base-type=uint32_t, unit=NoUnit}
