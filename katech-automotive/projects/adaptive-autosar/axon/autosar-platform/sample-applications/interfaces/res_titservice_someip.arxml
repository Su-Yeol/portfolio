AUTOSAR XML (schema 00052)
package /apd/ServiceInterfaceDeployments
  someip service interface deployment TitService_Someip: service-interface=TitService, service-interface-id=24, service-interface-version={major-version=1, minor-version=0}
    someip event deployment sensorData_Someip: event=sensorData, event-id=55, transport-protocol=UDP
    someip method deployment action_Someip: method=Action, method-id=13, transport-protocol=UDP
    someip event group sensorData_Someip_group: event-group-id=1, event=sensorData_Someip
