AUTOSAR XML (schema 00052)
package /apd/ServiceInterfaceDeployments
  someip service interface deployment FakeVideo_Someip: service-interface=FakeVideo, service-interface-id=65533
    someip event deployment Data_Someip: event=Data, event-id=1, transport-protocol=UDP
    someip event group FakeVideo: event-group-id=1, event=Data_Someip
