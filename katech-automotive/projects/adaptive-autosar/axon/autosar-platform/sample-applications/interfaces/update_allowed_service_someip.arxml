AUTOSAR XML (schema 00052)
package /apd/ServiceInterfaceDeployments
  someip service interface deployment UpdateAllowedService_Someip: service-interface=UpdateAllowedService, service-interface-id=671, service-interface-version={major-version=1, minor-version=0}
    someip field deployment UpdateAllowed_Someip: field=UpdateAllowed
      get Get: method-id=2, transport-protocol=UDP
      notifier Notifier: event-id=0x0BBF, transport-protocol=UDP
      set Set: method-id=1, transport-protocol=UDP
    someip event group SomeIpEventGroup: event-group-id=1, event=Notifier
