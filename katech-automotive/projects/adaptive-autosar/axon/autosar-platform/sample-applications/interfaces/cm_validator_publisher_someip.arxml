AUTOSAR XML (schema 00052)
package /apd/ServiceInterfaceDeployments
  someip service interface deployment CMValidatorPublisher_Someip: service-interface=CMValidatorPublisher, service-interface-id=88, service-interface-version={major-version=1, minor-version=0}
    someip event deployment Event1_Someip: event=Event1, event-id=1, transport-protocol=UDP
    someip event deployment Event2_Someip: event=Event2, event-id=2, transport-protocol=UDP
    someip field deployment Field1_Someip: field=Field1
      get getter: method-id=3021, transport-protocol=UDP
      notifier notifier: event-id=3020, transport-protocol=UDP
      set setter: method-id=3022, transport-protocol=UDP
    someip field deployment Field2_Someip: field=Field2
      notifier notifier: event-id=3024, transport-protocol=UDP
    someip method deployment MethodsCapability_Someip: method=MethodsCapability, method-id=32040, transport-protocol=UDP
    someip method deployment EchoSomeipMethod: method=Echo, method-id=32050, transport-protocol=UDP
    4 x someip event group:
      SomeipEventgroup1: event-group-id=1, event=Event1_Someip
      SomeipEventgroup2: event-group-id=2, event=Event2_Someip
      SomeipEventgroup3: event-group-id=3, event=Field1_Someip/notifier
      SomeipEventgroup4: event-group-id=4, event=Field2_Someip/notifier
