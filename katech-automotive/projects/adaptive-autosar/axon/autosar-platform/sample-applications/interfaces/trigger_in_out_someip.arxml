AUTOSAR XML (schema 00052)
package /apd/ServiceInterfaceDeployments
  someip service interface deployment TriggerInOut_Someip: service-interface=TriggerInOut, service-interface-id=669, service-interface-version={major-version=1, minor-version=0}
    someip field deployment Trigger_Someip: field=Trigger
      set Set: method-id=1, transport-protocol=UDP
    someip field deployment Notifier_Someip: field=Notifier
      get Get: method-id=30007, transport-protocol=UDP
      notifier Notifier: event-id=0x0BBD, transport-protocol=UDP
    someip event group SomeIpEventGroup: event-group-id=1, event=Notifier
