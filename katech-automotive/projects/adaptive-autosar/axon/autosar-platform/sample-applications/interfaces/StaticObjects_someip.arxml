AUTOSAR XML (schema 00052)
package /apd/ServiceInterfaceDeployments
  someip service interface deployment StaticObjects_Someip: service-interface=StaticObjectsService, service-interface-id=129, service-interface-version={major-version=1, minor-version=0}
    someip event deployment StaticObjectInterface_Someip: event=StaticObjectInterfaceEvent, event-id=1, transport-protocol=UDP
    someip method deployment Capability_Someip: method=StaticObjectsCapability, method-id=32000, transport-protocol=UDP
    someip event group SomeipEventgroup1: event-group-id=1, event=StaticObjectInterface_Someip
