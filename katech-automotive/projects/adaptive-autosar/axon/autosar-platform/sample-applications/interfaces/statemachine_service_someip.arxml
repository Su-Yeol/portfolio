AUTOSAR XML (schema 00052)
package /apd/ServiceInterfaceDeployments
  someip service interface deployment StateMachineService_Someip: service-interface=StateMachineService, service-interface-id=670, service-interface-version={major-version=1, minor-version=0}
    someip method deployment RequestState: method=RequestState, method-id=30004, transport-protocol=UDP
