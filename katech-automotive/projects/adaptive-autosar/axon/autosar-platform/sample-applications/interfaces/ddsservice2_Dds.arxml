AUTOSAR XML (schema 00052)
package /apd/ServiceInterfaceDeployments
  dds service interface deployment DDSService2_Dds: service-interface=ddsservice2, service-interface-id=ddsservice2, transport-protocols=UDP
    dds event deployment DdsEventC: event=EventC, topic-name=DdsTopicEventC, transport-protocols=UDP
