AUTOSAR XML (schema 00052)
package /apd/ServiceInterfaceDeployments
  someip service interface deployment HealthInfo_Someip: service-interface=HealthInfo, service-interface-id=101, service-interface-version={major-version=1, minor-version=0}
    someip event deployment HealthInfoEvent_Someip: event=HealthInfoEvent, event-id=1, transport-protocol=UDP
    someip event deployment HealthIndicatorEvent_Someip: event=HealthIndicatorEvent, event-id=2, transport-protocol=UDP
    someip event group SomeipEventgroup1: event-group-id=1, event=HealthInfoEvent_Someip
    someip event group SomeipEventgroup2: event-group-id=2, event=HealthIndicatorEvent_Someip
