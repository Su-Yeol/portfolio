AUTOSAR XML (schema 00052)
package /apd/ServiceInterfaceDeployments
  someip service interface deployment Image_Someip: service-interface=Image, service-interface-id=1
    someip event deployment Data_Someip: event=Data, event-id=1, transport-protocol=UDP
    someip event group Image: event-group-id=1, event=Data_Someip
