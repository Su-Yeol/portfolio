AUTOSAR XML (schema 00052)
package /apd/package_manager/PersistencyKeyValueStorageInterfaces
  persistency key value storage interface SwPackageCurrentStatus: redundancy=NONE, update-strategy=KEEP-EXISTING
