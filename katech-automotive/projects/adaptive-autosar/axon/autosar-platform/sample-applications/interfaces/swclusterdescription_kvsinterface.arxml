AUTOSAR XML (schema 00052)
package /apd/PersistencyKeyValueStorageInterfaces
  persistency key value storage interface SwClusterDescriptionKVSInterface: redundancy=NONE, update-strategy=KEEP-EXISTING
