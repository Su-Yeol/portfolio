AUTOSAR XML (schema 00052)
package /apd/ServiceInterfaceDeployments
  dds service interface deployment DDSService5_Dds: service-interface=ddsservice5, method-reply-topic-name=DdsTopicRadarMethodCReply, method-request-topic-name=DdsTopicRadarMethodDRequest, service-interface-id=ddsservice5, transport-protocols=UDP
