AUTOSAR XML (schema 00052)
package /apd/ServiceInterfaces
  service interface CMService1
    namespaces:
      symbol props apd
      symbol props testsuite
      symbol props cm
    events:
      data Event1: type=int32_t
