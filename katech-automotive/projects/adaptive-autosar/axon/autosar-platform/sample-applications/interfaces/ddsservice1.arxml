AUTOSAR XML (schema 00052)
package /apd/CppImplementationDataTypes
  std cpp implementation data type EventObjects: category=STRUCTURE, type-emitter=TYPE_EMITTER_ARA
    namespaces:
      symbol props apd
      symbol props testsuite
      symbol props cmdds
    cpp implementation data type element active: type-reference={inplace=false, type-reference=bool}
    cpp implementation data type element objectVector: type-reference={inplace=false, type-reference=ByteArray}
package /apd/ServiceInterfaces
  service interface ddsservice1
    namespaces:
      symbol props apd
      symbol props testsuite
      symbol props cmdds
    events:
      data EventA: type=EventObjects
      data EventB: type=EventObjects
