AUTOSAR XML (schema 00052)
package /apd/ServiceInterfaceDeployments
  someip service interface deployment UltrasonicDetections_Someip: service-interface=UltrasonicDetectionsService, service-interface-id=8, service-interface-version={major-version=1, minor-version=0}
    someip event deployment UltrasonicDetectionsInterface_Someip: event=UltrasonicDetectionsInterfaceEvent, event-id=1, transport-protocol=UDP
    someip method deployment Capability_Someip: method=UltrasonicDetectionsCapability, method-id=32000, transport-protocol=UDP
    someip event group SomeipEventgroup1: event-group-id=1, event=UltrasonicDetectionsInterface_Someip
