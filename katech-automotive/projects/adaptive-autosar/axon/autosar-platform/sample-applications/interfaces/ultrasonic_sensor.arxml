AUTOSAR XML (schema 00052)
package /apd/ServiceInterfaces
  service interface UltraSonicSensorInterface: category=APPLICATION_LEVEL
    namespaces:
      symbol props apd
      symbol props picar
    events:
      data ultrasonicSensorEvent: type=uint16_t
