AUTOSAR XML (schema 00052)
package /apd/ServiceInterfaceDeployments
  someip service interface deployment Vehicle_Someip: service-interface=Vehicle, service-interface-id=4
    someip event deployment Data_Someip: event=Data, event-id=1, transport-protocol=UDP
    someip event group Vehicle: event-group-id=1, event=Data_Someip
