AUTOSAR XML (schema 00052)
package /apd/ServiceInterfaceDeployments
  dds service interface deployment DDSService1_Dds: service-interface=ddsservice1, service-interface-id=ddsservice1, transport-protocols=UDP
    dds event deployment DdsEventA: event=EventA, topic-name=DdsTopicEventA, transport-protocols=UDP
    dds event deployment DdsEventB: event=EventB, topic-name=DdsTopicEventB, transport-protocols=UDP
