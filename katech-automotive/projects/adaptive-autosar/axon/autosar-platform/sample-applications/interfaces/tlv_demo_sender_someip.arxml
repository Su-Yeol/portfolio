AUTOSAR XML (schema 00052)
package /apd/ServiceInterfaceDeployments
  someip service interface deployment Tlv_Someip: service-interface=tlv, service-interface-id=89, service-interface-version={major-version=1, minor-version=0}
    someip method deployment State_Someip: method=State, method-id=32030, transport-protocol=UDP
