AUTOSAR XML (schema 00052)
package /apd/AdaptiveApplicationSwComponentTypes
  adaptive application sw component type STBG_EMOAppSysFG1
package /apd/Executables
  executable STBG_EMOAppSysFG1: category=APPLICATION_LEVEL, minimum-timer-granularity=1000.0, reporting-behavior=REPORTS-EXECUTION-STATE, version=1.0.0
    root sw component prototype STBG_EMOAppSysFG1Root: application-type=STBG_EMOAppSysFG1
