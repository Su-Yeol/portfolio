AUTOSAR XML (schema 00052)
package /apd/AdaptiveApplicationSwComponentTypes
  adaptive application sw component type STC2_EMOApp05
package /apd/Executables
  executable STC2_EMOApp05: category=APPLICATION_LEVEL, minimum-timer-granularity=1000.0, reporting-behavior=REPORTS-EXECUTION-STATE, version=1.0.0
    root sw component prototype STC2_EMOApp05Root: application-type=STC2_EMOApp05
