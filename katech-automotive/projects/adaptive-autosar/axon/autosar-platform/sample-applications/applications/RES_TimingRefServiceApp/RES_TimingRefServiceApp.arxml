AUTOSAR XML (schema 00052)
package /apd/AdaptiveApplicationSwComponentTypes
  adaptive application sw component type DataPreprocessor
    provide port SensorData_ActuatorPort: provided-interface=SensorActuatorService
package /apd/Executables
  executable RES_TimingRefServiceApp: category=APPLICATION_LEVEL, minimum-timer-granularity=1000
    root sw component prototype RES_TimingRefServiceApp: application-type=DataPreprocessor
