AUTOSAR XML (schema 00052)
package /apd/AdaptiveApplicationSwComponentTypes
  adaptive application sw component type transfer_performance_check
    require port PackageManagementRPort: required-interface=PackageManagement
package /apd/Executables
  executable transfer_performance_check: category=APPLICATION_LEVEL, minimum-timer-granularity=1000.0, version=1.0.0
    root sw component prototype transfer_performance_check_root: application-type=transfer_performance_check
