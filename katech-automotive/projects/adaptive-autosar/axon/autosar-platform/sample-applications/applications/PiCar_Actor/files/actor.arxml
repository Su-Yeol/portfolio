AUTOSAR XML (schema 00052)
package /apd/Executables
  executable actor: category=APPLICATION_LEVEL, build-type=BUILD-TYPE-DEBUG, minimum-timer-granularity=1000.0, reporting-behavior=REPORTS-EXECUTION-STATE, version=0.1.0
    root sw component prototype ActorRoot: application-type=actor
package /apd/AdaptiveApplicationSwComponentTypes
  adaptive application sw component type actor
    provide port ActorPPort: provided-interface=ActorInterface
