AUTOSAR XML (schema 00052)
package /System
  system WgresTrpSystemAp
    root-software-compositions:
      root sw composition prototype rscpTrp: software-composition=ApApComposition
package /Components
  composition sw component type ApApComposition
    component dataPreprocessor: type=DataPreprocessor
    component hpProcessingApplication: type=HpProcessingApp
package /TimingExtensions
  system timing PuttingEventChainsTogetherAp: system=WgresTrpSystemAp
    timing description event chain ReactingOnSensorData: stimulus=tdeSensorDataReceived, response=tdeMethodInvoke, segment=[tdecMethodInvokeToActionCallReceived, tdecSensorDataApSrvToApClient]
  system timing syst_MethodCallAp: system=WgresTrpSystemAp
    timing-descriptions:
      4 x td event operation, all with is-external=false, operation=Action:
        tdeActionCallReceived: port=SensorData_ActuatorPort, td-event-operation-type=OPERATION-CALL-RECEIVED
        tdeActionCallResponseSent: port=SensorData_ActuatorPort, td-event-operation-type=OPERATION-CALL-RESPONSE-SENT
        tdeMethodInvoke: port=cpapservicePort, td-event-operation-type=OPERATION-CALLED
        tdeMethodReturn: port=cpapservicePort, td-event-operation-type=OPERATION-CALL-RESPONSE-RECEIVED
      4 x timing description event chain:
        tdecActionCallResponseSentToMethodReturn: stimulus=tdeActionCallResponseSent, response=tdeMethodReturn, segment=tdecActionCallResponseSentToMethodReturn
        tdecActionProcessed: stimulus=tdeActionCallReceived, response=tdeActionCallResponseSent, segment=tdecActionProcessed
        tdecMethodInvokeToActionCallReceived: stimulus=tdeMethodInvoke, response=tdeActionCallReceived, segment=tdecMethodInvokeToActionCallReceived
        tdecMethodInvokeToReturn: stimulus=tdeMethodInvoke, response=tdeMethodReturn, segment=[tdecActionCallResponseSentToMethodReturn, tdecActionProcessed, tdecMethodInvokeToActionCallReceived]
    timing-requirements:
      latency timing constraint ltcFromTo: latency-constraint-type=REACTION, scope=tdecMethodInvokeToReturn, minimum={cse-code=3, cse-code-factor=10}, maximum={cse-code=3, cse-code-factor=11}
  system timing syst_SensorDataAp: system=WgresTrpSystemAp
    timing-descriptions:
      td event variable data prototype tdeSensorDataReceived: is-external=false, port=cpapservicePort, data-element=sensorData, td-event-variable-data-prototype-type=VARIABLE-DATA-PROTOTYPE-RECEIVED
      td event variable data prototype tdeSensorDataSent: is-external=false, port=SensorData_ActuatorPort, data-element=sensorData, td-event-variable-data-prototype-type=VARIABLE-DATA-PROTOTYPE-SENT
      timing description event chain tdecSensorDataApSrvToApClient: stimulus=tdeSensorDataSent, response=tdeSensorDataReceived, segment=tdecSensorDataApSrvToApClient
    timing-requirements:
      latency timing constraint ltcSensorData: latency-constraint-type=REACTION, scope=tdecSensorDataApSrvToApClient, minimum={cse-code=3, cse-code-factor=1}, maximum={cse-code=3, cse-code-factor=2}
      periodic event triggering petcSensorData: event=tdeSensorDataSent, minimum-inter-arrival-time={cse-code=3, cse-code-factor=100}, jitter={cse-code=3, cse-code-factor=4}, period={cse-code=3, cse-code-factor=100}
