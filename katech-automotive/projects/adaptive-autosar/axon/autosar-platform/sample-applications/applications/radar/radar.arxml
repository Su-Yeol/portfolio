AUTOSAR XML (schema 00052)
package /apd/AdaptiveApplicationSwComponentTypes
  adaptive application sw component type radar
    provide port radar_PPort: provided-interface=radar
package /apd/Executables
  executable radar: category=APPLICATION_LEVEL, minimum-timer-granularity=1000
    root sw component prototype radar: application-type=radar
