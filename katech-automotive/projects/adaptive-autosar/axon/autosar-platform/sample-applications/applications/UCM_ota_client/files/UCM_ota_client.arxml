AUTOSAR XML (schema 00052)
package /apd/AdaptiveApplicationSwComponentTypes
  adaptive application sw component type ota_client
    require port VehiclePackageManagementRPort: required-interface=VehiclePackageManagement
package /apd/Executables
  executable ota_app: category=APPLICATION_LEVEL, minimum-timer-granularity=1000.0, version=1.0.0
    root sw component prototype ota_app_root: application-type=ota_client
