AUTOSAR XML (schema 00052)
package /apd/AdaptiveApplicationSwComponentTypes
  adaptive application sw component type UpdatableApp
package /apd/Executables
  executable UpdatableApp: category=APPLICATION_LEVEL, minimum-timer-granularity=1000.0, version=1.0.0-1234567890
    root sw component prototype UpdatableAppRoot: application-type=UpdatableApp
