AUTOSAR XML (schema 00052)
package /apd/AdaptiveApplicationSwComponentTypes
  adaptive application sw component type TlvDemoSender
    provide port tlv_PPort: provided-interface=tlv
package /apd/Executables
  executable TlvDemoSender: category=APPLICATION_LEVEL, minimum-timer-granularity=1000
    root sw component prototype TlvDemoSender: application-type=TlvDemoSender
