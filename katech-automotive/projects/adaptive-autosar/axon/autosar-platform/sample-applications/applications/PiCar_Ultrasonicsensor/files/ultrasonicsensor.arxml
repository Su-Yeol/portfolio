AUTOSAR XML (schema 00052)
package /apd/Executables
  executable ultrasonicSensor: category=APPLICATION_LEVEL, build-type=BUILD-TYPE-DEBUG, minimum-timer-granularity=1000.0, reporting-behavior=REPORTS-EXECUTION-STATE, version=0.1.0
    root sw component prototype UltrasonicSensorRoot: application-type=ultrasonicsensor
package /apd/AdaptiveApplicationSwComponentTypes
  adaptive application sw component type ultrasonicsensor
    provide port UltraSonicSensorPPort: provided-interface=UltraSonicSensorInterface
