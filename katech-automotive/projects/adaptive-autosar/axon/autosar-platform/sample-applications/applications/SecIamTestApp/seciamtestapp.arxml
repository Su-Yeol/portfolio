AUTOSAR XML (schema 00052)
package /apd/AdaptiveApplicationSwComponentTypes
  adaptive application sw component type SecIamTestApp
package /apd/Executables
  executable SecIamTestApp: category=APPLICATION_LEVEL, minimum-timer-granularity=1000
    root sw component prototype SecIamTestApp: application-type=SecIamTestApp
