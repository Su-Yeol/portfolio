AUTOSAR XML (schema 00052)
package /apd/AdaptiveApplicationSwComponentTypes
  adaptive application sw component type EmoIntegrationTest
package /apd/Executables
  executable EmoIntegrationTest: category=APPLICATION_LEVEL, minimum-timer-granularity=1000, reporting-behavior=REPORTS-EXECUTION-STATE
    root sw component prototype EmoIntegrationTest: application-type=EmoIntegrationTest
