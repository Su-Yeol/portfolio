AUTOSAR XML (schema 00052)
package /apd/AdaptiveApplicationSwComponentTypes
  adaptive application sw component type DemoFunction
    provide/require port PRKvs: provided-required-interface=IKvs
    require port TutIf: required-interface=TutorialInterface
package /apd/Executables
  executable ExtendedTutorial: category=APPLICATION_LEVEL, minimum-timer-granularity=1000.0
    root sw component prototype DemoFunction: application-type=DemoFunction
package /apd/Interfaces
  persistency key value storage interface IKvs
