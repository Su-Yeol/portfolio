AUTOSAR XML (schema 00052)
package /apd/AdaptiveApplicationSwComponentTypes
  adaptive application sw component type shmClient2
    require port HealthIndicator_RPort: required-interface=HealthIndicator
package /apd/Executables
  executable shmClient2: category=APPLICATION_LEVEL, minimum-timer-granularity=1000
    root sw component prototype shmClient2: application-type=shmClient2
