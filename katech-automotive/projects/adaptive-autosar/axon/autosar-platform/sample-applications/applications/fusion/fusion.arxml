AUTOSAR XML (schema 00052)
package /apd/AdaptiveApplicationSwComponentTypes
  adaptive application sw component type fusion
    require port radar_RPort: required-interface=radar
package /apd/Executables
  executable fusion: category=APPLICATION_LEVEL, minimum-timer-granularity=1000.0
    root sw component prototype fusion: application-type=fusion
