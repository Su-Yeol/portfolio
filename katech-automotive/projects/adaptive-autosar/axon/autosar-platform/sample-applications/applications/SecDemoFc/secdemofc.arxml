AUTOSAR XML (schema 00052)
package /apd/AdaptiveApplicationSwComponentTypes
  adaptive application sw component type SecDemoFc
package /apd/Executables
  executable SecDemoFc: category=APPLICATION_LEVEL, minimum-timer-granularity=1000
    root sw component prototype SecDemoFc: application-type=SecDemoFc
