AUTOSAR XML (schema 00052)
package /apd/AdaptiveApplicationSwComponentTypes
  adaptive application sw component type CMValidatorPublisher
    provide port CMValidatorPublisher_PPort: provided-interface=CMValidatorPublisher
package /apd/Executables
  executable CMValidatorPublisher: category=APPLICATION_LEVEL, minimum-timer-granularity=1000
    root sw component prototype CMValidatorPublisher: application-type=CMValidatorPublisher
