AUTOSAR XML (schema 00052)
package /apd/AdaptiveApplicationSwComponentTypes
  adaptive application sw component type TlvDemoReceiver
    require port tlv_RPort: required-interface=tlv
package /apd/Executables
  executable TlvDemoReceiver: category=APPLICATION_LEVEL, minimum-timer-granularity=1000
    root sw component prototype TlvDemoReceiver: application-type=TlvDemoReceiver
