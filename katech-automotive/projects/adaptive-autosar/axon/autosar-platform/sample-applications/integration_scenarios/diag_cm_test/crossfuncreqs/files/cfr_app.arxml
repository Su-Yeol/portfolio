AUTOSAR XML (schema 00052)
package /ara/diag
  adaptive application sw component type crossfuncreqs_swc
    require port DiagnosticEvent: required-interface=DiagnosticEvent
  executable crossfuncreqs_exe
    root sw component prototype crossfuncreqs_component: application-type=crossfuncreqs_swc
  process crossfuncreqs: design=crossfuncreqs_design, executable=crossfuncreqs_exe
  process design crossfuncreqs_design: executable=crossfuncreqs_exe
  process to machine mapping set CrossFuncReqsMachineMappings
    process to machine mapping CrossFuncReqsMapping: machine=dmMachine, process=crossfuncreqs
  required someip service instance CrossFuncReqs_DiagnosticEventRequiredServiceInstance: service-interface-deployment=DiagnosticEvent_Someip, required-service-instance-id=ANY
  service instance to port prototype mapping CrossFuncReqs_DiagnosticEventRequiredServiceInstance_toPort: port-prototype=DiagnosticEvent, process=crossfuncreqs, service-instance=CrossFuncReqs_DiagnosticEventRequiredServiceInstance
  someip service instance to machine mapping CrossFuncReqs_DiagnosticEventRequiredServiceInstance_toMachine: communication-connector=myCommunicationConnector, service-instance=CrossFuncReqs_DiagnosticEventRequiredServiceInstance, tcp-port=ApApplicationEndpoint8
