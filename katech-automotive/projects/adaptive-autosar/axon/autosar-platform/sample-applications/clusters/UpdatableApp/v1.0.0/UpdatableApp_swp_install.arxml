AUTOSAR XML (schema 00052)
package /apd/SoftwarePackages/UpdatableApp
  software package UpdatableAppSwpkgInstall: action-type=INSTALL, activation-action=RESTART-APPLICATION, compressed-software-package-size=0, estimated-duration-of-operation=42, minimum-supported-ucm-version=1.0.0_0, packager-id=1347111236, purpose-of-update=UpdatableAppSwpkgInstallUpdatePurpose, software-cluster=UpdatableAppSwcl, uncompressed-software-cluster-size=@SWCL_UNCOMPRESSED_SIZE@
  documentation UpdatableAppSwpkgInstallUpdatePurpose: documentation-content=p=l-1=Install the updatable app application
