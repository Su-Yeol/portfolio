AUTOSAR XML (schema 00052)
package /apd/VehiclePackages
  vehicle package CampaignClassic: packager-signature=integratorCert, repository=https://autosar.org/apdrepo, ucm-master-fallback=TBD
    driver-notifications:
      approval-required=true, notification-state=TRANSFER
      approval-required=true, notification-state=PROCESS
      approval-required=false, notification-state=ACTIVATE
      approval-required=false, notification-state=ROLL-BACK
      approval-required=false, notification-state=FINISH
    rollout-qualifications:
      vehicle rollout step VEHICLE_ROLLOUT_STEP_1: safety-conditions=NONE
        ucm-processings:
          ucm step FLAD_STEP_1: ucm=Adapter_FLAD
            software package step SWP_STEP_1_1: process=@CSWPP_NAME@SwpkgInstall, transfers=software-package-storing={storing=NONE, transfer=@CSWPP_NAME@SwpkgInstall}
    ucm description Adapter_FLAD: identifier=FLAD, ucm-module-instantiation=TBD
