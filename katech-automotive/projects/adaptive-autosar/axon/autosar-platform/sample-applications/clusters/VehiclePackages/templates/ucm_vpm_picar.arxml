AUTOSAR XML (schema 00052)
package /apd/VehiclePackages
  vehicle package PicarCampaign: packager-signature=integratorCert, repository=https://autosar.org/apdrepo, ucm-master-fallback=TBD
    driver-notifications:
      approval-required=true, notification-state=TRANSFER
      approval-required=true, notification-state=PROCESS
      approval-required=false, notification-state=ACTIVATE
      approval-required=false, notification-state=ROLL-BACK
      approval-required=false, notification-state=FINISH
    rollout-qualifications:
      vehicle rollout step UltrasonicRolloutStep: safety-conditions=AUDIO_ON
        ucm-processings:
          ucm step UltrasonicStep: ucm=RadarFusionMachineUCM
            software package step UltrasonicTransfer: transfers=software-package-storing={storing=NONE, transfer=UltrasonicSensorAppSwpkgInstall}
            software package step UltrasonicProcess: process=UltrasonicSensorAppSwpkgInstall, transfers=software-package-storing=NONE
      vehicle rollout step VEHICLE_ROLLOUT_STEP_2: safety-conditions=[IGN_OFF, CAMERA_ON]
        ucm-processings:
          ucm step ControllerStep: ucm=RadarFusionMachineUCM
            software package step ControllerTransfer: transfers=software-package-storing={storing=NONE, transfer=ControllerAppSwpkgUpdate}
            software package step ControllerProcess: process=ControllerAppSwpkgUpdate, transfers=software-package-storing=NONE
            software package step Activate
    ucm description RadarFusionMachineUCM: identifier=RadarFusionMachineUCM, ucm-module-instantiation=TBD
