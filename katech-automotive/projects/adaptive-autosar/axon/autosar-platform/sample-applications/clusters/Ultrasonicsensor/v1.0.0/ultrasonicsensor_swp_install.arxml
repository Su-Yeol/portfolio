AUTOSAR XML (schema 00052)
package /apd/SoftwarePackages/UltrasonicSensor
  software package UltrasonicSensorAppSwpkgInstall: action-type=INSTALL, activation-action=RESTART-APPLICATION, compressed-software-package-size=0, estimated-duration-of-operation=42, minimum-supported-ucm-version=1.0.0_0, packager-id=1347111236, purpose-of-update=UltrasonicSensorAppSwpkgInstallUpdatePurpose, software-cluster=UltrasonicSensorAppSwcl, uncompressed-software-cluster-size=@SWCL_UNCOMPRESSED_SIZE@
  documentation UltrasonicSensorAppSwpkgInstallUpdatePurpose: documentation-content=p=l-1=Install the ultrasonic sensor application
