AUTOSAR XML (schema 00052)
package /apd/SoftwarePackages/Controller
  software package ControllerAppSwpkgUpdate: action-type=UPDATE, activation-action=RESTART-APPLICATION, compressed-software-package-size=0, estimated-duration-of-operation=42, minimum-supported-ucm-version=1.0.0_0, packager-id=1347111236, purpose-of-update=ControllerAppSwpkgUpdateUpdatePurpose, software-cluster=ControllerAppSwcl, uncompressed-software-cluster-size=@SWCL_UNCOMPRESSED_SIZE@
  documentation ControllerAppSwpkgUpdateUpdatePurpose: documentation-content=p=l-1=Update the controller application
