AUTOSAR XML (schema 00052)
package /apd/Machines/shmMachine/ProcessToMachineMappings
  process to machine mapping set shmClient2
    process to machine mapping shmClient2: machine=shmMachine, process=shmClient2
package /apd/Machines/shmMachine/Processes
  process shmClient2: executable=shmClient2, state-dependent-startup-config{function-group-state=[MachineFG.Driving, MachineFG.Parking], resource-group=ResourceGroup1, startup-config=shmStartup}
    process state machine state_machine: type=ProcessStateMachine
package /apd/Machines/shmMachine/StartupConfigSets
  startup config shmStartup: environment-variables=tag-with-optional-value={key=VSOMEIP_CONFIGURATION, value=/etc/vsomeip.json}, scheduling-policy=SCHEDULING-POLICY-ROUND-ROBIN, scheduling-priority=12, termination-behavior=PROCESS-IS-NOT-SELF-TERMINATING
package /apd/Machines/shmMachine/ServiceInstanceToPortPrototypeMappings
  service instance to port prototype mapping healthIndicator_RequiredServiceInstance_toPort: port-prototype=HealthIndicator_RPort, process=shmClient2, service-instance=healthIndicatorRequiredSomeipServiceInstance
package /apd/Machines/shmMachine/DltMappings
  dlt application to process mapping shmClient2DltApplicationToProcessMapping: dlt-application=shmClient2LogApplication, process=shmClient2
  dlt log sink to port prototype mapping shmClient2DltLogSinkToPortPrototypeMapping: dlt-context=DefaultDltContext, dlt-log-sink=[ConsoleDltSink, shmClient2FileDltSink, RemoteDltSink], process=shmClient2
