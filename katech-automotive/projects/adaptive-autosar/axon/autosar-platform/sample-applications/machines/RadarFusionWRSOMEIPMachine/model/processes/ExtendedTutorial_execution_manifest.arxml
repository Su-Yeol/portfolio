AUTOSAR XML (schema 00052)
package /apd/Machines/RadarFusionWRSOMEIPMachine/PersistencyKeyValueDatabases
  persistency key value storage ExtendedTutorialKvs: persistency-deployment-uri=/opt/ExtendedTutorial/var/PerKvsDemo.json
package /apd/Machines/RadarFusionWRSOMEIPMachine/PersistentPortPrototypeToKeyValueDatabaseMappings
  persistency port prototype to key value storage mapping ExtendedTutorial: port-prototype=PRKvs, process=ExtendedTutorial, key-value-storage=ExtendedTutorialKvs
package /apd/Machines/RadarFusionWRSOMEIPMachine/ProcessToMachineMappings
  process to machine mapping set ExtendedTutorial
    process to machine mapping ExtendedTutorial: machine=RadarFusionWRSOMEIPMachine, process=ExtendedTutorial
package /apd/Machines/RadarFusionWRSOMEIPMachine/Dlt
  dlt application to process mapping ExtendedTutorialDltApplicationToProcessMapping: dlt-application=ExtendedTutorialApplication, process=ExtendedTutorial
  dlt log sink to port prototype mapping ExtendedTutorialDltLogSinkToPortPrototypeMapping: dlt-context=DefaultDltContext, dlt-log-sink=[ConsoleDltSink, RemoteDltSink, ExtendedTutorialFileDltSink], process=ExtendedTutorial
package /apd/Machines/RadarFusionWRSOMEIPMachine/Processes
  process ExtendedTutorial: executable=ExtendedTutorial, state-dependent-startup-config{function-group-state=[MachineFG.Driving, MachineFG.Parking, MachineFG.Startup], resource-group=ResourceGroup1, startup-config=ExtendedTutorial}
    process state machine state_machine: type=ProcessStateMachine
package /apd/Machines/RadarFusionWRSOMEIPMachine/ServiceInstanceToPortPrototypeMappings
  service instance to port prototype mapping TutIfRequiredInstanceMapping: port-prototype=DemoFunction.TutIf, process=ExtendedTutorial, service-instance=TutorialInterfaceRequiredSomeipServiceInstance
package /apd/Machines/RadarFusionWRSOMEIPMachine/StartupConfigSets
  startup config ExtendedTutorial: scheduling-policy=SCHEDULING-POLICY-ROUND-ROBIN, scheduling-priority=12, termination-behavior=PROCESS-IS-NOT-SELF-TERMINATING
