AUTOSAR XML (schema 00052)
package /apd/Machines/RadarFusionWRSOMEIPMachine/ProcessToMachineMappings
  process to machine mapping set SensorDemoApplication
    process to machine mapping SensorDemoApplication: machine=RadarFusionWRSOMEIPMachine, process=SensorDemoApplication
package /apd/Machines/RadarFusionWRSOMEIPMachine/DltLogChannelToProcessMappings
  dlt application to process mapping SensorDemoDltApplicationToProcessMapping: dlt-application=SensorDemoApplication, process=SensorDemoApplication
  dlt log sink to port prototype mapping SensorDemoDltLogSinkToPortPrototypeMapping: dlt-context=DefaultDltContext, dlt-log-sink=[SensorDemoFileDltSink, ConsoleDltSink, RemoteDltSink], process=SensorDemoApplication
package /apd/Machines/RadarFusionWRSOMEIPMachine/Processes
  process SensorDemoApplication: design=SensorDemoApplication, executable=SensorDemoApplication, number-of-restart-attempts=0, state-dependent-startup-config{function-group-state=[Sensor.Running, Sensor.Calibration], resource-group=ResourceGroup1, startup-config=SensorDemoApplication}
    process state machine state_machine: type=ProcessStateMachine
package /apd/Machines/RadarFusionWRSOMEIPMachine/StartupConfigSets
  startup config SensorDemoApplication: scheduling-policy=SCHEDULING-POLICY-ROUND-ROBIN, scheduling-priority=12, termination-behavior=PROCESS-IS-NOT-SELF-TERMINATING, timeout={enter-timeout-value=0.5, exit-timeout-value=0.25}
