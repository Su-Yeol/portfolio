AUTOSAR XML (schema 00052)
package /apd/Machines/RadarFusionWRSOMEIPMachine/ProcessToMachineMappings
  process to machine mapping set RES_TimingRefServiceApp
    process to machine mapping RES_TimingRefServiceApp: machine=RadarFusionWRSOMEIPMachine, process=RES_TimingRefServiceApp
package /apd/Machines/RadarFusionWRSOMEIPMachine/DltLogChannelToProcessMappings
  dlt application to process mapping RES_TimingRefServiceAppDltApplicationToProcessMapping: dlt-application=RES_TimingRefServiceApp, process=RES_TimingRefServiceApp
  dlt log sink to port prototype mapping RES_TimingRefServiceAppDltLogSinkToPortPrototypeMapping: dlt-context=DefaultDltContext, dlt-log-sink=[ConsoleDltSink, RemoteDltSink, RES_TimingRefServiceAppFileDltSink], process=RES_TimingRefServiceApp
package /apd/Machines/RadarFusionWRSOMEIPMachine/Processes
  process RES_TimingRefServiceApp: design=RES_TimingRefServiceApp, executable=RES_TimingRefServiceApp, state-dependent-startup-config{function-group-state=[MachineFG.Driving, MachineFG.Parking], resource-group=ResourceGroup1, startup-config=RES_TimingRefServiceApp}
    process state machine state_machine: type=ProcessStateMachine
package /apd/Machines/RadarFusionWRSOMEIPMachine/ServiceInstanceToPortPrototypeMappings
  service instance to port prototype mapping TRA_ProvidedServiceInstance_toPort: port-prototype=SensorData_ActuatorPort, process=RES_TimingRefServiceApp, service-instance=TRA_ProvidedSomeipServiceInstance
package /apd/Machines/RadarFusionWRSOMEIPMachine/StartupConfigSets
  startup config RES_TimingRefServiceApp: environment-variables=tag-with-optional-value={key=WRSOMEIP_CONFIG_PATH, value=/etc/wrsomeip.json}, scheduling-policy=SCHEDULING-POLICY-ROUND-ROBIN, scheduling-priority=12, termination-behavior=PROCESS-IS-NOT-SELF-TERMINATING
