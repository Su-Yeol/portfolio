AUTOSAR XML (schema 00052)
package /apd/Machines/RadarFusionWRSOMEIPMachine/ServiceInstanceToMachineMappings
  someip service instance to machine mapping TIT_ProvidedServiceInstance_toMachine: communication-connector=RadarFusionWRSOMEIPConnector, service-instance=TIT_ProvidedSomeipServiceInstance, udp-port=TriggerApplicationEndpoint
package /apd/Machines/RadarFusionWRSOMEIPMachine/ServiceInstances
  provided someip service instance TIT_ProvidedSomeipServiceInstance: service-interface-deployment=TitService_Someip, sd-server-config=SomeipSdServerServiceInstanceConfig, service-instance-id=23
    someip provided event group sensorData_Someip_group: event-group=sensorData_Someip_group, multicast-threshold=0
