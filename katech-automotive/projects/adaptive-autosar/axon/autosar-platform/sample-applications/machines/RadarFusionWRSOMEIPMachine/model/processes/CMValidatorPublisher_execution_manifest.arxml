AUTOSAR XML (schema 00052)
package /apd/Machines/RadarFusionWRSOMEIPMachine/ProcessToMachineMappings
  process to machine mapping set CMValidatorPublisher
    process to machine mapping CMValidatorPublisher: machine=RadarFusionWRSOMEIPMachine, process=CMValidatorPublisher
package /apd/Machines/RadarFusionWRSOMEIPMachine/DltLogChannelToProcessMappings
  dlt application to process mapping CMValidatorPublisherDltApplicationToProcessMapping: dlt-application=CMValidatorPublisherApplication, process=CMValidatorPublisher
  dlt log sink to port prototype mapping CMValidatorPublisherDltLogSinkToPortPrototypeMapping: dlt-context=DefaultDltContext, dlt-log-sink=[ConsoleDltSink, RemoteDltSink, CMValidatorPublisherFileDltSink], process=CMValidatorPublisher
package /apd/Machines/RadarFusionWRSOMEIPMachine/Processes
  process CMValidatorPublisher: design=CMValidatorPublisher, executable=CMValidatorPublisher, state-dependent-startup-config{function-group-state=[MachineFG.Driving, MachineFG.Parking], resource-group=ResourceGroup1, startup-config=CMValidatorPublisherStartup}
    process state machine state_machine: type=ProcessStateMachine
package /apd/Machines/RadarFusionWRSOMEIPMachine/ServiceInstanceToPortPrototypeMappings
  service instance to port prototype mapping CMValidatorPublisher_ProvidedServiceInstance_toPort: port-prototype=CMValidatorPublisher_PPort, process=CMValidatorPublisher, service-instance=CMValidatorPublisherProvidedSomeipServiceInstance
package /apd/Machines/RadarFusionWRSOMEIPMachine/StartupConfigSets
  startup config CMValidatorPublisherStartup: environment-variables=tag-with-optional-value={key=WRSOMEIP_CONFIG_PATH, value=/etc/wrsomeip.json}, scheduling-policy=SCHEDULING-POLICY-ROUND-ROBIN, scheduling-priority=12, termination-behavior=PROCESS-IS-NOT-SELF-TERMINATING
