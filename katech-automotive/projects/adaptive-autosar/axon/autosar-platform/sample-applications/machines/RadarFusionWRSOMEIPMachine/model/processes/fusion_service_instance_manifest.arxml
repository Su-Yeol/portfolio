AUTOSAR XML (schema 00052)
package /apd/Machines/RadarFusionWRSOMEIPMachine/ServiceInstanceToMachineMappings
  someip service instance to machine mapping radar_RequiredServiceInstance_toMachine: communication-connector=RadarFusionWRSOMEIPConnector, service-instance=RadarRequiredSomeipServiceInstance, udp-port=TriggerApplicationEndpoint
package /apd/Machines/RadarFusionWRSOMEIPMachine/ServiceInstances
  required someip service instance RadarRequiredSomeipServiceInstance: service-interface-deployment=Radar_Someip, required-minor-version=0, required-service-instance-id=19, sd-client-config=SomeipSdClientServiceInstanceConfig, version-driven-find-behavior=MINIMUM-MINOR-VERSION
    e-2-e-event-protection-propss:
      end 2 end event protection props End2EndEventProtectionProps: data-ids=4321, e-2-e-profile-configuration=PROFILE_01, event=Brake_Someip, max-data-length=4096, min-data-length=1
      end 2 end event protection props End2EndEventProtectionProps: data-ids=[4321, 4321], e-2-e-profile-configuration=PROFILE_01, event=ParkingBrake_Someip, max-data-length=4096, min-data-length=1
    someip required event group RequiredEventgroup1: event-group=SomeipEventgroup1
    someip required event group RequiredEventgroup2: event-group=SomeipEventgroup2
