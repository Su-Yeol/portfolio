AUTOSAR XML (schema 00052)
package /apd/Machines/RadarFusionWRSOMEIPMachine/ProcessToMachineMappings
  process to machine mapping set access_manager
    process to machine mapping access_manager: machine=RadarFusionWRSOMEIPMachine, process=access_manager
package /apd/Machines/RadarFusionWRSOMEIPMachine/Processes
  process access_manager: design=access_manager_design, executable=access_manager, state-dependent-startup-config{function-group-state=[MachineFG.Startup, MachineFG.Driving, MachineFG.Parking], resource-group=ResourceGroupIAM, startup-config=access_manager_startup}
    process state machine state_machine: type=ProcessStateMachine
  process design access_manager_design: executable=access_manager
package /apd/Machines/RadarFusionWRSOMEIPMachine/startup_configs
  startup config access_manager_startup: scheduling-policy=SCHEDULING-POLICY-ROUND-ROBIN, scheduling-priority=12, termination-behavior=PROCESS-IS-NOT-SELF-TERMINATING
