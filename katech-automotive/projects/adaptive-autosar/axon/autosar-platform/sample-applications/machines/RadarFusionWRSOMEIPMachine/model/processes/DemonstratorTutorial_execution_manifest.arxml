AUTOSAR XML (schema 00052)
package /apd/Machines/RadarFusionWRSOMEIPMachine/ProcessToMachineMappings
  process to machine mapping set DemonstratorTutorial
    process to machine mapping DemonstratorTutorial: machine=RadarFusionWRSOMEIPMachine, process=DemonstratorTutorial
package /apd/Machines/RadarFusionWRSOMEIPMachine/Dlt
  dlt application to process mapping DemostratorTutorialDltApplicationToProcessMapping: dlt-application=DemonstratorTutorialApplication, process=DemonstratorTutorial
  dlt log sink to port prototype mapping DemostratorTutorialDltLogSinkToPortPrototypeMapping: dlt-context=DefaultDltContext, dlt-log-sink=[ConsoleDltSink, RemoteDltSink, DemonstratorTutorialFileDltSink], process=DemonstratorTutorial
package /apd/Machines/RadarFusionWRSOMEIPMachine/Processes
  process DemonstratorTutorial: design=DemonstratorTutorial, executable=DemonstratorTutorial, state-dependent-startup-config{function-group-state=[MachineFG.Driving, MachineFG.Parking], resource-group=ResourceGroup1, startup-config=DemonstratorTutorial}
    process state machine state_machine: type=ProcessStateMachine
package /apd/Machines/RadarFusionWRSOMEIPMachine/ServiceInstanceToPortPrototypeMappings
  service instance to port prototype mapping TutIfProvidedInstance1Mapping: port-prototype=ReportAlive.TutIfInst1, process=DemonstratorTutorial, service-instance=TutorialInterfaceProvidedSomeipServiceInstance1
  service instance to port prototype mapping TutIfProvidedInstance2Mapping: port-prototype=ReportAlive.TutIfInst2, process=DemonstratorTutorial, service-instance=TutorialInterfaceProvidedSomeipServiceInstance2
package /apd/Machines/RadarFusionWRSOMEIPMachine/StartupConfigSets
  startup config DemonstratorTutorial: scheduling-policy=SCHEDULING-POLICY-ROUND-ROBIN, scheduling-priority=12, termination-behavior=PROCESS-IS-NOT-SELF-TERMINATING
