AUTOSAR XML (schema 00052)
package /apd/Machines/testSuiteEcu1WRSOMEIPMachine/ProcessToMachineMappings
  process to machine mapping set CMApp10ProcessToMachineMapping
    process to machine mapping CMApp10SwcInstance1TotestSuiteEcu1WRSOMEIPMachine: machine=testSuiteEcu1WRSOMEIPMachine, process=ST_CMApp10Instance1
package /apd/Machines/testSuiteEcu1WRSOMEIPMachine/Processes
  process ST_CMApp10Instance1: design=ST_CMApp10Instance1, executable=ST_CMApp10, state-dependent-startup-config{function-group-state=SystemTestFunctionGroup.STS_CM_00003, resource-group=ResourceGroup1, startup-config=ST_CMApp10Startup}
    process state machine state_machine: type=ProcessStateMachine
package /apd/Machines/testSuiteEcu1WRSOMEIPMachine/ServiceInstanceToPortPrototypeMappings
  service instance to port prototype mapping CMApp10CMService5RequiredServiceInstanceToPort: port-prototype=CMApp10Service5Rport, process=ST_CMApp10Instance1, service-instance=ST_CMApp10CMService5RequiredSomeipServiceInstance
  service instance to port prototype mapping DataIdentifierPPortToCMApp10: port-prototype=DataIdentifierPport, process=ST_CMApp10Instance1, service-instance=ST_CMApp10DiagDataIdentifierProvidedSomeipServiceInstance
  service instance to port prototype mapping DiagRoutinePPortToCMApp10: port-prototype=DiagRoutineServicePport, process=ST_CMApp10Instance1, service-instance=ST_CMApp10DiagRoutineProvidedSomeipServiceInstance
package /apd/Machines/testSuiteEcu1WRSOMEIPMachine/StartupConfigSets
  startup config ST_CMApp10Startup: environment-variables=[{key=VSOMEIP_CONFIGURATION, value=/opt/CMApp10/etc/vsomeip.json}, {key=DLT_LOG_MODE, value=3}], scheduling-policy=SCHEDULING-POLICY-ROUND-ROBIN, scheduling-priority=12
package /apd/Machines/testSuiteEcu1WRSOMEIPMachine/DltLogChannelToProcessMappings
  dlt application to process mapping ST_CMApp10Instance1DltApplicationToProcessMapping: dlt-application=CMApp10Application, process=ST_CMApp10Instance1
  dlt log sink to port prototype mapping ST_CMApp10Instance1DltLogSinkToPortPrototypeMapping: dlt-context=DefaultDltContext, dlt-log-sink=[CMApp10FileDltSink, ConsoleDltSink, RemoteDltSink], process=ST_CMApp10Instance1
