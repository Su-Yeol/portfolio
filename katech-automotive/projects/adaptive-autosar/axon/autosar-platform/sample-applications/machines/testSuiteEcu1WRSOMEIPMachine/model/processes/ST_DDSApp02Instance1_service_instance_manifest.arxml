AUTOSAR XML (schema 00052)
package /apd/Machines/testSuiteEcu1WRSOMEIPMachine/ServiceInstanceToMachineMappings
  dds service instance to machine mapping DDSService1RequiredServiceInstanceToEcu1Machine: communication-connector=CommunicationWRSOMEIPConnector1, service-instance=[ST_DDSApp02Service1RequiredDdsServiceInstance, ST_DDSApp02Service3RequiredDdsServiceInstance, ST_DDSApp02Service4RequiredDdsServiceInstance]
package /apd/Machines/testSuiteEcu1WRSOMEIPMachine/ServiceInstances
  dds required service instance ST_DDSApp02Service1RequiredDdsServiceInstance: service-interface-deployment=DDSService1_Dds, qos-profile=default, domain-id=42, dds-event-qos-props{qos-profile=default, event=DdsEventA}, required-service-instance-id=29
  dds required service instance ST_DDSApp02Service3RequiredDdsServiceInstance: service-interface-deployment=DDSService3_Dds, qos-profile=default, domain-id=41, required-service-instance-id=31
  dds required service instance ST_DDSApp02Service4RequiredDdsServiceInstance: service-interface-deployment=DDSService4_Dds, qos-profile=default, domain-id=39, required-service-instance-id=32
