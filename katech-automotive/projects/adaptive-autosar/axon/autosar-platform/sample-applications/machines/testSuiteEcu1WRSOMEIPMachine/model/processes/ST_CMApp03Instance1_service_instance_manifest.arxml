AUTOSAR XML (schema 00052)
package /apd/Machines/testSuiteEcu1WRSOMEIPMachine/ServiceInstanceToMachineMappings
  someip service instance to machine mapping CmService1RequiredServiceInstanceToEcu1Machine: communication-connector=CommunicationWRSOMEIPConnector1, service-instance=ST_CMApp03CMService1RequiredSomeipServiceInstance, udp-port=CmService1ApplicationEndpoint
  someip service instance to machine mapping CMApp03DiagDataIdentifierProvidedServiceInstanceToEcu1Machine: communication-connector=CommunicationWRSOMEIPConnector1, service-instance=ST_CMApp03DiagDataIdentifierProvidedSomeipServiceInstance, udp-port=CMApp03DiagDataIdentifierApplicationEndpoint
package /apd/Machines/testSuiteEcu1WRSOMEIPMachine/ServiceInstances
  required someip service instance ST_CMApp03CMService1RequiredSomeipServiceInstance: service-interface-deployment=CMService1_Someip, required-service-instance-id=19, sd-client-config=SomeipSdClientServiceInstanceConfig
  provided someip service instance ST_CMApp03DiagDataIdentifierProvidedSomeipServiceInstance: service-interface-deployment=DataIdentifier_Someip, sd-server-config=SomeipSdServerServiceInstanceConfig, service-instance-id=1001
