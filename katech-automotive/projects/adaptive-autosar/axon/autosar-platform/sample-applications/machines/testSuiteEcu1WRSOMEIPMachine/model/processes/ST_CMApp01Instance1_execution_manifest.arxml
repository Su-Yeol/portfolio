AUTOSAR XML (schema 00052)
package /apd/Machines/testSuiteEcu1WRSOMEIPMachine/ProcessToMachineMappings
  process to machine mapping set CMApp01ProcessToMachineMapping
    process to machine mapping CMApp01SwcInstance1TotestSuiteEcu1WRSOMEIPMachine: machine=testSuiteEcu1WRSOMEIPMachine, process=ST_CMApp01Instance1
package /apd/Machines/testSuiteEcu1WRSOMEIPMachine/Processes
  process ST_CMApp01Instance1: design=ST_CMApp01Instance1, executable=ST_CMApp01, state-dependent-startup-config{function-group-state=SystemTestFunctionGroup.STS_CM_00001, resource-group=ResourceGroup1, startup-config=ST_CMApp01Startup}
    process state machine state_machine: type=ProcessStateMachine
package /apd/Machines/testSuiteEcu1WRSOMEIPMachine/ServiceInstanceToPortPrototypeMappings
  service instance to port prototype mapping CMService1ProvidedServiceInstanceToPort: port-prototype=CMApp01Service1Pport, process=ST_CMApp01Instance1, service-instance=ST_CMService1ProvidedSomeipServiceInstance
  service instance to port prototype mapping DiagRoutinePPortToCMApp01: port-prototype=DiagRoutineServicePport, process=ST_CMApp01Instance1, service-instance=ST_CMApp01DiagRoutineProvidedSomeipServiceInstance
package /apd/Machines/testSuiteEcu1WRSOMEIPMachine/StartupConfigSets
  startup config ST_CMApp01Startup: environment-variables=[{key=VSOMEIP_CONFIGURATION, value=/opt/CMApp01/etc/vsomeip.json}, {key=DLT_LOG_MODE, value=3}], scheduling-policy=SCHEDULING-POLICY-ROUND-ROBIN, scheduling-priority=12
package /apd/Machines/testSuiteEcu1WRSOMEIPMachine/DltLogChannelToProcessMappings
  dlt application to process mapping ST_CMApp01Instance1DltApplicationToProcessMapping: dlt-application=CMApp01Application, process=ST_CMApp01Instance1
  dlt log sink to port prototype mapping ST_CMApp01Instance1DltLogSinkToPortPrototypeMapping: dlt-context=DefaultDltContext, dlt-log-sink=[CMApp01FileDltSink, ConsoleDltSink, RemoteDltSink], process=ST_CMApp01Instance1
