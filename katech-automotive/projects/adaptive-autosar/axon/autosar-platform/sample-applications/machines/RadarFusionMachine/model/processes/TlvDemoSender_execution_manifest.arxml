AUTOSAR XML (schema 00052)
package /apd/Machines/RadarFusionMachine/ProcessToMachineMappings
  process to machine mapping set TlvDemoSender
    process to machine mapping TlvDemoSender: machine=RadarFusionMachine, process=TlvDemoSender
package /apd/Machines/RadarFusionMachine/Dlt
  dlt application to process mapping TlvDemoSenderDltApplicationToProcessMapping: dlt-application=TlvDemoSenderApplication, process=TlvDemoSender
  dlt log sink to port prototype mapping TlvDemoSenderDltLogSinkToPortPrototypeMapping: dlt-context=DefaultDltContext, dlt-log-sink=[ConsoleDltSink, RemoteDltSink, TlvDemoSenderFileDltSink], process=TlvDemoSender
package /apd/Machines/RadarFusionMachine/Processes
  process TlvDemoSender: design=TlvDemoSender, executable=TlvDemoSender, state-dependent-startup-config{function-group-state=MachineFG.Parking, resource-group=ResourceGroup1, startup-config=TlvDemoSenderStartup}
    process state machine state_machine: type=ProcessStateMachine
package /apd/Machines/RadarFusionMachine/ServiceInstanceToPortPrototypeMappings
  service instance to port prototype mapping tlv_ProvidedServiceInstance_toPort: port-prototype=tlv_PPort, process=TlvDemoSender, service-instance=TlvProvidedSomeipServiceInstance
package /apd/Machines/RadarFusionMachine/StartupConfigSets
  startup config TlvDemoSenderStartup: environment-variables=tag-with-optional-value={key=VSOMEIP_CONFIGURATION, value=/etc/vsomeip.json}, scheduling-policy=SCHEDULING-POLICY-ROUND-ROBIN, scheduling-priority=12, termination-behavior=PROCESS-IS-NOT-SELF-TERMINATING
