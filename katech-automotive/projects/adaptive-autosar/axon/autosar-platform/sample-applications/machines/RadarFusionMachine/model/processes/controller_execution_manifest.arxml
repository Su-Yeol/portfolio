AUTOSAR XML (schema 00052)
package /apd/Machines/RadarFusionMachine/DltLogChannelToProcessMappings
  dlt application to process mapping ControllerToLogChannelMapping: dlt-application=Controller, process=controller
  dlt log sink to port prototype mapping ControllerDltLogSinkToPortPrototypeMapping: dlt-context=DefaultDltContext, dlt-log-sink=[ControllerFileDltSink, ConsoleDltSink, RemoteDltSink], process=controller
package /apd/Machines/RadarFusionMachine/ProcessToMachineMappings
  process to machine mapping set controller
    process to machine mapping controller: machine=RadarFusionMachine, process=controller
package /apd/Machines/RadarFusionMachine/ServiceInstanceToPortPrototypeMappings
  service instance to port prototype mapping RequiredControllerInstanceToPortMappingActor: port-prototype=ControllerRPortActor, process=controller, service-instance=RequiredSomeIpActorInstance
  service instance to port prototype mapping RequiredControllerInstanceToPortMappingLineSensor: port-prototype=ControllerRPortLineSensor, process=controller, service-instance=RequiredSomeIpLineSensorInstance
  service instance to port prototype mapping RequiredControllerInstanceToPortMappingUltraSonicSensor: port-prototype=ControllerRPortUltraSonicSensor, process=controller, service-instance=RequiredSomeIpUltraSonicSensorInstance
package /apd/Machines/RadarFusionMachine/StartupConfigSets
  startup config controller_startup: process-argument=--rest, scheduling-policy=SCHEDULING-POLICY-ROUND-ROBIN, scheduling-priority=12, termination-behavior=PROCESS-IS-NOT-SELF-TERMINATING
package /apd/Machines/RadarFusionMachine/Processes
  process controller: executable=controller
    process state machine state_machine: type=ProcessStateMachine
    state-dependent-startup-configs:
      function-group-state=ControllerApplicationFG.Running, resource-group=ResourceGroup1, startup-config=controller_startup
      function-group-state=ControllerApplicationFG.Verify, resource-group=ResourceGroup1, startup-config=controller_startup
