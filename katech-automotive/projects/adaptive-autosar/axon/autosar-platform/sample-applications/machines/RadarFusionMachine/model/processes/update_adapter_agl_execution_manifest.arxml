AUTOSAR XML (schema 00052)
package /apd/Machines/RadarFusionMachine/DltLogChannelToProcessMappings
  dlt application to process mapping update_adapter_aglDltApplicationToProcessMapping: dlt-application=UpdateAdapterAGLApplication, process=update_adapter_agl
  dlt log sink to port prototype mapping update_adapter_aglDltLogSinkToPortPrototypeMapping: dlt-context=DefaultDltContext, dlt-log-sink=[ConsoleDltSink, RemoteDltSink, UpdateAdapterAGLFileDltSink], process=update_adapter_agl
package /apd/Machines/RadarFusionMachine/PersistencyKeyValueStorages
  persistency key value storage SwPackageTransferStatusStorageForUpdateAdapterAGL: persistency-deployment-uri=/opt/update_adapter_agl/var/transfer_status_database.json
package /apd/Machines/RadarFusionMachine/PersistentPortPrototypeToKeyValueStorageMappings
  persistency port prototype to key value storage mapping SwPackageTransferStatusStorageToPortMappingForUpdateAdapterAGL: port-prototype=SwPackageTransferStatusPRPort, process=update_adapter_agl, key-value-storage=SwPackageTransferStatusStorageForUpdateAdapterAGL
package /apd/Machines/RadarFusionMachine/ProcessToMachineMappings
  process to machine mapping set update_adapter_agl_mapping_set
    process to machine mapping update_adapter_agl_mapping: machine=RadarFusionMachine, process=update_adapter_agl
package /apd/Machines/RadarFusionMachine/Processes
  process update_adapter_agl: executable=update_adapter_agl, state-dependent-startup-config{function-group-state=MachineFG.Parking, resource-group=ResourceGroup1, startup-config=update_adapter_agl_startup}
    process state machine state_machine: type=ProcessStateMachine
package /apd/Machines/RadarFusionMachine/ServiceInstanceToPortPrototypeMappings
  service instance to port prototype mapping UpdateAdapterAGLPackageManagementInstanceToPortMapping: port-prototype=PackageManagementProvided, process=update_adapter_agl, service-instance=UpdateAdapterAglSomeIpPackageManagementInstance
package /apd/Machines/RadarFusionMachine/StartupConfigSets
  startup config update_adapter_agl_startup: process-arguments=[--ucmId, UAGL, --itm], scheduling-policy=SCHEDULING-POLICY-ROUND-ROBIN, scheduling-priority=12, termination-behavior=PROCESS-IS-NOT-SELF-TERMINATING
