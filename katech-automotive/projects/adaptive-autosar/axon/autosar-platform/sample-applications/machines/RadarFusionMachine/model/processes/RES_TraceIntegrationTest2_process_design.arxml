AUTOSAR XML (schema 00052)
package /apd/Machines/RadarFusionMachine/ProcessDesigns
  process design RES_TraceIntegrationTest2: executable=RES_TraceIntegrationTest2
