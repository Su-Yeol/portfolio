AUTOSAR XML (schema 00052)
package /apd/Machines/RadarFusionMachine/Processes
  process SecDemoFc: executable=SecDemoFc, state-dependent-startup-config{execution-dependency=state_machine.Running, function-group-state=MachineFG.Parking, resource-group=ResourceGroup1, startup-config=SecDemoFc}
    process state machine state_machine: type=ProcessStateMachine
package /apd/Machines/RadarFusionMachine/ProcessToMachineMappings
  process to machine mapping set SecDemoFc
    process to machine mapping SecDemoFc: machine=RadarFusionMachine, process=SecDemoFc
package /apd/Machines/RadarFusionMachine/DltLogChannelToProcessMappings
  dlt application to process mapping SecDemoFcDltApplicationToProcessMapping: dlt-application=SecDemoFcApplication, process=SecDemoFc
  dlt log sink to port prototype mapping SecDemoFcDltLogSinkToPortPrototypeMapping: dlt-context=DefaultDltContext, dlt-log-sink=[ConsoleDltSink, RemoteDltSink, SecDemoFcFileDltSink], process=SecDemoFc
package /apd/Machines/RadarFusionMachine/StartupConfigSets
  startup config SecDemoFc: environment-variables=tag-with-optional-value={key=DLT_LOG_MODE, value=3}, scheduling-policy=SCHEDULING-POLICY-ROUND-ROBIN, scheduling-priority=12
