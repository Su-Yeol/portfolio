AUTOSAR XML (schema 00052)
package /apd/Machines/RadarFusionMachine/ProcessToMachineMappings
  process to machine mapping set vehicle_driver_application
    process to machine mapping vehicle_driver_application: machine=RadarFusionMachine, process=vehicle_driver_application
package /apd/Machines/RadarFusionMachine/DltLogChannelToProcessMappings
  dlt application to process mapping vehicle_driver_applicationDltApplicationToProcessMapping: dlt-application=VehicleDriverIfApplication, process=vehicle_driver_application
  dlt log sink to port prototype mapping vehicle_driver_applicationDltLogSinkToPortPrototypeMapping: dlt-context=DefaultDltContext, dlt-log-sink=[ConsoleDltSink, RemoteDltSink, VehicleDriverIfFileDltSink], process=vehicle_driver_application
package /apd/Machines/RadarFusionMachine/Processes
  process vehicle_driver_application: executable=vehicle_driver_application
    process state machine state_machine: type=ProcessStateMachine
    state-dependent-startup-configs:
      function-group-state=UCMDemoModeFG.VUCM_ITM, resource-group=ResourceGroup1, startup-config=vehicle_driver_application_itm
      function-group-state=[UCMDemoModeFG.VUCM_Backend_Hawkbit, UCMDemoModeFG.VUCM_Backend_Pull], resource-group=ResourceGroup1, startup-config=vehicle_driver_application_demo
package /apd/Machines/RadarFusionMachine/ServiceInstanceToPortPrototypeMappings
  service instance to port prototype mapping RequiredVehiclePackageManagementInstanceToPortMapping: port-prototype=VehicleDriverApplicationInterfaceRPort, process=vehicle_driver_application, service-instance=RequiredSomeIpVehicleDriverApplicationInterfaceInstance
package /apd/Machines/RadarFusionMachine/StartupConfigSets
  startup config vehicle_driver_application_demo: process-arguments=[--itm-mode, disabled], scheduling-policy=SCHEDULING-POLICY-ROUND-ROBIN, scheduling-priority=12, termination-behavior=PROCESS-IS-NOT-SELF-TERMINATING
  startup config vehicle_driver_application_itm: process-arguments=[--itm-mode, enabled], scheduling-policy=SCHEDULING-POLICY-ROUND-ROBIN, scheduling-priority=12, termination-behavior=PROCESS-IS-NOT-SELF-TERMINATING
