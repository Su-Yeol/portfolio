AUTOSAR XML (schema 00052)
package /apd/Machines/RadarFusionMachine/PersistencyKeyValueStorages
  persistency key value storage VehiclePackageTransferStatusStorage: persistency-deployment-uri=/opt/vehicle_package_manager/var/vehiclepackage_transfer_status_database.json
package /apd/Machines/RadarFusionMachine/PersistentPortPrototypeToKeyValueStorageMappings
  persistency port prototype to key value storage mapping VehiclePackageTransferStatusStorageToPortMapping: port-prototype=VehiclePackageTransferStatusPRPort, process=vehicle_package_manager, key-value-storage=VehiclePackageTransferStatusStorage
package /apd/Machines/RadarFusionMachine/ProcessToMachineMappings
  process to machine mapping set vehicle_package_manager
    process to machine mapping vehicle_package_manager: machine=RadarFusionMachine, process=vehicle_package_manager
package /apd/Machines/RadarFusionMachine/DltLogChannelToProcessMappings
  dlt application to process mapping vehicle_package_managerDltApplicationToProcessMapping: dlt-application=VehiclePackageManager, process=vehicle_package_manager
  dlt log sink to port prototype mapping vehicle_package_managerDltLogSinkToPortPrototypeMapping: dlt-context=DefaultDltContext, dlt-log-sink=[ConsoleDltSink, RemoteDltSink, VehiclePackageManagerFileDltSink], process=vehicle_package_manager
package /apd/Machines/RadarFusionMachine/Processes
  process vehicle_package_manager: executable=vehicle_package_manager, state-dependent-startup-config{function-group-state=[MachineFG.Driving, MachineFG.Parking], resource-group=ResourceGroup1, startup-config=package_manager_startup}
    process state machine state_machine: type=ProcessStateMachine
package /apd/Machines/RadarFusionMachine/ServiceInstanceToPortPrototypeMappings
  4 x service instance to port prototype mapping, all with process=vehicle_package_manager:
    ProvidedVehicleDriverApplicationInterfaceInstanceToPortMapping: port-prototype=VehicleDriverApplicationInterfacePPort, service-instance=ProvidedSomeIpVehicleDriverApplicationInterfaceInstance
    ProvidedVehiclePackageManagementInstanceToPortMapping: port-prototype=VehiclePackageManagementPPort, service-instance=ProvidedSomeIpVehiclePackageManagementInstance
    ProvidedVehicleStateManagerInterfaceInstanceToPortMapping: port-prototype=VehicleStateManagerInterfacePPort, service-instance=ProvidedSomeIpVehicleStateManagerInterfaceInstance
    RequiredPackageManagementInstanceToPortMappingForVehiclePackageManagement: port-prototype=PackageManagementRPort, service-instance=RequiredSomeIpPackageManagementInstanceForVehiclePackageManager
package /apd/Machines/RadarFusionMachine/StartupConfigSets
  startup config vehicle_package_manager_startup: process-argument=--itm, scheduling-policy=SCHEDULING-POLICY-ROUND-ROBIN, scheduling-priority=12, termination-behavior=PROCESS-IS-NOT-SELF-TERMINATING
