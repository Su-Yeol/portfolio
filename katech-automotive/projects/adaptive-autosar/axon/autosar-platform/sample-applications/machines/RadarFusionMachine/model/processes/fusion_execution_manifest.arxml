AUTOSAR XML (schema 00052)
package /apd/Machines/RadarFusionMachine/ProcessToMachineMappings
  process to machine mapping set Fusion
    process to machine mapping Fusion: machine=RadarFusionMachine, process=fusion
package /apd/Machines/RadarFusionMachine/DltLogChannelToProcessMappings
  dlt application to process mapping fusionDltApplicationToProcessMapping: dlt-application=FusionApplication, process=fusion
  dlt log sink to port prototype mapping fusionDltLogSinkToPortPrototypeMapping: dlt-context=DefaultDltContext, dlt-log-sink=[ConsoleDltSink, RemoteDltSink, FusionFileDltSink], process=fusion
package /apd/Machines/RadarFusionMachine/Processes
  process fusion: design=fusion, executable=fusion, state-dependent-startup-config{function-group-state=[MachineFG.Driving, MachineFG.Parking], resource-group=ResourceGroup1, startup-config=FusionStartup}
    process state machine state_machine: type=ProcessStateMachine
package /apd/Machines/RadarFusionMachine/ServiceInstanceToPortPrototypeMappings
  service instance to port prototype mapping radar_RequiredServiceInstance_toPort: port-prototype=radar_RPort, process=fusion, service-instance=RadarRequiredSomeipServiceInstance
package /apd/Machines/RadarFusionMachine/StartupConfigSets
  startup config FusionStartup: environment-variables=tag-with-optional-value={key=VSOMEIP_CONFIGURATION, value=/etc/vsomeip.json}, scheduling-policy=SCHEDULING-POLICY-ROUND-ROBIN, scheduling-priority=12, termination-behavior=PROCESS-IS-NOT-SELF-TERMINATING
