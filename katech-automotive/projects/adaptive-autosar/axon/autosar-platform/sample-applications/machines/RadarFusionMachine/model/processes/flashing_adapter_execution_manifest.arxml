AUTOSAR XML (schema 00052)
package /apd/Machines/RadarFusionMachine/DltLogChannelToProcessMappings
  dlt application to process mapping flashing_adapterDltApplicationToProcessMapping: dlt-application=FlashingAdapterApplication, process=flashing_adapter
  dlt log sink to port prototype mapping flashing_adapterDltLogSinkToPortPrototypeMapping: dlt-context=DefaultDltContext, dlt-log-sink=[ConsoleDltSink, FlashingAdapterFileDltSink, RemoteDltSink], process=flashing_adapter
package /apd/Machines/RadarFusionMachine/PersistencyKeyValueStorages
  persistency key value storage SwClusterDescStorage: persistency-deployment-uri=/opt/flashing_adapter/var/flashing_adapter_sw_cluster_desc_database.json
  persistency key value storage SwPackageTransferStatusStorageForFlashingAdapter: persistency-deployment-uri=/opt/flashing_adapter/var/flashing_adapter_transfer_status_database.json
package /apd/Machines/RadarFusionMachine/PersistentPortPrototypeToKeyValueStorageMappings
  persistency port prototype to key value storage mapping SwClusterDescStorageToPortMapping: port-prototype=SwClusterDescPRPort, process=flashing_adapter, key-value-storage=SwClusterDescStorage
  persistency port prototype to key value storage mapping SwPackageTransferStatusStorageToPortMappingForFlashingAdapter: port-prototype=SwPackageTransferStatusPRPort, process=flashing_adapter, key-value-storage=SwPackageTransferStatusStorageForFlashingAdapter
package /apd/Machines/RadarFusionMachine/ProcessToMachineMappings
  process to machine mapping set flashing_adapter_mapping_set
    process to machine mapping flashing_adapter_mapping: machine=RadarFusionMachine, process=flashing_adapter
package /apd/Machines/RadarFusionMachine/Processes
  process flashing_adapter: executable=flashing_adapter, state-dependent-startup-config{function-group-state=[MachineFG.Driving, MachineFG.Parking], resource-group=ResourceGroup1, startup-config=flashing_adapter_startup}
    process state machine state_machine: type=ProcessStateMachine
package /apd/Machines/RadarFusionMachine/ServiceInstanceToPortPrototypeMappings
  service instance to port prototype mapping FlashingAdapterPackageManagementInstanceToPortMapping: port-prototype=PackageManagementProvided, process=flashing_adapter, service-instance=FlashingAdapterSomeIpPackageManagementInstance
package /apd/Machines/RadarFusionMachine/StartupConfigSets
  startup config flashing_adapter_startup: process-arguments=[--ucmId, FLAD], scheduling-policy=SCHEDULING-POLICY-ROUND-ROBIN, scheduling-priority=12, termination-behavior=PROCESS-IS-NOT-SELF-TERMINATING
