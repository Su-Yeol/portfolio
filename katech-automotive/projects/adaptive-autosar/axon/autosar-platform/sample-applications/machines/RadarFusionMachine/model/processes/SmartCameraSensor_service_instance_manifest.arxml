AUTOSAR XML (schema 00052)
package /apd/Machines/RadarFusionMachine/ServiceInstanceToMachineMappings
  9 x someip service instance to machine mapping, all with communication-connector=RadarFusionConnector, udp-port=TriggerApplicationEndpointExtended:
    SmartCameraSensor_ProvidedServiceInstance_toMachine: service-instance=SmartCameraSensorProvidedSomeipServiceInstance
    SmartCameraSensor_ProvidedServiceInstance{2..9}_toMachine: service-instance=SmartCameraSensorProvidedSomeipServiceInstance{2..9}
package /apd/Machines/RadarFusionMachine/ServiceInstances
  9 x provided someip service instance, all with sd-server-config=SomeipSdServerServiceInstanceConfig:
    SmartCameraSensorProvidedSomeipServiceInstance: service-interface-deployment=RoadObjects_Someip, service-instance-id=119
      e-2-e-event-protection-propss:
        end 2 end event protection props End2EndEventProtectionProps: data-ids=[4321, 4321], e-2-e-profile-configuration=PROFILE_01, event=RoadObjectInterface_Someip, max-data-length=4096, min-data-length=1
      someip provided event group RequiredEventgroup1: event-group=SomeipEventgroup1, multicast-threshold=0
    SmartCameraSensorProvidedSomeipServiceInstance2: service-interface-deployment=StaticObjects_Someip, service-instance-id=139
      e-2-e-event-protection-propss:
        end 2 end event protection props End2EndEventProtectionProps: data-ids=4321, e-2-e-profile-configuration=PROFILE_01, event=StaticObjectInterface_Someip, max-data-length=4096, min-data-length=1
      someip provided event group RequiredEventgroup1: event-group=SomeipEventgroup1, multicast-threshold=0
    SmartCameraSensorProvidedSomeipServiceInstance3: service-interface-deployment=PotentiallyMovingObjects_Someip, service-instance-id=189
      e-2-e-event-protection-propss:
        end 2 end event protection props End2EndEventProtectionProps: data-ids=4321, e-2-e-profile-configuration=PROFILE_01, event=PotentiallyMovingObjectsInterface_Someip, max-data-length=4096, min-data-length=1
      someip provided event group RequiredEventgroup1: event-group=SomeipEventgroup1, multicast-threshold=0
    SmartCameraSensorProvidedSomeipServiceInstance4: service-interface-deployment=CameraFeatures_Someip, service-instance-id=188
      e-2-e-event-protection-propss:
        end 2 end event protection props End2EndEventProtectionProps: data-ids=4321, e-2-e-profile-configuration=PROFILE_01, event=CameraFeaturesInterface_Someip, max-data-length=4096, min-data-length=1
      someip provided event group RequiredEventgroup1: event-group=SomeipEventgroup1, multicast-threshold=0
    SmartCameraSensorProvidedSomeipServiceInstance5: service-interface-deployment=CameraDetection_Someip, service-instance-id=187
      e-2-e-event-protection-propss:
        end 2 end event protection props End2EndEventProtectionProps: data-ids=4321, e-2-e-profile-configuration=PROFILE_01, event=CameraDetectionInterface_Someip, max-data-length=4096, min-data-length=1
      someip provided event group RequiredEventgroup1: event-group=SomeipEventgroup1, multicast-threshold=0
    SmartCameraSensorProvidedSomeipServiceInstance6: service-interface-deployment=UltrasonicDetections_Someip, service-instance-id=186
      e-2-e-event-protection-propss:
        end 2 end event protection props End2EndEventProtectionProps: data-ids=4321, e-2-e-profile-configuration=PROFILE_01, event=UltrasonicDetectionsInterface_Someip, max-data-length=4096, min-data-length=1
      someip provided event group RequiredEventgroup1: event-group=SomeipEventgroup1, multicast-threshold=0
    SmartCameraSensorProvidedSomeipServiceInstance7: service-interface-deployment=UltrasonicFeatures_Someip, service-instance-id=185
      e-2-e-event-protection-propss:
        end 2 end event protection props End2EndEventProtectionProps: data-ids=4321, e-2-e-profile-configuration=PROFILE_01, event=UltrasonicFeaturesInterface_Someip, max-data-length=4096, min-data-length=1
      someip provided event group RequiredEventgroup1: event-group=SomeipEventgroup1, multicast-threshold=0
    SmartCameraSensorProvidedSomeipServiceInstance8: service-interface-deployment=LidarDetections_Someip, service-instance-id=184
      e-2-e-event-protection-propss:
        end 2 end event protection props End2EndEventProtectionProps: data-ids=4321, e-2-e-profile-configuration=PROFILE_01, event=LidarDetectionsInterface_Someip, max-data-length=4096, min-data-length=1
      someip provided event group RequiredEventgroup1: event-group=SomeipEventgroup1, multicast-threshold=0
    SmartCameraSensorProvidedSomeipServiceInstance9: service-interface-deployment=RadarDetections_Someip, service-instance-id=183
      e-2-e-event-protection-propss:
        end 2 end event protection props End2EndEventProtectionProps: data-ids=4321, e-2-e-profile-configuration=PROFILE_01, event=RadarDetectionsInterface_Someip, max-data-length=4096, min-data-length=1
      someip provided event group RequiredEventgroup1: event-group=SomeipEventgroup1, multicast-threshold=0
