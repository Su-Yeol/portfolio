AUTOSAR XML (schema 00052)
package /apd/Machines/RadarFusionMachine/ProcessToMachineMappings
  process to machine mapping set pkgmgr_sample
    process to machine mapping pkgmgr_sample: machine=RadarFusionMachine, process=pkgmgr_sample
package /apd/Machines/RadarFusionMachine/DltLogChannelToProcessMappings
  dlt application to process mapping pkgmgr_sampleDltApplicationToProcessMapping: dlt-application=PkgmgrApplication, process=pkgmgr_sample
  dlt log sink to port prototype mapping pkgmgr_sampleDltLogSinkToPortPrototypeMapping: dlt-context=DefaultDltContext, dlt-log-sink=[ConsoleDltSink, RemoteDltSink, PkgmgrFileDltSink], process=pkgmgr_sample
package /apd/Machines/RadarFusionMachine/Processes
  process pkgmgr_sample: executable=pkgmgr_sample, state-dependent-startup-config{function-group-state=UCMDemoModeFG.UCM_ITM, resource-group=ResourceGroup1, startup-config=pkgmgr_sample_startup}
    process state machine state_machine: type=ProcessStateMachine
package /apd/Machines/RadarFusionMachine/ServiceInstanceToPortPrototypeMappings
  service instance to port prototype mapping RequiredPackageManagementInstanceToPortMapping: port-prototype=PackageManagementRPort, process=pkgmgr_sample, service-instance=RequiredSomeIpPackageManagementInstance
package /apd/Machines/RadarFusionMachine/StartupConfigSets
  startup config pkgmgr_sample_startup: scheduling-policy=SCHEDULING-POLICY-ROUND-ROBIN, scheduling-priority=12, termination-behavior=PROCESS-IS-SELF-TERMINATING
    process-arguments:
      --campaign
      UpdatableAppSwpkgInstall_1.0.0.zip
      --campaign
      UpdatableAppSwpkgUpdate_2.0.0.zip
      --campaign
      UpdatableAppSwpkgRemove_3.0.0.zip
      --test-downgrade
      UpdatableAppSwpkgInstall_1.0.0.zip
      --ucmId
      RadarFusionMachineUCM
