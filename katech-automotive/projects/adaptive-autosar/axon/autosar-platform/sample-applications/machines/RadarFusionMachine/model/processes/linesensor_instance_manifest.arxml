AUTOSAR XML (schema 00052)
package /apd/Machines/RadarFusionMachine/ServiceInstances
  provided someip service instance ProvidedSomeIpLineSensorInstance: service-interface-deployment=LineSensorSomeIp, sd-server-config=SomeipSdServerServiceInstanceConfig, service-instance-id=20556
    someip provided event group LineSensorEventGroup: event-group=LineSensorEventGroup, multicast-threshold=0
package /apd/Machines/RadarFusionMachine/ServiceInstanceToMachineMappings
  someip service instance to machine mapping ProvidedLineSensorInstanceToMachineMapping: communication-connector=RadarFusionConnector, service-instance=ProvidedSomeIpLineSensorInstance, udp-port=PicarApplicationEndpoint
