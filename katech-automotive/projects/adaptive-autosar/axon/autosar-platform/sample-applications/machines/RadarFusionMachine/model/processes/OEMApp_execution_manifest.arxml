AUTOSAR XML (schema 00052)
package /apd/Machines/RadarFusionMachine/ProcessToMachineMappings
  process to machine mapping set OEMApp
    process to machine mapping OEMApp: machine=RadarFusionMachine, process=OEMApp
package /apd/Machines/RadarFusionMachine/Processes
  process OEMApp: executable=OEMApp
    process state machine StateMachine: type=ProcessStateMachine
    state-dependent-startup-configs:
      execution-dependency=state_machine.Running, function-group-state=MachineFG.Driving, resource-group=ResourceGroup1, startup-config=OEMAppRunning
      function-group-state=MachineFG.Parking, resource-group=ResourceGroup1, startup-config=OEMAppParking
package /apd/Machines/RadarFusionMachine/DltLogChannelToProcessMappings
  dlt application to process mapping OEMAppDltApplicationToProcessMapping: dlt-application=OEMApplication, process=OEMApp
  dlt log sink to port prototype mapping OEMAppDltLogSinkToPortPrototypeMapping: dlt-context=DefaultDltContext, dlt-log-sink=[ConsoleDltSink, RemoteDltSink, OEMAppFileDltSink], process=OEMApp
package /apd/Machines/RadarFusionMachine/StartupConfigSets
  startup config OEMAppRunning: process-arguments=[--state, Driving], scheduling-policy=SCHEDULING-POLICY-ROUND-ROBIN, scheduling-priority=12, termination-behavior=PROCESS-IS-SELF-TERMINATING
  startup config OEMAppParking: process-arguments=[--state, Parking], scheduling-policy=SCHEDULING-POLICY-ROUND-ROBIN, scheduling-priority=12, termination-behavior=PROCESS-IS-SELF-TERMINATING
