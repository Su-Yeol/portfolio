AUTOSAR XML (schema 00052)
package /apd/Machines/RadarFusionMachine/Dlt
  dlt application to process mapping DemonstratorTutorialDltApplicationToProcessMapping: dlt-application=DemonstratorTutorialApplication, process=DemonstratorTutorial
  dlt log sink to port prototype mapping DemonstratorTutorialDltLogSinkToPortPrototypeMapping: dlt-context=DefaultDltContext, dlt-log-sink=[DemonstratorTutorialFileDltSink, RemoteDltSink, ConsoleDltSink], process=DemonstratorTutorial
package /apd/Machines/RadarFusionMachine/ProcessToMachineMappings
  process to machine mapping set DemonstratorTutorial
    process to machine mapping DemonstratorTutorial: machine=RadarFusionMachine, process=DemonstratorTutorial
package /apd/Machines/RadarFusionMachine/Processes
  process DemonstratorTutorial: design=DemonstratorTutorial, executable=DemonstratorTutorial, state-dependent-startup-config{function-group-state=[MachineFG.Driving, MachineFG.Parking], resource-group=ResourceGroup1, startup-config=DemonstratorTutorial}
    process state machine state_machine: type=ProcessStateMachine
package /apd/Machines/RadarFusionMachine/ServiceInstanceToPortPrototypeMappings
  service instance to port prototype mapping TutIfProvidedInstance1Mapping: port-prototype=ReportAlive.TutIfInst1, process=DemonstratorTutorial, service-instance=TutorialInterfaceProvidedSomeipServiceInstance1
  service instance to port prototype mapping TutIfProvidedInstance2Mapping: port-prototype=ReportAlive.TutIfInst2, process=DemonstratorTutorial, service-instance=TutorialInterfaceProvidedSomeipServiceInstance2
package /apd/Machines/RadarFusionMachine/StartupConfigSets
  startup config DemonstratorTutorial: scheduling-policy=SCHEDULING-POLICY-ROUND-ROBIN, scheduling-priority=12, termination-behavior=PROCESS-IS-NOT-SELF-TERMINATING
