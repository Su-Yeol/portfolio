AUTOSAR XML (schema 00052)
package /apd/Machines/RadarFusionMachine/ServiceInstanceToMachineMappings
  someip service instance to machine mapping RequiredVehicleStateManagerInterfaceInstanceToMachineMapping: communication-connector=RadarFusionConnector, service-instance=RequiredSomeIpVehicleStateManagerInterfaceInstance, udp-port=UpdateRequestApplicationEndpoint
package /apd/Machines/RadarFusionMachine/ServiceInstances
  required someip service instance RequiredSomeIpVehicleStateManagerInterfaceInstance: service-interface-deployment=VehicleStateManagerInterfaceSomeIp, required-minor-version=0, required-service-instance-id=ANY, sd-client-config=SomeipSdClientServiceInstanceConfig
    someip required event group VehicleConditionCollection_required_eventgroup: event-group=VehicleConditionCollection_eventgroup
