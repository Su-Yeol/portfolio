AUTOSAR XML (schema 00052)
package /apd/Machines/RadarFusionMachine/ServiceInstanceToMachineMappings
  someip service instance to machine mapping TRA_ProvidedServiceInstance_toMachine: communication-connector=RadarFusionConnector, service-instance=TRA_ProvidedSomeipServiceInstance, udp-port=TriggerApplicationEndpoint
package /apd/Machines/RadarFusionMachine/ServiceInstances
  provided someip service instance TRA_ProvidedSomeipServiceInstance: service-interface-deployment=SensorActuatorService_Someip, sd-server-config=SomeipSdServerServiceInstanceConfig, service-instance-id=23
    someip provided event group sensorData_Someip_group: event-group=sensorData_Someip_group, multicast-threshold=0
