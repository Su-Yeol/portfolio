AUTOSAR XML (schema 00052)
package /apd/Machines/RadarFusionMachine/ServiceInstanceToMachineMappings
  someip service instance to machine mapping RequiredServiceInstance_toMachine: communication-connector=RadarFusionConnector, service-instance=TRA_RequiredSomeipServiceInstance, udp-port=TriggerApplicationEndpoint
package /apd/Machines/RadarFusionMachine/ServiceInstances
  required someip service instance TRA_RequiredSomeipServiceInstance: service-interface-deployment=SensorActuatorService_Someip, required-minor-version=0, required-service-instance-id=23, sd-client-config=SomeipSdClientServiceInstanceConfig, version-driven-find-behavior=MINIMUM-MINOR-VERSION
    someip required event group sensorData_Someip_group: event-group=sensorData_Someip_group
