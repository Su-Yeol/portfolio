AUTOSAR XML (schema 00052)
package /apd/Machines/testSuiteEcu2Machine/ProcessDesigns
  process design ST_CMApp14Instance1: executable=ST_CMApp14
