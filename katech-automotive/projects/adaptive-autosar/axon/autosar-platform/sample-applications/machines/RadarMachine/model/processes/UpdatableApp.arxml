AUTOSAR XML (schema 00052)
package /apd/Machines/RadarMachine
  process design UpdatableAppDesign: executable=UpdatableApp
