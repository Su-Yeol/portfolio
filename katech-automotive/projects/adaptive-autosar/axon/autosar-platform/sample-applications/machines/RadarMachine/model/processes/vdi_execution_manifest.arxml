AUTOSAR XML (schema 00052)
package /apd/Machines/RadarMachine/ProcessToMachineMappings
  process to machine mapping set vehicle_driver_application
    process to machine mapping vehicle_driver_application: machine=RadarMachine, process=vehicle_driver_application
package /apd/Machines/RadarMachine/DltLogChannelToProcessMappings
  dlt application to process mapping vehicle_driver_applicationDltApplicationToProcessMapping: dlt-application=VehicleDriverIfApplication, process=vehicle_driver_application
  dlt log sink to port prototype mapping vehicle_driver_applicationDltLogSinkToPortPrototypeMapping: dlt-context=DefaultDltContext, dlt-log-sink=[ConsoleDltSink, RemoteDltSink, VehicleDriverIfFileDltSink], process=vehicle_driver_application
package /apd/Machines/RadarMachine/Processes
  process vehicle_driver_application: executable=vehicle_driver_application, state-dependent-startup-config{function-group-state=MachineFG.Driving, resource-group=ResourceGroup1, startup-config=vehicle_driver_application}
    process state machine state_machine: type=ProcessStateMachine
package /apd/Machines/RadarMachine/ServiceInstanceToPortPrototypeMappings
  service instance to port prototype mapping RequiredVehiclePackageManagementInstanceToPortMapping: port-prototype=VehicleDriverApplicationInterfaceRPort, process=vehicle_driver_application, service-instance=RequiredSomeIpVehicleDriverApplicationInstance
package /apd/Machines/RadarMachine/StartupConfigSets
  startup config vehicle_driver_application: scheduling-policy=SCHEDULING-POLICY-ROUND-ROBIN, scheduling-priority=12, termination-behavior=PROCESS-IS-NOT-SELF-TERMINATING
