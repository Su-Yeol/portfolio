AUTOSAR XML (schema 00052)
package /apd/Machines/RadarMachine/ProcessToMachineMappings
  process to machine mapping set ara_tsync_daemon
    process to machine mapping ara_tsync_daemon: machine=RadarMachine, process=ara_tsync_daemon
package /apd/Machines/RadarMachine/DltLogChannelToProcessMappings
  dlt application to process mapping ara_tsync_daemonDltApplicationToProcessMapping: dlt-application=ara_tsync_daemonApplication, process=ara_tsync_daemon
  dlt log sink to port prototype mapping ara_tsync_daemonDltLogSinkToPortPrototypeMapping: dlt-context=DefaultDltContext, dlt-log-sink=[ConsoleDltSink, RemoteDltSink, TimeSyncFileDltSink], process=ara_tsync_daemon
package /apd/Machines/RadarMachine/Processes
  process ara_tsync_daemon: executable=ara_tsync_daemon
    process state machine state_machine: type=ProcessStateMachine
    state-dependent-startup-configs:
      execution-dependency=state_machine.Running, function-group-state=MachineFG.Driving, resource-group=ResourceGroup2, startup-config=ara_tsync_daemon
      execution-dependency=state_machine.Running, function-group-state=MachineFG.Parking, resource-group=ResourceGroup2, startup-config=ara_tsync_daemon
package /apd/Machines/RadarMachine/StartupConfigSets
  startup config ara_tsync_daemon: environment-variables=tag-with-optional-value={key=TSYNC_APP_INTERFACE, value=/opt/ara_tsync_daemon/etc/TimeSyncProviderInterface.json}, scheduling-policy=SCHEDULING-POLICY-ROUND-ROBIN, scheduling-priority=12, termination-behavior=PROCESS-IS-NOT-SELF-TERMINATING
