AUTOSAR XML (schema 00052)
package /apd/Machines/RadarMachine/DltLogChannelToProcessMappings
  dlt application to process mapping ActorToLogChannelMapping: dlt-application=Actor, process=actor
  dlt log sink to port prototype mapping ActorDltLogSinkToPortPrototypeMapping: dlt-context=DefaultDltContext, dlt-log-sink=[ActorFileDltSink, ConsoleDltSink, RemoteDltSink], process=actor
package /apd/Machines/RadarMachine/ProcessToMachineMappings
  process to machine mapping set actor
    process to machine mapping actor: machine=RadarMachine, process=actor
package /apd/Machines/RadarMachine/ServiceInstanceToPortPrototypeMappings
  service instance to port prototype mapping ProvidedActorInstanceToPortMapping: port-prototype=ActorPPort, process=actor, service-instance=ProvidedSomeIpActorInstance
package /apd/Machines/RadarMachine/StartupConfigSets
  startup config actor_startup: scheduling-policy=SCHEDULING-POLICY-ROUND-ROBIN, scheduling-priority=12, termination-behavior=PROCESS-IS-NOT-SELF-TERMINATING
package /apd/Machines/RadarMachine/Processes
  process actor: executable=actor, state-dependent-startup-config{function-group-state=MachineFG.Driving, resource-group=ResourceGroup1, startup-config=actor_startup}
    process state machine state_machine: type=ProcessStateMachine
