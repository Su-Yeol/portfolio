AUTOSAR XML (schema 00052)
package /apd/Machines/RadarMachine/ServiceInstanceToMachineMappings
  someip service instance to machine mapping PackageManagementInstanceToMachineMapping: communication-connector=RadarConnector, service-instance=SomeIpPackageManagementInstance, tcp-port=PackageManagementApplicationEndpoint
  someip service instance to machine mapping RequiredUpdateRequestInstanceToMachineMapping: communication-connector=RadarConnector, service-instance=UpdateRequest_RequiredSomeipServiceInstance
package /apd/Machines/RadarMachine/ServiceInstances
  provided someip service instance SomeIpPackageManagementInstance: service-interface-deployment=PackageManagementSomeIp, sd-server-config=SomeipSdServerServiceInstanceConfig, service-instance-id=813
    someip provided event group CurrentStatus_provided_eventgroup: event-group=CurrentStatus_eventgroup, multicast-threshold=0
  required someip service instance UpdateRequest_RequiredSomeipServiceInstance: service-interface-deployment=UpdateRequest_Someip, required-minor-version=0, required-service-instance-id=668, sd-client-config=SomeipSdClientServiceInstanceConfig
