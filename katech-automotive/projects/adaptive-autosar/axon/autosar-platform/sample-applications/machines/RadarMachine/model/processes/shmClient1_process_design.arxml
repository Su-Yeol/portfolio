AUTOSAR XML (schema 00052)
package /apd/Machines/RadarMachine/ProcessDesigns
  process design shmClient1: executable=shmClient1
