AUTOSAR XML (schema 00052)
package /apd/Machines/RadarMachine/ServiceInstanceToMachineMappings
  someip service instance to machine mapping UpdateAdapterAndroidPackageManagementInstanceToMachineMapping: communication-connector=RadarConnector, service-instance=UpdateAdapterAndroidSomeIpPackageManagementInstance, tcp-port=UpdateAdapterAndroidApplicationEndpoint
package /apd/Machines/RadarMachine/ServiceInstances
  provided someip service instance UpdateAdapterAndroidSomeIpPackageManagementInstance: service-interface-deployment=PackageManagementSomeIp, sd-server-config=SomeipSdServerServiceInstanceConfig, service-instance-id=815
    someip provided event group CurrentStatus_provided_eventgroup: event-group=CurrentStatus_eventgroup, multicast-threshold=0
