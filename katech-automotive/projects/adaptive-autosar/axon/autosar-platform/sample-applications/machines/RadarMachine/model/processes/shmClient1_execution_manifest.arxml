AUTOSAR XML (schema 00052)
package /apd/Machines/RadarMachine/ProcessToMachineMappings
  process to machine mapping set shmClient1
    process to machine mapping shmClient1: machine=RadarMachine, process=shmClient1
package /apd/Machines/RadarMachine/DltLogChannelToProcessMappings
  dlt application to process mapping shmClient1DltApplicationToProcessMapping: dlt-application=shmClient1Application, process=shmClient1
  dlt log sink to port prototype mapping shmClient1DltLogSinkToPortPrototypeMapping: dlt-context=DefaultDltContext, dlt-log-sink=[ConsoleDltSink, RemoteDltSink, shmClient1FileDltSink], process=shmClient1
package /apd/Machines/RadarMachine/Processes
  process shmClient1: executable=shmClient1, state-dependent-startup-config{function-group-state=[MachineFG.Driving, MachineFG.Parking], resource-group=ResourceGroup1, startup-config=shmClient1Startup}
    process state machine state_machine: type=ProcessStateMachine
package /apd/Machines/RadarMachine/ServiceInstanceToPortPrototypeMappings
  service instance to port prototype mapping shmClient1_ProvidedServiceInstance_toPort: port-prototype=shmClient1_PPort, process=shmClient1, service-instance=shmClient1ProvidedSomeipServiceInstance
package /apd/Machines/RadarMachine/StartupConfigSets
  startup config shmClient1Startup: environment-variables=tag-with-optional-value={key=VSOMEIP_CONFIGURATION, value=/etc/vsomeip.json}, scheduling-policy=SCHEDULING-POLICY-ROUND-ROBIN, scheduling-priority=12, termination-behavior=PROCESS-IS-NOT-SELF-TERMINATING
