AUTOSAR XML (schema 00052)
package /apd/Machines/RadarMachine/ServiceInstances
  provided someip service instance ProvidedSomeIpUltraSonicSensorInstance: service-interface-deployment=UltraSonicSensorSomeIp, sd-server-config=SomeipSdServerServiceInstanceConfig, service-instance-id=20565
    someip provided event group UltraSonicSensorEventGroup: event-group=UltraSonicSensorEventGroup, multicast-threshold=0
package /apd/Machines/RadarMachine/ServiceInstanceToMachineMappings
  someip service instance to machine mapping ProvidedUltraSonicSensorInstanceToMachineMapping: communication-connector=RadarConnector, service-instance=ProvidedSomeIpUltraSonicSensorInstance, udp-port=PicarApplicationEndpoint
