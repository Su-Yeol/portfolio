AUTOSAR XML (schema 00052)
package /apd/Machines/RadarMachine/ServiceInstanceToMachineMappings
  someip service instance to machine mapping shmClient1_ProvidedServiceInstance_toMachine: communication-connector=shmConnector, service-instance=shmClient1ProvidedSomeipServiceInstance, udp-port=TriggerApplicationEndpoint
package /apd/Machines/RadarMachine/ServiceInstances
  provided someip service instance shmClient1ProvidedSomeipServiceInstance: service-interface-deployment=HealthInfo_Someip, sd-server-config=SomeipSdServerServiceInstanceConfig, service-instance-id=119
    someip provided event group ProvidedEventgroup1: event-group=SomeipEventgroup1, multicast-threshold=0
