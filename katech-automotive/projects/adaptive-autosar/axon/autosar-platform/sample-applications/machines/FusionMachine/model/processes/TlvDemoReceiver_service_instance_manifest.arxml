AUTOSAR XML (schema 00052)
package /apd/Machines/FusionMachine/ServiceInstanceToMachineMappings
  someip service instance to machine mapping tlv_RequiredServiceInstance_toMachine: communication-connector=FusionConnector, service-instance=TlvRequiredSomeipServiceInstance, udp-port=TriggerApplicationEndpoint
package /apd/Machines/FusionMachine/ServiceInstances
  required someip service instance TlvRequiredSomeipServiceInstance: service-interface-deployment=Tlv_Someip, required-minor-version=0, required-service-instance-id=ANY, sd-client-config=SomeipSdClientServiceInstanceConfig, version-driven-find-behavior=MINIMUM-MINOR-VERSION
