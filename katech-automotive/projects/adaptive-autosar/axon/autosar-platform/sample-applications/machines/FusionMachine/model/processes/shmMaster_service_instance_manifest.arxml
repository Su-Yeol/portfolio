AUTOSAR XML (schema 00052)
package /apd/Machines/FusionMachine/ServiceInstanceToMachineMappings
  someip service instance to machine mapping healthInfo_RequiredServiceInstance_toMachine: communication-connector=healthInfoConnector, service-instance=healthInfoRequiredSomeipServiceInstance, udp-port=TriggerApplicationEndpoint
  someip service instance to machine mapping healthIndicator_ProvidedServiceInstance_toMachine: communication-connector=healthIndicatorConnector, service-instance=healthIndicatorProvidedSomeipServiceInstance, udp-port=TriggerApplicationEndpoint
package /apd/Machines/FusionMachine/ServiceInstances
  required someip service instance healthInfoRequiredSomeipServiceInstance: service-interface-deployment=HealthInfo_Someip, required-minor-version=0, required-service-instance-id=119, sd-client-config=SomeipSdClientServiceInstanceConfig, version-driven-find-behavior=MINIMUM-MINOR-VERSION
    someip required event group RequiredEventgroup1: event-group=SomeipEventgroup1
  provided someip service instance healthIndicatorProvidedSomeipServiceInstance: service-interface-deployment=HealthIndicator_Someip, sd-server-config=SomeipSdServerServiceInstanceConfig, service-instance-id=120
    someip provided event group ProvidedEventgroup1: event-group=SomeipEventgroup1
