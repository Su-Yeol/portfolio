AUTOSAR XML (schema 00052)
package /apd/Machines/FusionMachine
  process design UpdatableAppDesign: executable=UpdatableApp
