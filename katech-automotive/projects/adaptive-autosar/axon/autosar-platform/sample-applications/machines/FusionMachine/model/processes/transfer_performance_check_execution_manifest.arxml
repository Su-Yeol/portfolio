AUTOSAR XML (schema 00052)
package /apd/Machines/FusionMachine/ProcessToMachineMappings
  process to machine mapping set transfer_performance_check
    process to machine mapping transfer_performance_check: machine=FusionMachine, process=transfer_performance_check
package /apd/Machines/FusionMachine/DltLogChannelToProcessMappings
  dlt application to process mapping transfer_performance_checkDltApplicationToProcessMapping: dlt-application=TransferPerformanceCheckApplication, process=transfer_performance_check
  dlt log sink to port prototype mapping transfer_performance_checkDltLogSinkToPortPrototypeMapping: dlt-context=DefaultDltContext, dlt-log-sink=[ConsoleDltSink, RemoteDltSink, TransferPerformanceCheckFileDltSink], process=transfer_performance_check
package /apd/Machines/FusionMachine/Processes
  process transfer_performance_check: executable=transfer_performance_check
    process state machine state_machine: type=ProcessStateMachine
package /apd/Machines/FusionMachine/ServiceInstanceToPortPrototypeMappings
  service instance to port prototype mapping RequiredPackageManagementInstanceToPortMappingForTransferPerformanceCheck: port-prototype=PackageManagementRPort, process=transfer_performance_check, service-instance=RequiredSomeIpPackageManagementInstanceTPC
package /apd/Machines/FusionMachine/StartupConfigSets
  startup config transfer_performance_check_startup: process-arguments=[--block-size, 1048576, --total-size, 2097152, --timeout, 9001], scheduling-policy=SCHEDULING-POLICY-ROUND-ROBIN, scheduling-priority=12, termination-behavior=PROCESS-IS-SELF-TERMINATING
