AUTOSAR XML (schema 00052)
package /apd/Machines/FusionMachine/PersistencyKeyValueDatabases
  persistency key value storage PersistencyRedundancyDemo: persistency-deployment-uri=/opt/PersistencyRedundancyDemo/var/PerRedundancyDemo.json, redundancy-handlings=persistency-redundancy-m-out-of-n={scope=PERSISTENCY-REDUNDANCY-HANDLING-SCOPE-STORAGE, m=2, n=3}
package /apd/Machines/FusionMachine/PersistentPortPrototypeToKeyValueDatabaseMappings
  persistency port prototype to key value storage mapping PersistencyRedundancyDemo: port-prototype=PersistencyRedundancyDemo_PRPort, process=PersistencyRedundancyDemo, key-value-storage=PersistencyRedundancyDemo
package /apd/Machines/FusionMachine/ProcessToMachineMappings
  process to machine mapping set PersistencyRedundancyDemo
    process to machine mapping ProcessToMachineMapping: machine=FusionMachine, process=PersistencyRedundancyDemo
package /apd/Machines/FusionMachine/Processes
  process PersistencyRedundancyDemo: executable=PersistencyRedundancyDemo, state-dependent-startup-config{function-group-state=[MachineFG.Driving, MachineFG.Parking], resource-group=ResourceGroup2, startup-config=PersistencyRedundancyDemo}
    process state machine state_machine: type=ProcessStateMachine
package /apd/Machines/FusionMachine/StartupConfigSets
  startup config PersistencyRedundancyDemo: scheduling-policy=SCHEDULING-POLICY-ROUND-ROBIN, scheduling-priority=12, termination-behavior=PROCESS-IS-SELF-TERMINATING
