AUTOSAR XML (schema 00052)
package /apd/Machines/RadarFusionDDSMachine
  machine RadarFusionDDSMachine: default-application-timeout=exit-timeout-value=0.1, environment-variables=tag-with-optional-value={key=DLT_LOG_MODE, value=3}, machine-design=RadarFusionDDSMachineDesign
    module-instantiations:
      log and trace instantiation LogAndTraceInstanciation: log-sink=ConsoleDltSink
      os module instantiation Linux
        6 x resource group:
          ResourceGroup1: cpu-usage=95, mem-usage=2000000000
          ResourceGroup2: cpu-usage=95, mem-usage=2000000000
          ResourceGroupDB: cpu-usage=80, mem-usage=500000000
          ResourceGroupDIAG: cpu-usage=80, mem-usage=500000000
          ResourceGroupIAM: cpu-usage=80, mem-usage=500000000
          ResourceGroupSM: cpu-usage=80, mem-usage=500000000
      ucm subordinate module instantiation UcmInstance: identifier=DevelopmentMachineUCM
package /apd/Machines/RadarFusionDDSMachine/E2E
  e 2 e profile configuration set e2eprofiles
    e 2 e profile configuration PROFILE_01: max-delta-counter=1, max-error-state-init=0, max-error-state-invalid=0, max-error-state-valid=0, min-ok-state-init=1, min-ok-state-invalid=1, min-ok-state-valid=1, profile-name=PROFILE_01, window-size-init=1, window-size-invalid=1, window-size-valid=1
package /apd/Machines/RadarFusionDDSMachine/FunctionGroupSets
  function group set RadarFusionDDSFunctionGroups
    function-groups:
      4 x mode declaration group prototype:
        MachineFG: type=MachineState
        Lane_Change_Assistance: type=Lane_Change_Assistance
        Pedestrian_Protection: type=Pedestrian_Protection
        UpdatableApplicationFG: type=UpdatableApplicationFG
package /apd/Machines/RadarFusionDDSMachine/SoftwareClusters
  software cluster RadarFusionCoreCluster: category=PLATFORM_CORE, claimed-function-group=[MachineFG, Lane_Change_Assistance, Pedestrian_Protection, RadarFusionDDSFunctionGroups/UpdatableApplicationFG, DevelopmentFunctionGroups/UpdatableApplicationFG], contained-process=[EmoSampleApplication, fusion, PersistencyDemo, PersistencyRedundancyDemo, radar, StateManager], module-instantiation=Linux
package /apd/Machines/RadarFusionDDSMachine/Dlt
  dlt log sink ConsoleDltSink: category=DLT_LOGSINK_CONSOLE, buffer-output=true, default-log-threshold=VERBOSE
  dlt ecu RadarFusionDDSMachineDltEcu
    4 x dlt application, all with contexts=DefaultDltContext:
      FusionApplication: application-description=example app. fusion, application-id=EXFU
      RadarApplication: application-description=example app. radar, application-id=EXRA
      StateManagerApplication: application-description=State Manager, application-id=STMR
      EmoSampleApplicationLogChannel: application-description=Emo Sample Application, application-id=EMAP
package /ara/apd/function_group_modes
  mode declaration group UpdatableApplicationFG: initial-mode=Off
    mode Off
    mode Running
    mode Verify
package /ara/apd/function_group_sets
  function group set DevelopmentFunctionGroups
    function-groups:
      mode declaration group prototype UpdatableApplicationFG: type=UpdatableApplicationFG
