AUTOSAR XML (schema 00052)
package /apd/Machines/RadarMachine/ProcessToMachineMappings
  process to machine mapping set linesensor
    process to machine mapping linesensor: machine=RadarMachine, process=linesensor
package /apd/Machines/RadarMachine/DltLogChannelToProcessMappings
  dlt application to process mapping LineSensorToLogChannelMapping: dlt-application=LineSensor, process=linesensor
  dlt log sink to port prototype mapping LineSensorDltLogSinkToPortPrototypeMapping: dlt-context=DefaultDltContext, dlt-log-sink=[LineSensorFileDltSink, ConsoleDltSink, RemoteDltSink], process=linesensor
package /apd/Machines/RadarMachine/ServiceInstanceToPortPrototypeMappings
  service instance to port prototype mapping ProvidedLineSensorToPortMapping: port-prototype=LineSensorPPort, process=linesensor, service-instance=ProvidedSomeIpLineSensorInstance
package /apd/Machines/RadarMachine/StartupConfigSets
  startup config LinesensorStartup: scheduling-policy=SCHEDULING-POLICY-ROUND-ROBIN, scheduling-priority=12, termination-behavior=PROCESS-IS-NOT-SELF-TERMINATING
package /apd/Machines/RadarMachine/Processes
  process linesensor: executable=linesensor, state-dependent-startup-config{function-group-state=MachineFG.Driving, resource-group=ResourceGroup1, startup-config=LinesensorStartup}
    process state machine state_machine: type=ProcessStateMachine
