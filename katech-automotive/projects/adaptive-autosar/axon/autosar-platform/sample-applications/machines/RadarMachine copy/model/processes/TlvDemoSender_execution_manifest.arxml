AUTOSAR XML (schema 00052)
package /apd/Machines/RadarMachine/ProcessToMachineMappings
  process to machine mapping set TlvDemoSender
    process to machine mapping TlvDemoSender: machine=RadarMachine, process=TlvDemoSender
package /apd/Machines/RadarMachine/Dlt
  dlt application to process mapping TlvDemoSenderDltApplicationToProcessMapping: dlt-application=TlvDemoSenderApplication, process=TlvDemoSender
  dlt log sink to port prototype mapping TlvDemoSenderDltLogSinkToPortPrototypeMapping: dlt-context=DefaultDltContext, dlt-log-sink=[ConsoleDltSink, RemoteDltSink, TlvDemoSenderFileDltSink], process=TlvDemoSender
package /apd/Machines/RadarMachine/Processes
  process TlvDemoSender: design=TlvDemoSender, executable=TlvDemoSender, state-dependent-startup-config{function-group-state=MachineFG.Driving, resource-group=ResourceGroup1, startup-config=TlvDemoSenderStartup}
    process state machine state_machine: type=ProcessStateMachine
package /apd/Machines/RadarMachine/ServiceInstanceToPortPrototypeMappings
  service instance to port prototype mapping tlv_ProvidedServiceInstance_toPort: port-prototype=tlv_PPort, process=TlvDemoSender, service-instance=TlvProvidedSomeipServiceInstance
package /apd/Machines/RadarMachine/StartupConfigSets
  startup config TlvDemoSenderStartup: environment-variables=tag-with-optional-value={key=VSOMEIP_CONFIGURATION, value=/etc/vsomeip.json}, scheduling-policy=SCHEDULING-POLICY-ROUND-ROBIN, scheduling-priority=12, termination-behavior=PROCESS-IS-NOT-SELF-TERMINATING
