AUTOSAR XML (schema 00052)
package /apd/Machines/RadarMachine/ProcessToMachineMappings
  process to machine mapping set ultrasonicsensor
    process to machine mapping ultrasonicsensor: machine=RadarMachine, process=ultrasonicsensor
package /apd/Machines/RadarMachine/ServiceInstanceToPortPrototypeMappings
  service instance to port prototype mapping ProvidedUltraSonicSensorToPortMapping: port-prototype=UltraSonicSensorPPort, process=ultrasonicsensor, service-instance=ProvidedSomeIpUltraSonicSensorInstance
  dlt application to process mapping UltraSonicSensorToLogChannelMapping: dlt-application=UltrasonicSensor, process=ultrasonicsensor
  dlt log sink to port prototype mapping UltrasonicSensorDltLogSinkToPortPrototypeMapping: dlt-context=DefaultDltContext, dlt-log-sink=[UltrasonicSensorFileDltSink, ConsoleDltSink, RemoteDltSink], process=ultrasonicsensor
package /apd/Machines/RadarMachine/StartupConfigSets
  startup config ultrasonic_startup: scheduling-policy=SCHEDULING-POLICY-ROUND-ROBIN, scheduling-priority=12, termination-behavior=PROCESS-IS-NOT-SELF-TERMINATING
package /apd/Machines/RadarMachine/Processes
  process ultrasonicsensor: executable=ultrasonicSensor, state-dependent-startup-config{function-group-state=MachineFG.Driving, resource-group=ResourceGroup1, startup-config=ultrasonic_startup}
    process state machine state_machine: type=ProcessStateMachine
