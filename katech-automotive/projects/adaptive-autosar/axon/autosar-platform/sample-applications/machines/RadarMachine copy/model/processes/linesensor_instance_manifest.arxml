AUTOSAR XML (schema 00052)
package /apd/Machines/RadarMachine/ServiceInstances
  provided someip service instance ProvidedSomeIpLineSensorInstance: service-interface-deployment=LineSensorSomeIp, sd-server-config=SomeipSdServerServiceInstanceConfig, service-instance-id=20556
    someip provided event group LineSensorEventGroup: event-group=LineSensorEventGroup, multicast-threshold=0
package /apd/Machines/RadarMachine/ServiceInstanceToMachineMappings
  someip service instance to machine mapping ProvidedLineSensorInstanceToMachineMapping: communication-connector=RadarConnector, service-instance=ProvidedSomeIpLineSensorInstance, udp-port=PicarApplicationEndpoint
