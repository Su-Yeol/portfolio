AUTOSAR XML (schema 00052)
package /apd/Machines/testSuiteEcu1Machine/ProcessToMachineMappings
  process to machine mapping set CMApp12ProcessToMachineMapping
    process to machine mapping CMApp12SwcInstance1TotestSuiteEcu1Machine: machine=testSuiteEcu1Machine, process=ST_CMApp12Instance1
package /apd/Machines/testSuiteEcu1Machine/Processes
  process ST_CMApp12Instance1: design=ST_CMApp12Instance1, executable=ST_CMApp12, state-dependent-startup-config{function-group-state=SystemTestFunctionGroup.STS_CM_00004, resource-group=ResourceGroup1, startup-config=ST_CMApp12Startup}
    process state machine state_machine: type=ProcessStateMachine
package /apd/Machines/testSuiteEcu1Machine/ServiceInstanceToPortPrototypeMappings
  service instance to port prototype mapping CMService6ProvidedServiceInstanceToPort: port-prototype=CMApp12Service6Pport, process=ST_CMApp12Instance1, service-instance=ST_CMService6ProvidedSomeipServiceInstance
  service instance to port prototype mapping DiagRoutinePPortToCMApp12: port-prototype=DiagRoutineServicePport, process=ST_CMApp12Instance1, service-instance=ST_CMApp12DiagRoutineProvidedSomeipServiceInstance
package /apd/Machines/testSuiteEcu1Machine/StartupConfigSets
  startup config ST_CMApp12Startup: environment-variables=[{key=VSOMEIP_CONFIGURATION, value=/opt/CMApp12/etc/vsomeip.json}, {key=DLT_LOG_MODE, value=3}], scheduling-policy=SCHEDULING-POLICY-ROUND-ROBIN, scheduling-priority=12
package /apd/Machines/testSuiteEcu1Machine/DltLogChannelToProcessMappings
  dlt application to process mapping ST_CMApp12Instance1DltApplicationToProcessMapping: dlt-application=CMApp12Application, process=ST_CMApp12Instance1
  dlt log sink to port prototype mapping ST_CMApp12Instance1DltLogSinkToPortPrototypeMapping: dlt-context=DefaultDltContext, dlt-log-sink=[CMApp12FileDltSink, ConsoleDltSink, RemoteDltSink], process=ST_CMApp12Instance1
