AUTOSAR XML (schema 00052)
package /apd/Machines/testSuiteEcu2WRSOMEIPMachine/ServiceInstanceToMachineMappings
  someip service instance to machine mapping CmService5RequiredServiceInstanceToEcu2Machine: communication-connector=CommunicationWRSOMEIPConnector1, service-instance=ST_CMApp11CMService5RequiredSomeipServiceInstance, udp-port=CMService5ApplicationEndpoint
  someip service instance to machine mapping CMApp11DiagDataIdentifierProvidedServiceInstanceToEcu2Machine: communication-connector=CommunicationWRSOMEIPConnector1, service-instance=ST_CMApp11DiagDataIdentifierProvidedSomeipServiceInstance, udp-port=CMApp11DiagDataIdentifierApplicationEndpoint
  someip service instance to machine mapping CMApp11DiagRoutineProvidedServiceInstanceToEcu1Machine: communication-connector=CommunicationWRSOMEIPConnector1, service-instance=ST_CMApp11DiagRoutineProvidedSomeipServiceInstance, udp-port=ST_CMApp11DiagRoutineApplicationEndpoint
package /apd/Machines/testSuiteEcu2WRSOMEIPMachine/ServiceInstances
  required someip service instance ST_CMApp11CMService5RequiredSomeipServiceInstance: service-interface-deployment=CMService5_Someip, required-service-instance-id=25, sd-client-config=SomeipSdClientServiceInstanceConfig
  provided someip service instance ST_CMApp11DiagDataIdentifierProvidedSomeipServiceInstance: service-interface-deployment=DataIdentifier_Someip, sd-server-config=SomeipSdServerServiceInstanceConfig, service-instance-id=1103
  provided someip service instance ST_CMApp11DiagRoutineProvidedSomeipServiceInstance: service-interface-deployment=RoutineService_Someip, sd-server-config=SomeipSdServerServiceInstanceConfig, service-instance-id=1732
