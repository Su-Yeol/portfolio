AUTOSAR XML (schema 00052)
package /apd/Machines/testSuiteEcu2WRSOMEIPMachine/ProcessToMachineMappings
  process to machine mapping set CMApp02ProcessToMachineMapping
    process to machine mapping CMApp02SwcInstance1TotestSuiteEcu2WRSOMEIPMachine: machine=testSuiteEcu2WRSOMEIPMachine, process=ST_CMApp02Instance1
package /apd/Machines/testSuiteEcu2WRSOMEIPMachine/Processes
  process ST_CMApp02Instance1: design=ST_CMApp02Instance1, executable=ST_CMApp02, state-dependent-startup-config{function-group-state=MachineFG.Driving, resource-group=ResourceGroup1, startup-config=ST_CMApp02Startup}
    process state machine state_machine: type=ProcessStateMachine
package /apd/Machines/testSuiteEcu2WRSOMEIPMachine/ServiceInstanceToPortPrototypeMappings
  service instance to port prototype mapping CMApp02CMService1RequiredServiceInstanceToPort: port-prototype=CMApp02Service1Rport, process=ST_CMApp02Instance1, service-instance=ST_CMApp02CMService1RequiredSomeipServiceInstance
  service instance to port prototype mapping DataIdentifierPPortToCMApp02: port-prototype=DataIdentifierPport, process=ST_CMApp02Instance1, service-instance=ST_CMApp02DiagDataIdentifierProvidedSomeipServiceInstance
package /apd/Machines/testSuiteEcu2WRSOMEIPMachine/StartupConfigSets
  startup config ST_CMApp02Startup: environment-variables=[{key=VSOMEIP_CONFIGURATION, value=/opt/CMApp02/etc/vsomeip.json}, {key=DLT_LOG_MODE, value=3}], scheduling-policy=SCHEDULING-POLICY-ROUND-ROBIN, scheduling-priority=12
package /apd/Machines/testSuiteEcu2WRSOMEIPMachine/DltLogChannelToProcessMappings
  dlt application to process mapping ST_CMApp02Instance1DltApplicationToProcessMapping: dlt-application=CMApp02Application, process=ST_CMApp02Instance1
  dlt log sink to port prototype mapping ST_CMApp02Instance1DltLogSinkToPortPrototypeMapping: dlt-context=DefaultDltContext, dlt-log-sink=[CMApp02FileDltSink, ConsoleDltSink, RemoteDltSink], process=ST_CMApp02Instance1
