AUTOSAR XML (schema 00052)
package /apd/Machines/testSuiteEcu2WRSOMEIPMachine/ProcessToMachineMappings
  process to machine mapping set CMApp14ProcessToMachineMapping
    process to machine mapping CMApp14SwcInstance1TotestSuiteEcu2WRSOMEIPMachine: machine=testSuiteEcu2WRSOMEIPMachine, process=ST_CMApp14Instance1
package /apd/Machines/testSuiteEcu2WRSOMEIPMachine/Processes
  process ST_CMApp14Instance1: design=ST_CMApp14Instance1, executable=ST_CMApp14, state-dependent-startup-config{function-group-state=SystemTestFunctionGroup.STS_CM_00004, resource-group=ResourceGroup1, startup-config=ST_CMApp14Startup}
    process state machine state_machine: type=ProcessStateMachine
package /apd/Machines/testSuiteEcu2WRSOMEIPMachine/ServiceInstanceToPortPrototypeMappings
  service instance to port prototype mapping CMApp14CMService6RequiredServiceInstanceToPort: port-prototype=CMApp14Service6Rport, process=ST_CMApp14Instance1, service-instance=ST_CMApp14CMService6RequiredSomeipServiceInstance
  service instance to port prototype mapping DataIdentifierPPortToCMApp14: port-prototype=DataIdentifierPport, process=ST_CMApp14Instance1, service-instance=ST_CMApp14DiagDataIdentifierProvidedSomeipServiceInstance
  service instance to port prototype mapping DiagRoutinePPortToCMApp14: port-prototype=DiagRoutineServicePport, process=ST_CMApp14Instance1, service-instance=ST_CMApp14DiagRoutineProvidedSomeipServiceInstance
package /apd/Machines/testSuiteEcu2WRSOMEIPMachine/StartupConfigSets
  startup config ST_CMApp14Startup: environment-variables=[{key=VSOMEIP_CONFIGURATION, value=/opt/CMApp14/etc/vsomeip.json}, {key=DLT_LOG_MODE, value=3}], scheduling-policy=SCHEDULING-POLICY-ROUND-ROBIN, scheduling-priority=12
package /apd/Machines/testSuiteEcu2WRSOMEIPMachine/DltLogChannelToProcessMappings
  dlt application to process mapping ST_CMApp14Instance1DltApplicationToProcessMapping: dlt-application=CMApp14Application, process=ST_CMApp14Instance1
  dlt log sink to port prototype mapping ST_CMApp14Instance1DltLogSinkToPortPrototypeMapping: dlt-context=DefaultDltContext, dlt-log-sink=[CMApp14FileDltSink, ConsoleDltSink, RemoteDltSink], process=ST_CMApp14Instance1
