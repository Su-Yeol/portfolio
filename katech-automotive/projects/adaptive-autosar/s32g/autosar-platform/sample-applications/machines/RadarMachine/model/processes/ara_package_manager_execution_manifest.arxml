AUTOSAR XML (schema 00052)
package /apd/Machines/RadarMachine/PersistencyKeyValueStorages
  persistency key value storage SwPackageCurrentStatusDatabase: persistency-deployment-uri=/opt/package_manager/var/swpackage_current_status_database.json
  persistency key value storage SwPackageTransferStatusStorage: persistency-deployment-uri=/opt/package_manager/var/swpackage_transfer_status_database.json
package /apd/Machines/RadarMachine/PersistentPortPrototypeToKeyValueStorageMappings
  persistency port prototype to key value storage mapping SwPackageCurrentStatusToPortMapping: port-prototype=SwPackageCurrentStatusPRPort, process=package_manager, key-value-storage=SwPackageCurrentStatusDatabase
  persistency port prototype to key value storage mapping SwPackageTransferStatusStorageToPortMapping: port-prototype=SwPackageTransferStatusPRPort, process=package_manager, key-value-storage=SwPackageTransferStatusStorage
package /apd/Machines/RadarMachine/ProcessToMachineMappings
  process to machine mapping set package_manager
    process to machine mapping package_manager: machine=RadarMachine, process=package_manager
package /apd/Machines/RadarMachine/DltLogChannelToProcessMappings
  dlt application to process mapping package_managerDltApplicationToProcessMapping: dlt-application=PackageManager, process=package_manager
  dlt log sink to port prototype mapping package_managerDltLogSinkToPortPrototypeMapping: dlt-context=DefaultDltContext, dlt-log-sink=[ConsoleDltSink, RemoteDltSink, PackageManagerFileDltSink], process=package_manager
package /apd/Machines/RadarMachine/Processes
  process package_manager: executable=package_manager, state-dependent-startup-config{execution-dependency=state_machine.Running, function-group-state=MachineFG.Driving, resource-group=ResourceGroup1, startup-config=package_manager_startup}
    process state machine state_machine: type=ProcessStateMachine
package /apd/Machines/RadarMachine/ServiceInstanceToPortPrototypeMappings
  service instance to port prototype mapping PackageManagementInstanceToPortMapping: port-prototype=PackageManagementPPort, process=package_manager, service-instance=SomeIpPackageManagementInstance
  service instance to port prototype mapping RequiredUpdateRequestPortMapping: port-prototype=UpdateRequestRPort, process=package_manager, service-instance=UpdateRequest_RequiredSomeipServiceInstance
package /apd/Machines/RadarMachine/startup_configs
  startup config package_manager_startup: scheduling-policy=SCHEDULING-POLICY-ROUND-ROBIN, scheduling-priority=12, termination-behavior=PROCESS-IS-NOT-SELF-TERMINATING
