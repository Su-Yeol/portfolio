AUTOSAR XML (schema 00052)
package /apd/Machines/RadarMachine
  machine RadarMachine: default-application-timeout=exit-timeout-value=0.1, environment-variables=tag-with-optional-value={key=DLT_LOG_MODE, value=3}, machine-design=RadarMachineDesign
    module-instantiations:
      log and trace instantiation LogAndTraceInstanciation: dlt-ecu=DltEcu, log-sink=ConsoleDltSink
      os module instantiation Linux
        6 x resource group:
          ResourceGroup1: cpu-usage=95, mem-usage=2000000000
          ResourceGroup2: cpu-usage=95, mem-usage=2000000000
          ResourceGroupDB: cpu-usage=80, mem-usage=500000000
          ResourceGroupDIAG: cpu-usage=80, mem-usage=500000000
          ResourceGroupIAM: cpu-usage=80, mem-usage=500000000
          ResourceGroupSM: cpu-usage=80, mem-usage=500000000
      ucm subordinate module instantiation UcmInstance: identifier=RadarMachineUCM
package /apd/Machines/RadarMachine/E2E
  e 2 e profile configuration set e2eprofiles
    e 2 e profile configuration PROFILE_01: max-delta-counter=1, max-error-state-init=0, max-error-state-invalid=0, max-error-state-valid=0, min-ok-state-init=1, min-ok-state-invalid=1, min-ok-state-valid=1, profile-name=PROFILE_01, window-size-init=1, window-size-invalid=1, window-size-valid=1
package /apd/Machines/RadarMachine/FunctionGroupSets
  function group set RadarFunctionGroups
    function-groups:
      4 x mode declaration group prototype:
        MachineFG: type=MachineState
        Lane_Change_Assistance: type=Lane_Change_Assistance
        Pedestrian_Protection: type=Pedestrian_Protection
        UpdatableApplicationFG: type=UpdatableApplicationFG
package /apd/Machines/RadarMachine/SoftwareClusters
  software cluster RadarCoreCluster:
    category=PLATFORM_CORE
    claimed-function-group=[MachineFG, Lane_Change_Assistance, Pedestrian_Protection, RadarFunctionGroups/UpdatableApplicationFG, DevelopmentFunctionGroups/UpdatableApplicationFG]
    contained-process=[actor, ara_tsync_daemon, EmoSampleApplication, linesensor, PersistencyDemo, PersistencyRedundancyDemo, radar, shmClient1, StateManager, TimeSyncProvider, ultrasonicsensor, UpdatableApp, update_adapter_agl, update_adapter_android, vehicle_driver_application]
    module-instantiation=Linux
package /apd/Machines/RadarMachine/Dlt
  dlt ecu DltEcu
    16 x dlt application, all with contexts=DefaultDltContext:
      RadarApplication: application-description=example app. radar, application-id=EXRA
      ara_tsync_daemonApplication: application-description=Time Sync Daemon Platform Application, application-id=TSYD
      TimeSyncProviderApplication: application-description=Time Sync Provider Application, application-id=TSYP
      TlvDemoSenderApplication: application-description=TLV demo sender Application, application-id=TSYP
      StateManagerApplication: application-description=State Manager, application-id=STMR
      EmoSampleApplicationLogChannel: application-description=Emo Sample Application, application-id=EMAP
      shmClient1Application: application-description=example app. shmClient1, application-id=EXS1
      UpdatableApplication: application-description=Updatable App, application-id=UAPP
      UpdateAdapterAGLApplication: application-description=Update Adapter for non-AUTOSAR platform, application-id=UAGL
      UpdateAdapterAndroidApplication: application-description=Update Adapter for non-AUTOSAR platform, application-id=UAND
      PackageManager: application-description=UCM, application-id=UCM
      VehiclePackageManager: application-description=UCM Master, application-id=UCMM
      Actor: application-description=example app. picar actor, application-id=PIA
      LineSensor: application-description=example app. picar linesensor, application-id=PIL
      UltrasonicSensor: application-description=example app. picar ultrasonicsensor, application-id=PIU
      VehicleDriverIfApplication: application-description=example app. vehicle driver interface, application-id=VDIF
  dlt log sink ConsoleDltSink: category=DLT_LOGSINK_CONSOLE, buffer-output=true, default-log-threshold=VERBOSE
package /ara/apd/function_group_modes
  mode declaration group UpdatableApplicationFG: initial-mode=Off
    mode Off
    mode Running
    mode Verify
package /ara/apd/function_group_sets
  function group set DevelopmentFunctionGroups
    function-groups:
      mode declaration group prototype UpdatableApplicationFG: type=UpdatableApplicationFG
