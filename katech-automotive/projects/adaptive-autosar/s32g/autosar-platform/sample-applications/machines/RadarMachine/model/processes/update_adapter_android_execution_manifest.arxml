AUTOSAR XML (schema 00052)
package /apd/Machines/RadarMachine/DltLogChannelToProcessMappings
  dlt application to process mapping update_adapter_androidDltApplicationToProcessMapping: dlt-application=UpdateAdapterAndroidApplication, process=update_adapter_android
  dlt log sink to port prototype mapping update_adapter_androidDltLogSinkToPortPrototypeMapping: dlt-context=DefaultDltContext, dlt-log-sink=[ConsoleDltSink, RemoteDltSink, UpdateAdapterAndroidFileDltSink], process=update_adapter_android
package /apd/Machines/RadarMachine/PersistencyKeyValueStorages
  persistency key value storage SwPackageTransferStatusStorageForUpdateAdapterAndroid: persistency-deployment-uri=/opt/update_adapter_android/var/transfer_status_database.json
package /apd/Machines/RadarMachine/PersistentPortPrototypeToKeyValueStorageMappings
  persistency port prototype to key value storage mapping SwPackageTransferStatusStorageToPortMappingForUpdateAdapterAndroid: port-prototype=SwPackageTransferStatusPRPort, process=update_adapter_android, key-value-storage=SwPackageTransferStatusStorageForUpdateAdapterAndroid
package /apd/Machines/RadarMachine/ProcessToMachineMappings
  process to machine mapping set update_adapter_android_mapping_set
    process to machine mapping update_adapter_android_mapping: machine=RadarMachine, process=update_adapter_android
package /apd/Machines/RadarMachine/Processes
  process update_adapter_android: executable=update_adapter_android, state-dependent-startup-config{function-group-state=MachineFG.Driving, resource-group=ResourceGroup1, startup-config=update_adapter_android_startup}
    process state machine state_machine: type=ProcessStateMachine
package /apd/Machines/RadarMachine/ServiceInstanceToPortPrototypeMappings
  service instance to port prototype mapping UpdateAdapterPackageManagementInstanceToPortMapping: port-prototype=PackageManagementProvided, process=update_adapter_android, service-instance=UpdateAdapterAndroidSomeIpPackageManagementInstance
package /apd/Machines/RadarMachine/StartupConfigSets
  startup config update_adapter_android_startup: process-arguments=[--ucmId, UAND, --itm], scheduling-policy=SCHEDULING-POLICY-ROUND-ROBIN, scheduling-priority=12, termination-behavior=PROCESS-IS-NOT-SELF-TERMINATING
