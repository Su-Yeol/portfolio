AUTOSAR XML (schema 00052)
package /adcm/Machines/AdaptiveMachine/ProcessToMachineMappings
  process to machine mapping set Control
    process to machine mapping Control: machine=AdaptiveMachine, process=Control
package /adcm/Machines/AdaptiveMachine/DltLogChannelToProcessMappings
  dlt application to process mapping ControlDltApplicationToProcessMapping: dlt-application=Control, process=Control
  dlt log sink to port prototype mapping ControlDltLogSinkToPortPrototypeMapping: dlt-context=DefaultDltContext, dlt-log-sink=[ConsoleDltSink, RemoteDltSink, ControlFileDltSink], process=Control
package /adcm/Machines/AdaptiveMachine/Processes
  process Control: executable=Control, state-dependent-startup-config{function-group-state=MachineFG.Driving, resource-group=ResourceGroupADCM, startup-config=Control}
    process state machine state_machine: type=ProcessStateMachine
package /adcm/Machines/AdaptiveMachine/ServiceInstanceToPortPrototypeMappings
  11 x service instance to port prototype mapping, all with process=Control:
    ProvidedServiceInstance_toPort_control_can_data: port-prototype=PPort_can_data, service-instance=ProvidedSomeipServiceInstance_can_data
    ProvidedServiceInstance_toPort_control_can_data_etc: port-prototype=PPort_can_data_etc, service-instance=ProvidedSomeipServiceInstance_can_data_etc
    ProvidedServiceInstance_toPort_control_control_bridge: port-prototype=PPort_control_bridge, service-instance=ProvidedSomeipServiceInstance_control_bridge
    ProvidedServiceInstance_toPort_control_bridge_control: port-prototype=PPort_bridge_control, service-instance=ProvidedSomeipServiceInstance_bridge_control
    ProvidedServiceInstance_toPort_control_collect_fault_control: port-prototype=PPort_collect_fault_control, service-instance=ProvidedSomeipServiceInstance_collect_fault_control
    ProvidedServiceInstance_toPort_control_sensor_radar: port-prototype=PPort_sensor_radar, service-instance=ProvidedSomeipServiceInstance_sensor_radar
    RequiredServiceInstance_toPort_control_bridge_control: port-prototype=RPort_bridge_control, service-instance=RequiredSomeipServiceInstance_bridge_control
    RequiredServiceInstance_toPort_control_driving_trajectory: port-prototype=RPort_driving_trajectory, service-instance=RequiredSomeipServiceInstance_driving_trajectory
    RequiredServiceInstance_toPort_control_report_fault: port-prototype=RPort_report_fault, service-instance=RequiredSomeipServiceInstance_report_fault
    RequiredServiceInstance_toPort_control_smart_cruise_control: port-prototype=RPort_smart_cruise_control, service-instance=RequiredSomeipServiceInstance_smart_cruise_control
    RequiredServiceInstance_toPort_control_vehicle_location: port-prototype=RPort_vehicle_location, service-instance=RequiredSomeipServiceInstance_vehicle_location
package /adcm/Machines/AdaptiveMachine/StartupConfigSets
  startup config Control: environment-variables=tag-with-optional-value={key=VSOMEIP_CONFIGURATION, value=/etc/vsomeip.json}, scheduling-policy=SCHEDULING-POLICY-ROUND-ROBIN, scheduling-priority=12, termination-behavior=PROCESS-IS-NOT-SELF-TERMINATING
