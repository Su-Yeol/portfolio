AUTOSAR XML (schema 00052)
package /adcm/Machines/AdaptiveMachine/ProcessToMachineMappings
  process to machine mapping set TimeSyncProvider
    process to machine mapping TimeSyncProvider: machine=AdaptiveMachine, process=TimeSyncProvider
package /adcm/Machines/AdaptiveMachine/DltLogChannelToProcessMappings
  dlt application to process mapping TimeSyncProviderDltApplicationToProcessMapping: dlt-application=TimeSyncProviderApplication, process=TimeSyncProvider
  dlt log sink to port prototype mapping TimeSyncProviderDltLogSinkToPortPrototypeMapping: dlt-context=DefaultDltContext, dlt-log-sink=[ConsoleDltSink, RemoteDltSink, TimeSyncProviderFileDltSink], process=TimeSyncProvider
package /adcm/Machines/AdaptiveMachine/Processes
  process TimeSyncProvider: executable=TimeSyncProvider, state-dependent-startup-config{function-group-state=MachineFG.Driving, resource-group=ResourceGroupADCM, startup-config=TimeSyncProvider}
    process state machine state_machine: type=ProcessStateMachine
package /adcm/Machines/AdaptiveMachine/StartupConfigSets
  startup config TimeSyncProvider: environment-variables=tag-with-optional-value={key=VSOMEIP_CONFIGURATION, value=/etc/vsomeip.json}, scheduling-policy=SCHEDULING-POLICY-ROUND-ROBIN, scheduling-priority=12, termination-behavior=PROCESS-IS-NOT-SELF-TERMINATING
