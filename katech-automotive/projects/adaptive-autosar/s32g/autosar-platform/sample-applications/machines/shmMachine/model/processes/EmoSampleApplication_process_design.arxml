AUTOSAR XML (schema 00052)
package /apd/Machines/shmMachine/ProcessDesigns
  process design EmoSampleApplication: executable=EmoSampleApplication
