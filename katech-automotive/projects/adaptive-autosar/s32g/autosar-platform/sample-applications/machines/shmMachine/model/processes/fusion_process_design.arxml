AUTOSAR XML (schema 00052)
package /apd/Machines/shmMachine/ProcessDesigns
  process design fusion: executable=fusion
