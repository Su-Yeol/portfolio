AUTOSAR XML (schema 00052)
package /apd/Machines/shmMachine/ProcessToMachineMappings
  process to machine mapping set fusion
    process to machine mapping fusion: machine=shmMachine, process=fusion
package /apd/Machines/shmMachine/Processes
  process fusion: executable=fusion, state-dependent-startup-config{function-group-state=[MachineFG.Driving, MachineFG.Parking], resource-group=ResourceGroup1, startup-config=FusionStartup}
    process state machine state_machine: type=ProcessStateMachine
package /apd/Machines/shmMachine/StartupConfigSets
  startup config FusionStartup: environment-variables=tag-with-optional-value={key=VSOMEIP_CONFIGURATION, value=/etc/vsomeip.json}, scheduling-policy=SCHEDULING-POLICY-ROUND-ROBIN, scheduling-priority=12, termination-behavior=PROCESS-IS-NOT-SELF-TERMINATING
package /apd/Machines/shmMachine/ServiceInstanceToPortPrototypeMappings
  service instance to port prototype mapping radar_RequiredServiceInstance_toPort: port-prototype=radar_RPort, process=fusion, service-instance=RadarRequiredSomeipServiceInstance
package /apd/Machines/shmMachine/DltMappings
  dlt application to process mapping FusionDltApplicationToProcessMapping: dlt-application=FusionLogApplication, process=fusion
  dlt log sink to port prototype mapping FusionDltLogSinkToPortPrototypeMapping: dlt-context=DefaultDltContext, dlt-log-sink=[ConsoleDltSink, FusionFileDltSink, RemoteDltSink], process=fusion
