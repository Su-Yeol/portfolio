AUTOSAR XML (schema 00052)
package /apd/Machines/RadarFusionWRSOMEIPMachine/ProcessToMachineMappings
  process to machine mapping set RES_TimingRefApp
    process to machine mapping RES_TimingRefApp: machine=RadarFusionWRSOMEIPMachine, process=RES_TimingRefApp
package /apd/Machines/RadarFusionWRSOMEIPMachine/DltLogChannelToProcessMappings
  dlt application to process mapping RES_TimingRefAppDltApplicationToProcessMapping: dlt-application=RES_TimingRefApp, process=RES_TimingRefApp
  dlt log sink to port prototype mapping RES_TimingRefAppDltLogSinkToPortPrototypeMapping: dlt-context=DefaultDltContext, dlt-log-sink=[ConsoleDltSink, RemoteDltSink, RES_TimingRefAppFileDltSink], process=RES_TimingRefApp
package /apd/Machines/RadarFusionWRSOMEIPMachine/Processes
  process RES_TimingRefApp: design=RES_TimingRefApp, executable=RES_TimingRefApp, state-dependent-startup-config{function-group-state=[MachineFG.Driving, MachineFG.Parking], resource-group=ResourceGroup1, startup-config=RES_TimingRefApp}
    process state machine state_machine: type=ProcessStateMachine
package /apd/Machines/RadarFusionWRSOMEIPMachine/ServiceInstanceToPortPrototypeMappings
  service instance to port prototype mapping TRA_RequiredServiceInstance_toPort: port-prototype=cpapservicePort, process=RES_TimingRefApp, service-instance=TRA_RequiredSomeipServiceInstance
package /apd/Machines/RadarFusionWRSOMEIPMachine/StartupConfigSets
  startup config RES_TimingRefApp: environment-variables=tag-with-optional-value={key=WRSOMEIP_CONFIG_PATH, value=/etc/wrsomeip.json}, scheduling-policy=SCHEDULING-POLICY-ROUND-ROBIN, scheduling-priority=12, termination-behavior=PROCESS-IS-NOT-SELF-TERMINATING
