AUTOSAR XML (schema 00052)
package /apd/Machines/RadarFusionWRSOMEIPMachine/DltLogChannelToProcessMappings
  dlt application to process mapping update_adapter_aglDltApplicationToProcessMapping: dlt-application=UpdateAdapterAglApplication, process=update_adapter_agl
  dlt log sink to port prototype mapping update_adapter_aglDltLogSinkToPortPrototypeMapping: dlt-context=DefaultDltContext, dlt-log-sink=[ConsoleDltSink, RemoteDltSink, UpdateAdapterAGLFileDltSink], process=update_adapter_agl
package /apd/Machines/RadarFusionWRSOMEIPMachine/PersistencyKeyValueStorages
  persistency key value storage SwPackageTransferStatusStorageForUpdateAdapterAGL: persistency-deployment-uri=/opt/update_adapter_agl/var/transfer_status_database.json
package /apd/Machines/RadarFusionWRSOMEIPMachine/PersistentPortPrototypeToKeyValueStorageMappings
  persistency port prototype to key value storage mapping SwPackageTransferStatusStorageToPortMappingForUpdateAdapterAGL: port-prototype=SwPackageTransferStatusPRPort, process=update_adapter_agl, key-value-storage=SwPackageTransferStatusStorageForUpdateAdapterAGL
package /apd/Machines/RadarFusionWRSOMEIPMachine/ProcessToMachineMappings
  process to machine mapping set update_adapter_agl_mapping_set
    process to machine mapping update_adapter_agl_mapping: machine=RadarFusionWRSOMEIPMachine, process=update_adapter_agl
package /apd/Machines/RadarFusionWRSOMEIPMachine/Processes
  process update_adapter_agl: executable=update_adapter_agl, state-dependent-startup-config{function-group-state=MachineFG.Driving, resource-group=ResourceGroup1, startup-config=update_adapter_agl_startup}
    process state machine state_machine: type=ProcessStateMachine
package /apd/Machines/RadarFusionWRSOMEIPMachine/ServiceInstanceToPortPrototypeMappings
  service instance to port prototype mapping UpdateAdapterAGLPackageManagementInstanceToPortMapping: port-prototype=PackageManagementProvided, process=update_adapter_agl, service-instance=UpdateAdapterAglSomeIpPackageManagementInstance
package /apd/Machines/RadarFusionWRSOMEIPMachine/StartupConfigSets
  startup config update_adapter_agl_startup: environment-variables=tag-with-optional-value={key=WRSOMEIP_CONFIG_PATH, value=/etc/wrsomeip.json}, process-arguments=[--ucmId, UAGL, --itm], scheduling-policy=SCHEDULING-POLICY-ROUND-ROBIN, scheduling-priority=12, termination-behavior=PROCESS-IS-NOT-SELF-TERMINATING
