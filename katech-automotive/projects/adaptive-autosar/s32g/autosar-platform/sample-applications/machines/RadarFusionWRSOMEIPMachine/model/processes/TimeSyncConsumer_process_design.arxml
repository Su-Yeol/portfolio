AUTOSAR XML (schema 00052)
package /apd/Machines/RadarFusionWRSOMEIPMachine/ProcessDesigns
  process design TimeSyncConsumer: executable=TimeSyncConsumer
