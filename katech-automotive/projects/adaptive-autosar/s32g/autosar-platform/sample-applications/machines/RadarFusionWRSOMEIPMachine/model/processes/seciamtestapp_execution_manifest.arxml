AUTOSAR XML (schema 00052)
package /apd/Machines/RadarFusionWRSOMEIPMachine/Processes
  process SecIamTestApp: executable=SecIamTestApp
    process state machine state_machine: type=ProcessStateMachine
    state-dependent-startup-configs:
      execution-dependencys=[state_machine.Running, state_machine.Running], function-group-state=MachineFG.Driving, resource-group=ResourceGroup1, startup-config=SecIamTestApp
      execution-dependencys=[state_machine.Running, state_machine.Running], function-group-state=MachineFG.Parking, resource-group=ResourceGroup1, startup-config=SecIamTestApp
package /apd/Machines/RadarFusionWRSOMEIPMachine/ProcessToMachineMappings
  process to machine mapping set SecIamTestApp
    process to machine mapping SecIamTestApp: machine=RadarFusionWRSOMEIPMachine, process=SecIamTestApp
package /apd/Machines/RadarFusionWRSOMEIPMachine/DltLogChannelToProcessMappings
  dlt application to process mapping SecIamTestAppDltApplicationToProcessMapping: dlt-application=SecIamTestAppApplication, process=SecIamTestApp
  dlt log sink to port prototype mapping SecIamTestAppDltLogSinkToPortPrototypeMapping: dlt-context=DefaultDltContext, dlt-log-sink=[ConsoleDltSink, RemoteDltSink, SecIamTestAppFileDltSink], process=SecIamTestApp
package /apd/Machines/RadarFusionWRSOMEIPMachine/StartupConfigSets
  startup config SecIamTestApp: environment-variables=tag-with-optional-value={key=DLT_LOG_MODE, value=3}, scheduling-policy=SCHEDULING-POLICY-ROUND-ROBIN, scheduling-priority=12
