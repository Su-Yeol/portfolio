AUTOSAR XML (schema 00052)
package /apd/Machines/RadarFusionWRSOMEIPMachine/ProcessToMachineMappings
  process to machine mapping set smtool
    process to machine mapping smtool: machine=RadarFusionWRSOMEIPMachine, process=smtool
package /apd/Machines/RadarFusionWRSOMEIPMachine/Processes
  process smtool: design=smtool, executable=smtool
    process state machine state_machine: type=ProcessStateMachine
package /apd/Machines/RadarFusionWRSOMEIPMachine/ServiceInstanceToPortPrototypeMappings
  service instance to port prototype mapping TriggerIn_RequiredServiceInstance_toPort: port-prototype=TriggerIn_RPort, process=smtool, service-instance=TriggerIn_RequiredSomeipServiceInstance
  service instance to port prototype mapping TriggerOut_RequiredServiceInstance_toPort: port-prototype=TriggerOut_RPort, process=smtool, service-instance=TriggerOut_RequiredSomeipServiceInstance
package /apd/Machines/RadarFusionWRSOMEIPMachine/StartupConfigSets
  startup config smtool: scheduling-policy=SCHEDULING-POLICY-ROUND-ROBIN, scheduling-priority=12, termination-behavior=PROCESS-IS-SELF-TERMINATING
