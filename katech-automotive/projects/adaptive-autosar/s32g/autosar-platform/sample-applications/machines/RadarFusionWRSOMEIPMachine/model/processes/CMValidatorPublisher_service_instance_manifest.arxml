AUTOSAR XML (schema 00052)
package /apd/Machines/RadarFusionWRSOMEIPMachine/ServiceInstanceToMachineMappings
  someip service instance to machine mapping CMValidatorPublisher_ProvidedServiceInstance_toMachine: communication-connector=RadarFusionWRSOMEIPConnector, service-instance=CMValidatorPublisherProvidedSomeipServiceInstance, udp-port=TriggerApplicationEndpoint
package /apd/Machines/RadarFusionWRSOMEIPMachine/ServiceInstances
  provided someip service instance CMValidatorPublisherProvidedSomeipServiceInstance: service-interface-deployment=CMValidatorPublisher_Someip, sd-server-config=SomeipSdServerServiceInstanceConfig, service-instance-id=88
    e-2-e-event-protection-propss:
      end 2 end event protection props End2EndEventProtectionProps: data-ids=4321, e-2-e-profile-configuration=PROFILE_01, event=Event1_Someip, max-data-length=4096, min-data-length=1
      end 2 end event protection props End2EndEventProtectionProps: data-ids=[4321, 4321], e-2-e-profile-configuration=PROFILE_01, event=Event2_Someip, max-data-length=4096, min-data-length=1
    someip provided event group RequiredEventgroup1: event-group=SomeipEventgroup1, multicast-threshold=0
    someip provided event group RequiredEventgroup2: event-group=SomeipEventgroup2, multicast-threshold=0
