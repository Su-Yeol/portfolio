AUTOSAR XML (schema 00052)
package /apd/Machines/testSuiteEcu2Machine/ServiceInstanceToMachineMappings
  someip service instance to machine mapping CMApp09DiagRoutineProvidedServiceInstanceToEcu2Machine: communication-connector=CommunicationConnector1, service-instance=ST_CMApp09DiagRoutineProvidedSomeipServiceInstance, udp-port=ST_CMApp09DiagRoutineAplicationEndpoint
  someip service instance to machine mapping CMService5ProvidedServiceInstanceToEcu2Machine: communication-connector=CommunicationConnector1, service-instance=ST_CMService5ProvidedSomeipServiceInstance, udp-port=CMService5ApplicationEndpoint
package /apd/Machines/testSuiteEcu2Machine/ServiceInstances
  provided someip service instance ST_CMApp09DiagRoutineProvidedSomeipServiceInstance: service-interface-deployment=RoutineService_Someip, sd-server-config=SomeipSdServerServiceInstanceConfig, service-instance-id=1730
  provided someip service instance ST_CMService5ProvidedSomeipServiceInstance: service-interface-deployment=CMService5_Someip, sd-server-config=SomeipSdServerServiceInstanceConfig, service-instance-id=25
