AUTOSAR XML (schema 00052)
package /apd/Machines/testSuiteEcu2Machine/ProcessDesigns
  process design StateManager: executable=StateManager
