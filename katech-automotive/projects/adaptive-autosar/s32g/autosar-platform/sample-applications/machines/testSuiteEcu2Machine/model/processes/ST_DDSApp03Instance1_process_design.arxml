AUTOSAR XML (schema 00052)
package /apd/Machines/testSuiteEcu2Machine/ProcessDesigns
  process design ST_DDSApp03Instance1: executable=ST_DDSApp03
