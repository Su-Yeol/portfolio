AUTOSAR XML (schema 00052)
package /apd/Machines/testSuiteEcu2WRSOMEIPMachine/ProcessDesigns
  process design StateManager: executable=StateManager
