AUTOSAR XML (schema 00052)
package /apd/Machines/testSuiteEcu2WRSOMEIPMachine/ProcessToMachineMappings
  process to machine mapping set DDSApp03ProcessToMachineMapping
    process to machine mapping DDSApp03SwcInstance1TotestSuiteEcu2WRSOMEIPMachine: machine=testSuiteEcu2WRSOMEIPMachine, process=ST_DDSApp03Instance1
package /apd/Machines/testSuiteEcu2WRSOMEIPMachine/Processes
  process ST_DDSApp03Instance1: design=ST_DDSApp03Instance1, executable=ST_DDSApp03, state-dependent-startup-config{function-group-state=[SystemTestFunctionGroup.STS_DDS_00001, SystemTestFunctionGroup.STS_DDS_00002, SystemTestFunctionGroup.STS_DDS_00003, SystemTestFunctionGroup.STS_DDS_00004], resource-group=ResourceGroup1, startup-config=ST_DDSApp03Startup}
    process state machine state_machine: type=ProcessStateMachine
package /apd/Machines/testSuiteEcu2WRSOMEIPMachine/ServiceInstanceToPortPrototypeMappings
  service instance to port prototype mapping DDSApp03Service2RequiredServiceInstance_toPort: port-prototype=DDSApp03Service2RPort, process=ST_DDSApp03Instance1, service-instance=ST_DDSApp03Service2RequiredDdsServiceInstance
  service instance to port prototype mapping DDSApp03Service3RequiredServiceInstance_toPort: port-prototype=DDSApp03Service3RPort, process=ST_DDSApp03Instance1, service-instance=ST_DDSApp03Service3RequiredDdsServiceInstance
  service instance to port prototype mapping DDSApp03Service5RequiredServiceInstance_toPort: port-prototype=DDSApp03Service5RPort, process=ST_DDSApp03Instance1, service-instance=ST_DDSApp03Service5RequiredDdsServiceInstance
package /apd/Machines/testSuiteEcu2WRSOMEIPMachine/StartupConfigSets
  startup config ST_DDSApp03Startup: environment-variables=[{key=VSOMEIP_CONFIGURATION, value=/opt/DDSApp03/etc/vsomeip.json}, {key=DLT_LOG_MODE, value=3}], scheduling-policy=SCHEDULING-POLICY-ROUND-ROBIN, scheduling-priority=12
package /apd/Machines/testSuiteEcu2WRSOMEIPMachine/DltLogChannelToProcessMappings
  dlt application to process mapping ST_DDSApp03Instance1DltApplicationToProcessMapping: dlt-application=DDSApp03Application, process=ST_DDSApp03Instance1
  dlt log sink to port prototype mapping ST_DDSApp03Instance1DltLogSinkToPortPrototypeMapping: dlt-context=DefaultDltContext, dlt-log-sink=[DDSApp03FileDltSink, ConsoleDltSink, RemoteDltSink], process=ST_DDSApp03Instance1
