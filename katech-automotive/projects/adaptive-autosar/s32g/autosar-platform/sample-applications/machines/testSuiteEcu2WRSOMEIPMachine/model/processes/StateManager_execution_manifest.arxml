AUTOSAR XML (schema 00052)
package /apd/Machines/testSuiteEcu2WRSOMEIPMachine/ProcessToMachineMappings
  process to machine mapping set StateManager
    process to machine mapping StateManager: machine=testSuiteEcu2WRSOMEIPMachine, process=StateManager
package /apd/Machines/testSuiteEcu2WRSOMEIPMachine/DltLogChannelToProcessMappings
  dlt application to process mapping StateManagerDltApplicationToProcessMapping: dlt-application=StateManagerApplication, process=StateManager
  dlt log sink to port prototype mapping StateManagerDltLogSinkToPortPrototypeMapping: dlt-context=DefaultDltContext, dlt-log-sink=[ConsoleDltSink, RemoteDltSink, StateManagerFileDltSink], process=StateManager
package /apd/Machines/testSuiteEcu2WRSOMEIPMachine/Processes
  process StateManager: executable=StateManager, function-cluster-affiliation=STATE_MANAGEMENT, state-dependent-startup-config{function-group-state=[MachineFG.Startup, MachineFG.Driving, MachineFG.Shutdown, MachineFG.Restart, MachineFG.Parking, MachineFG.Leaving, MachineFG.Verify], resource-group=ResourceGroupSM, startup-config=StateManager}
    process state machine state_machine: type=ProcessStateMachine
package /apd/Machines/testSuiteEcu2WRSOMEIPMachine/ServiceInstanceToPortPrototypeMappings
  7 x service instance to port prototype mapping, all with process=StateManager:
    RoutineService_ProvidedServiceInterface_toPort: port-prototype=RoutineService_PPort, service-instance=RoutineService_ProvidedSomeipServiceInstance
    UpdateAllowedService_ProvidedServiceInterface_toPort: port-prototype=UpdateAllowedService_PPort, service-instance=UpdateAllowedService_ProvidedSomeipServiceInstance
    UpdateRequest_ProvidedServiceInterface_toPort: port-prototype=UpdateRequest_PPort, service-instance=UpdateRequest_ProvidedSomeipServiceInstance
    StateMachineService_ProvidedServiceInterface_toPort: port-prototype=StateMachineService_PPort, service-instance=StateMachineService_ProvidedSomeipServiceInstance
    TriggerInOut_ProvidedServiceInstance_toPort: port-prototype=TriggerInOut_PPort, service-instance=TriggerInOut_ProvidedSomeipServiceInstance
    TriggerIn_ProvidedServiceInstance_toPort: port-prototype=TriggerIn_PPort, service-instance=TriggerIn_ProvidedSomeipServiceInstance
    TriggerOut_ProvidedServiceInstance_toPort: port-prototype=TriggerOut_PPort, service-instance=TriggerOut_ProvidedSomeipServiceInstance
package /apd/Machines/testSuiteEcu2WRSOMEIPMachine/StartupConfigSets
  startup config StateManager: environment-variables=tag-with-optional-value={key=DLT_LOG_MODE, value=3}, scheduling-policy=SCHEDULING-POLICY-ROUND-ROBIN, scheduling-priority=12, termination-behavior=PROCESS-IS-NOT-SELF-TERMINATING
