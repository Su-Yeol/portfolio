AUTOSAR XML (schema 00052)
package /apd/Machines/testSuiteEcu2WRSOMEIPMachine/ServiceInstanceToMachineMappings
  someip service instance to machine mapping CmService1RequiredServiceInstanceToEcu2Machine: communication-connector=CommunicationWRSOMEIPConnector1, service-instance=ST_CMApp02CMService1RequiredSomeipServiceInstance, udp-port=ST_CMApp02CMService1ApplicationEndpoint
  someip service instance to machine mapping CMApp02DiagDataIdentifierProvidedServiceInstanceToEcu2Machine: communication-connector=CommunicationWRSOMEIPConnector1, service-instance=ST_CMApp02DiagDataIdentifierProvidedSomeipServiceInstance, udp-port=CMApp02DiagDataIdentifierApplicationEndpoint
package /apd/Machines/testSuiteEcu2WRSOMEIPMachine/ServiceInstances
  required someip service instance ST_CMApp02CMService1RequiredSomeipServiceInstance: service-interface-deployment=CMService1_Someip, required-service-instance-id=19, sd-client-config=SomeipSdClientServiceInstanceConfig
  provided someip service instance ST_CMApp02DiagDataIdentifierProvidedSomeipServiceInstance: service-interface-deployment=DataIdentifier_Someip, sd-server-config=SomeipSdServerServiceInstanceConfig, service-instance-id=2001
