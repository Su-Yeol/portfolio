AUTOSAR XML (schema 00052)
package /apd/Machines/testSuiteEcu2WRSOMEIPMachine/ProcessToMachineMappings
  process to machine mapping set CMApp11ProcessToMachineMapping
    process to machine mapping CMApp11SwcInstance1TotestSuiteEcu2WRSOMEIPMachine: machine=testSuiteEcu2WRSOMEIPMachine, process=ST_CMApp11Instance1
package /apd/Machines/testSuiteEcu2WRSOMEIPMachine/Processes
  process ST_CMApp11Instance1: design=ST_CMApp11Instance1, executable=ST_CMApp11, state-dependent-startup-config{function-group-state=SystemTestFunctionGroup.STS_CM_00003, resource-group=ResourceGroup1, startup-config=ST_CMApp11Startup}
    process state machine state_machine: type=ProcessStateMachine
package /apd/Machines/testSuiteEcu2WRSOMEIPMachine/ServiceInstanceToPortPrototypeMappings
  service instance to port prototype mapping CMApp11CMService5RequiredServiceInstanceToPort: port-prototype=CMApp11Service5Rport, process=ST_CMApp11Instance1, service-instance=ST_CMApp11CMService5RequiredSomeipServiceInstance
  service instance to port prototype mapping DataIdentifierPPortToCMApp11: port-prototype=DataIdentifierPport, process=ST_CMApp11Instance1, service-instance=ST_CMApp11DiagDataIdentifierProvidedSomeipServiceInstance
  service instance to port prototype mapping DiagRoutinePPortToCMApp11: port-prototype=DiagRoutineServicePport, process=ST_CMApp11Instance1, service-instance=ST_CMApp11DiagRoutineProvidedSomeipServiceInstance
package /apd/Machines/testSuiteEcu2WRSOMEIPMachine/StartupConfigSets
  startup config ST_CMApp11Startup: environment-variables=[{key=VSOMEIP_CONFIGURATION, value=/opt/CMApp11/etc/vsomeip.json}, {key=DLT_LOG_MODE, value=3}], scheduling-policy=SCHEDULING-POLICY-ROUND-ROBIN, scheduling-priority=12
package /apd/Machines/testSuiteEcu2WRSOMEIPMachine/DltLogChannelToProcessMappings
  dlt application to process mapping ST_CMApp11Instance1DltApplicationToProcessMapping: dlt-application=CMApp11Application, process=ST_CMApp11Instance1
  dlt log sink to port prototype mapping ST_CMApp11Instance1DltLogSinkToPortPrototypeMapping: dlt-context=DefaultDltContext, dlt-log-sink=[CMApp11FileDltSink, ConsoleDltSink, RemoteDltSink], process=ST_CMApp11Instance1
