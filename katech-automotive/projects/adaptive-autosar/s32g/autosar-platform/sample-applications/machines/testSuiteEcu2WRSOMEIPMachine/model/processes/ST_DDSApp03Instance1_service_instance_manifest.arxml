AUTOSAR XML (schema 00052)
package /apd/Machines/testSuiteEcu2WRSOMEIPMachine/ServiceInstanceToMachineMappings
  dds service instance to machine mapping DDSService2RequiredServiceInstanceToEcu2Machine: communication-connector=CommunicationWRSOMEIPConnector1, service-instance=[ST_DDSApp03Service2RequiredDdsServiceInstance, ST_DDSApp03Service3RequiredDdsServiceInstance, ST_DDSApp03Service5RequiredDdsServiceInstance]
package /apd/Machines/testSuiteEcu2WRSOMEIPMachine/ServiceInstances
  dds required service instance ST_DDSApp03Service2RequiredDdsServiceInstance: service-interface-deployment=DDSService2_Dds, qos-profile=default, domain-id=40, dds-event-qos-props{qos-profile=default, event=DdsEventC}, required-service-instance-id=30
  dds required service instance ST_DDSApp03Service3RequiredDdsServiceInstance: service-interface-deployment=DDSService3_Dds, qos-profile=default, domain-id=41, dds-field-qos-props{qos-profile=default, field=FieldA_Dds}, required-service-instance-id=31
  dds required service instance ST_DDSApp03Service5RequiredDdsServiceInstance: service-interface-deployment=DDSService5_Dds, qos-profile=default, domain-id=38, required-service-instance-id=33
