AUTOSAR XML (schema 00052)
package /apd/Machines/RadarFusionMachine/ProcessToMachineMappings
  process to machine mapping set TimeSyncConsumer
    process to machine mapping TimeSyncConsumer: machine=RadarFusionMachine, process=TimeSyncConsumer
package /apd/Machines/RadarFusionMachine/DltLogChannelToProcessMappings
  dlt application to process mapping TimeSyncConsumerDltApplicationToProcessMapping: dlt-application=TimeSyncConsumerApplication, process=TimeSyncConsumer
  dlt log sink to port prototype mapping TimeSyncConsumerDltLogSinkToPortPrototypeMapping: dlt-context=DefaultDltContext, dlt-log-sink=[TimeSyncConsumerFileDltSink, ConsoleDltSink, RemoteDltSink], process=TimeSyncConsumer
package /apd/Machines/RadarFusionMachine/Processes
  process TimeSyncConsumer: design=TimeSyncConsumer, executable=TimeSyncConsumer
    process state machine state_machine: type=ProcessStateMachine
    state-dependent-startup-configs:
      execution-dependency=state_machine.Running, function-group-state=MachineFG.Driving, resource-group=ResourceGroup2, startup-config=TimeSyncConsumer
      execution-dependency=state_machine.Running, function-group-state=MachineFG.Parking, resource-group=ResourceGroup2, startup-config=TimeSyncConsumer
package /apd/Machines/RadarFusionMachine/StartupConfigSets
  startup config TimeSyncConsumer: scheduling-policy=SCHEDULING-POLICY-ROUND-ROBIN, scheduling-priority=12, termination-behavior=PROCESS-IS-NOT-SELF-TERMINATING
