AUTOSAR XML (schema 00052)
package /apd/Machines/RadarFusionMachine/ProcessToMachineMappings
  process to machine mapping set FaultyProbingApplication
    process to machine mapping FaultyProbingApplication: machine=RadarFusionMachine, process=FaultyProbingApplication
package /apd/Machines/RadarFusionMachine/Dlt
  dlt application to process mapping FaultyProbingDltApplicationToProcessMapping: dlt-application=FaultyProbingApplication, process=FaultyProbingApplication
  dlt log sink to port prototype mapping FaultyProbingDltLogSinkToPortPrototypeMapping: dlt-context=DefaultDltContext, dlt-log-sink=[ConsoleDltSink, RemoteDltSink, FaultyProbingFileDltSink], process=FaultyProbingApplication
package /apd/Machines/RadarFusionMachine/Processes
  process FaultyProbingApplication: design=FaultyProbingApplication, executable=FaultyProbingApplication, number-of-restart-attempts=0, state-dependent-startup-config{function-group-state=Sensor.Probing, resource-group=ResourceGroup1, startup-config=FaultyProbingApplication}
    process state machine state_machine: type=ProcessStateMachine
package /apd/Machines/RadarFusionMachine/StartupConfigSets
  startup config FaultyProbingApplication: scheduling-policy=SCHEDULING-POLICY-ROUND-ROBIN, scheduling-priority=12, termination-behavior=PROCESS-IS-NOT-SELF-TERMINATING, timeout={enter-timeout-value=0.5, exit-timeout-value=0.25}
