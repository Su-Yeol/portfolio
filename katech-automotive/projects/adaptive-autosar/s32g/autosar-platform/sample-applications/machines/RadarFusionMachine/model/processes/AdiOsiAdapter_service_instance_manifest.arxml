AUTOSAR XML (schema 00052)
package /apd/Machines/RadarFusionMachine/ServiceInstanceToMachineMappings
  9 x someip service instance to machine mapping, all with communication-connector=RadarFusionConnector, udp-port=TriggerApplicationEndpoint:
    SmartCameraSensor_RequiredServiceInstance_toMachine: service-instance=SmartCameraSensorRequiredSomeipServiceInstance
    SmartCameraSensor_RequiredServiceInstance{2..9}_toMachine: service-instance=SmartCameraSensorRequiredSomeipServiceInstance{2..9}
package /apd/Machines/RadarFusionMachine/ServiceInstances
  9 x required someip service instance, all with required-minor-version=0, sd-client-config=SomeipSdClientServiceInstanceConfig, version-driven-find-behavior=MINIMUM-MINOR-VERSION:
    SmartCameraSensorRequiredSomeipServiceInstance: service-interface-deployment=RoadObjects_Someip, required-service-instance-id=119
      e-2-e-event-protection-propss:
        end 2 end event protection props End2EndEventProtectionProps: data-ids=4321, e-2-e-profile-configuration=PROFILE_01, event=RoadObjectInterface_Someip, max-data-length=4096, min-data-length=1
      someip required event group RequiredEventgroup1: event-group=SomeipEventgroup1
    SmartCameraSensorRequiredSomeipServiceInstance2: service-interface-deployment=StaticObjects_Someip, required-service-instance-id=139
      e-2-e-event-protection-propss:
        end 2 end event protection props End2EndEventProtectionProps: data-ids=4321, e-2-e-profile-configuration=PROFILE_01, event=StaticObjectInterface_Someip, max-data-length=4096, min-data-length=1
      someip required event group RequiredEventgroup1: event-group=SomeipEventgroup1
    SmartCameraSensorRequiredSomeipServiceInstance3: service-interface-deployment=PotentiallyMovingObjects_Someip, required-service-instance-id=189
      e-2-e-event-protection-propss:
        end 2 end event protection props End2EndEventProtectionProps: data-ids=4321, e-2-e-profile-configuration=PROFILE_01, event=PotentiallyMovingObjectsInterface_Someip, max-data-length=4096, min-data-length=1
      someip required event group RequiredEventgroup1: event-group=SomeipEventgroup1
    SmartCameraSensorRequiredSomeipServiceInstance4: service-interface-deployment=CameraFeatures_Someip, required-service-instance-id=188
      e-2-e-event-protection-propss:
        end 2 end event protection props End2EndEventProtectionProps: data-ids=4321, e-2-e-profile-configuration=PROFILE_01, event=CameraFeaturesInterface_Someip, max-data-length=4096, min-data-length=1
      someip required event group RequiredEventgroup1: event-group=SomeipEventgroup1
    SmartCameraSensorRequiredSomeipServiceInstance5: service-interface-deployment=CameraDetection_Someip, required-service-instance-id=187
      e-2-e-event-protection-propss:
        end 2 end event protection props End2EndEventProtectionProps: data-ids=4321, e-2-e-profile-configuration=PROFILE_01, event=CameraDetectionInterface_Someip, max-data-length=4096, min-data-length=1
      someip required event group RequiredEventgroup1: event-group=SomeipEventgroup1
    SmartCameraSensorRequiredSomeipServiceInstance6: service-interface-deployment=UltrasonicDetections_Someip, required-service-instance-id=186
      e-2-e-event-protection-propss:
        end 2 end event protection props End2EndEventProtectionProps: data-ids=4321, e-2-e-profile-configuration=PROFILE_01, event=UltrasonicDetectionsInterface_Someip, max-data-length=4096, min-data-length=1
      someip required event group RequiredEventgroup1: event-group=SomeipEventgroup1
    SmartCameraSensorRequiredSomeipServiceInstance7: service-interface-deployment=UltrasonicFeatures_Someip, required-service-instance-id=185
      e-2-e-event-protection-propss:
        end 2 end event protection props End2EndEventProtectionProps: data-ids=4321, e-2-e-profile-configuration=PROFILE_01, event=UltrasonicFeaturesInterface_Someip, max-data-length=4096, min-data-length=1
      someip required event group RequiredEventgroup1: event-group=SomeipEventgroup1
    SmartCameraSensorRequiredSomeipServiceInstance8: service-interface-deployment=LidarDetections_Someip, required-service-instance-id=184
      e-2-e-event-protection-propss:
        end 2 end event protection props End2EndEventProtectionProps: data-ids=4321, e-2-e-profile-configuration=PROFILE_01, event=LidarDetectionsInterface_Someip, max-data-length=4096, min-data-length=1
      someip required event group RequiredEventgroup1: event-group=SomeipEventgroup1
    SmartCameraSensorRequiredSomeipServiceInstance9: service-interface-deployment=RadarDetections_Someip, required-service-instance-id=183
      e-2-e-event-protection-propss:
        end 2 end event protection props End2EndEventProtectionProps: data-ids=4321, e-2-e-profile-configuration=PROFILE_01, event=RadarDetectionsInterface_Someip, max-data-length=4096, min-data-length=1
      someip required event group RequiredEventgroup1: event-group=SomeipEventgroup1
