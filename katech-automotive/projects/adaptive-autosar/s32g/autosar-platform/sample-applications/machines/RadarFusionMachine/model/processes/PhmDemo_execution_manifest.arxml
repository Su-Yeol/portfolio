AUTOSAR XML (schema 00052)
package /apd/Machines/RadarFusionMachine/ProcessToMachineMappings
  process to machine mapping set PhmDemo
    process to machine mapping PhmDemo: machine=RadarFusionMachine, process=PhmDemo
package /apd/Machines/RadarFusionMachine/DltLogChannelToProcessMappings
  dlt application to process mapping PhmDemoDltApplicationToProcessMapping: dlt-application=PhmDemoApplication, process=PhmDemo
  dlt log sink to port prototype mapping PhmDemoDltLogSinkToPortPrototypeMapping: dlt-context=DefaultDltContext, dlt-log-sink=[ConsoleDltSink, RemoteDltSink, PhmDemoFileDltSink], process=PhmDemo
package /apd/Machines/RadarFusionMachine/Processes
  process PhmDemo: design=PhmDemo, executable=PhmDemo, state-dependent-startup-config{function-group-state=MachineFG.Driving, resource-group=ResourceGroup1, startup-config=PhmDemo}
    process state machine state_machine: type=ProcessStateMachine
package /apd/Machines/RadarFusionMachine/StartupConfigSets
  startup config PhmDemo: scheduling-policy=SCHEDULING-POLICY-ROUND-ROBIN, scheduling-priority=12, termination-behavior=PROCESS-IS-SELF-TERMINATING
