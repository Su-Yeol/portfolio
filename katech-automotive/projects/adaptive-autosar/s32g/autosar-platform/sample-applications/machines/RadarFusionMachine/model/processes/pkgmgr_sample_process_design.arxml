AUTOSAR XML (schema 00052)
package /apd/Machines/RadarFusionMachine/ProcessDesigns
  process design pkgmgr_sample: executable=pkgmgr_sample
