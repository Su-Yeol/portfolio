AUTOSAR XML (schema 00052)
package /apd/Machines/RadarFusionMachine/ProcessToMachineMappings
  process to machine mapping set fc_firewall
    process to machine mapping fc_firewall: machine=RadarFusionMachine, process=fc_firewall
package /apd/Machines/RadarFusionMachine/DltLogChannelToProcessMappings
  dlt application to process mapping fc_firewallDltApplicationToProcessMapping: dlt-application=fc_firewall, process=fc_firewall
  dlt log sink to port prototype mapping fc_firewallDltLogSinkToPortPrototypeMapping: dlt-context=DefaultDltContext, dlt-log-sink=[ConsoleDltSink, RemoteDltSink, FCFirewallFileDltSink], process=fc_firewall
package /apd/Machines/RadarFusionMachine/Processes
  process fc_firewall: executable=fc_firewall, state-dependent-startup-config{function-group-state=[MachineFG.Driving, MachineFG.Parking], resource-group=ResourceGroup1, startup-config=fc_firewall_startup}
    process state machine state_machine: type=ProcessStateMachine
package /apd/Machines/RadarFusionMachine/startup_configs
  startup config fc_firewall_startup: scheduling-policy=SCHEDULING-POLICY-ROUND-ROBIN, scheduling-priority=12, termination-behavior=PROCESS-IS-NOT-SELF-TERMINATING
