AUTOSAR XML (schema 00052)
package /apd/Machines/RadarFusionMachine/ServiceInstanceToMachineMappings
  someip service instance to machine mapping TutIfInst1OnRadarFusionMachine: communication-connector=RadarFusionConnector, service-instance=[TutorialInterfaceProvidedSomeipServiceInstance1, TutorialInterfaceRequiredSomeipServiceInstance], udp-port=TriggerApplicationEndpoint
  someip service instance to machine mapping TutIfInst2OnRadarFusionMachine: communication-connector=RadarFusionConnector, service-instance=TutorialInterfaceProvidedSomeipServiceInstance2, udp-port=TriggerApplicationEndpointExtended
package /apd/Machines/RadarFusionMachine/ServiceInstances
  provided someip service instance TutorialInterfaceProvidedSomeipServiceInstance1: service-interface-deployment=TutorialInterfaceSomeipDeployment, sd-server-config=SomeipSdServerServiceInstanceConfig, service-instance-id=1
    someip provided event group ProvidedEventGroup: event-group=TutorialInterfaceEventGroup, multicast-threshold=0
  provided someip service instance TutorialInterfaceProvidedSomeipServiceInstance2: service-interface-deployment=TutorialInterfaceSomeipDeployment, sd-server-config=SomeipSdServerServiceInstanceConfig, service-instance-id=2
    someip provided event group ProvidedEventGroup: event-group=TutorialInterfaceEventGroup, multicast-threshold=0
  required someip service instance TutorialInterfaceRequiredSomeipServiceInstance: service-interface-deployment=TutorialInterfaceSomeipDeployment, required-service-instance-id=ANY, sd-client-config=SomeipSdClientServiceInstanceConfig
    someip required event group RequiredEventGroup: event-group=TutorialInterfaceEventGroup
