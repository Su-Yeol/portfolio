AUTOSAR XML (schema 00052)
package /apd/Machines/RadarFusionMachine/ServiceInstanceToMachineMappings
  7 x someip service instance to machine mapping, all with communication-connector=RadarFusionConnector:
    RoutineService_ProvidedServiceInstance_toMachine: service-instance=RoutineService_ProvidedSomeipServiceInstance, udp-port=RoutineServiceApplicationEndpoint
    StateMachineService_ProvidedServiceInstance_toMachine: service-instance=StateMachineService_ProvidedSomeipServiceInstance, udp-port=StateMachineServiceApplicationEndpoint
    TriggerIn_ProvidedServiceInstance_toMachine: service-instance=TriggerIn_ProvidedSomeipServiceInstance, udp-port=TriggerApplicationEndpoint
    TriggerInOut_ProvidedServiceInstance_toMachine: service-instance=TriggerInOut_ProvidedSomeipServiceInstance, udp-port=TriggerApplicationEndpoint
    TriggerOut_ProvidedServiceInstance_toMachine: service-instance=TriggerOut_ProvidedSomeipServiceInstance, udp-port=TriggerApplicationEndpoint
    UpdateAllowedService_ProvidedServiceInstance_toMachine: service-instance=UpdateAllowedService_ProvidedSomeipServiceInstance, udp-port=UpdateAllowedServiceApplicationEndpoint
    UpdateRequest_ProvidedServiceInstance_toMachine: service-instance=UpdateRequest_ProvidedSomeipServiceInstance, tcp-port=UpdateRequestApplicationEndpoint
package /apd/Machines/RadarFusionMachine/ServiceInstances
  7 x provided someip service instance:
    RoutineService_ProvidedSomeipServiceInstance: service-interface-deployment=RoutineService_Someip, service-instance-id=8899
    StateMachineService_ProvidedSomeipServiceInstance: service-interface-deployment=StateMachineService_Someip, sd-server-config=SomeipSdServerServiceInstanceConfig, service-instance-id=670
    UpdateAllowedService_ProvidedSomeipServiceInstance: service-interface-deployment=UpdateAllowedService_Someip, sd-server-config=SomeipSdServerServiceInstanceConfig, service-instance-id=671
      someip provided event group ProvidedEventGroup: event-group=SomeIpEventGroup, multicast-threshold=2
    UpdateRequest_ProvidedSomeipServiceInstance: service-interface-deployment=UpdateRequest_Someip, sd-server-config=SomeipSdServerServiceInstanceConfig, service-instance-id=666
    TriggerInOut_ProvidedSomeipServiceInstance: service-interface-deployment=TriggerInOut_Someip, sd-server-config=SomeipSdServerServiceInstanceConfig, service-instance-id=669
      someip provided event group ProvidedEventGroup: event-group=SomeIpEventGroup, multicast-threshold=2
    TriggerIn_ProvidedSomeipServiceInstance: service-interface-deployment=TriggerIn_Someip, sd-server-config=SomeipSdServerServiceInstanceConfig, service-instance-id=49
    TriggerOut_ProvidedSomeipServiceInstance: service-interface-deployment=TriggerOut_Someip, sd-server-config=SomeipSdServerServiceInstanceConfig, service-instance-id=668
      someip provided event group ProvidedEventGroup: event-group=SomeIpEventGroup, multicast-threshold=2
