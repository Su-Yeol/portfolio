AUTOSAR XML (schema 00052)
package /apd/Machines/RadarFusionMachine/ProcessToMachineMappings
  process to machine mapping set UpdatableApp
    process to machine mapping UpdatableApp: machine=RadarFusionMachine, process=UpdatableApp
package /apd/Machines/RadarFusionMachine/Processes
  process UpdatableApp: executable=UpdatableApp
    process state machine StateMachine: type=ProcessStateMachine
    state-dependent-startup-configs:
      function-group-state=UpdatableApplicationFG.Running, resource-group=ResourceGroup1, startup-config=UpdatableAppStartupRunning
      function-group-state=UpdatableApplicationFG.Verify, resource-group=ResourceGroup1, startup-config=UpdatableAppStartupVerify
package /apd/Machines/RadarFusionMachine/DltLogChannelToProcessMappings
  dlt application to process mapping UpdatableAppDltApplicationToProcessMapping: dlt-application=UpdatableApplication, process=UpdatableApp
  dlt log sink to port prototype mapping UpdatableAppDltLogSinkToPortPrototypeMapping: dlt-context=DefaultDltContext, dlt-log-sink=[ConsoleDltSink, RemoteDltSink, UpdatableAppFileDltSink], process=UpdatableApp
package /apd/Machines/RadarFusionMachine/StartupConfigSets
  startup config UpdatableAppStartupRunning: process-arguments=[--FGState, Running], scheduling-policy=SCHEDULING-POLICY-ROUND-ROBIN, scheduling-priority=12, termination-behavior=PROCESS-IS-NOT-SELF-TERMINATING
  startup config UpdatableAppStartupVerify: process-arguments=[--FGState, Verify], scheduling-policy=SCHEDULING-POLICY-ROUND-ROBIN, scheduling-priority=12, termination-behavior=PROCESS-IS-NOT-SELF-TERMINATING
