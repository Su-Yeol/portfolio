AUTOSAR XML (schema 00052)
package /apd/Machines/RadarFusionMachine/ProcessToMachineMappings
  process to machine mapping set Radar
    process to machine mapping Radar: machine=RadarFusionMachine, process=radar
package /apd/Machines/RadarFusionMachine/DltLogChannelToProcessMappings
  dlt application to process mapping radarDltApplicationToProcessMapping: dlt-application=RadarApplication, process=radar
  dlt log sink to port prototype mapping radarDltLogSinkToPortPrototypeMapping: dlt-context=DefaultDltContext, dlt-log-sink=[ConsoleDltSink, RemoteDltSink, RadarFileDltSink], process=radar
package /apd/Machines/RadarFusionMachine/Processes
  process radar: design=radar, executable=radar, state-dependent-startup-config{function-group-state=[MachineFG.Driving, MachineFG.Parking], resource-group=ResourceGroup1, startup-config=RadarStartup}
    process state machine state_machine: type=ProcessStateMachine
package /apd/Machines/RadarFusionMachine/ServiceInstanceToPortPrototypeMappings
  service instance to port prototype mapping radar_ProvidedServiceInstance_toPort: port-prototype=radar_PPort, process=radar, service-instance=RadarProvidedSomeipServiceInstance
package /apd/Machines/RadarFusionMachine/StartupConfigSets
  startup config RadarStartup: environment-variables=tag-with-optional-value={key=VSOMEIP_CONFIGURATION, value=/etc/vsomeip.json}, scheduling-policy=SCHEDULING-POLICY-ROUND-ROBIN, scheduling-priority=12, termination-behavior=PROCESS-IS-NOT-SELF-TERMINATING
