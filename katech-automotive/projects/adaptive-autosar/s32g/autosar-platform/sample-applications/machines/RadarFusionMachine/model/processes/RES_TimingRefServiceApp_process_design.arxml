AUTOSAR XML (schema 00052)
package /apd/Machines/RadarFusionMachine/ProcessDesigns
  process design RES_TimingRefServiceApp: executable=RES_TimingRefServiceApp
