AUTOSAR XML (schema 00052)
package /apd/Machines/RadarFusionMachine/ProcessToMachineMappings
  process to machine mapping set ota_client
    process to machine mapping ota_client: machine=RadarFusionMachine, process=ota_client
package /apd/Machines/RadarFusionMachine/DltLogChannelToProcessMappings
  dlt application to process mapping ota_clientDltApplicationToProcessMapping: dlt-application=OtaClientApplication, process=ota_client
  dlt log sink to port prototype mapping ota_clientDltLogSinkToPortPrototypeMapping: dlt-context=DefaultDltContext, dlt-log-sink=[ConsoleDltSink, RemoteDltSink, OtaClientFileDltSink], process=ota_client
package /apd/Machines/RadarFusionMachine/Processes
  process ota_client: executable=ota_app
    process state machine state_machine: type=ProcessStateMachine
    state-dependent-startup-configs:
      function-group-state=UCMDemoModeFG.VUCM_Backend_Hawkbit, resource-group=ResourceGroup1, startup-config=ota_client_startup_hawkbit
      function-group-state=UCMDemoModeFG.VUCM_Backend_Pull, resource-group=ResourceGroup1, startup-config=ota_client_startup_pull
      function-group-state=UCMDemoModeFG.VUCM_ITM, resource-group=ResourceGroup1, startup-config=ota_client_startup_itm
package /apd/Machines/RadarFusionMachine/ServiceInstanceToPortPrototypeMappings
  service instance to port prototype mapping RequiredVehPackageManagementInstanceToPortMapping: port-prototype=VehiclePackageManagementRPort, process=ota_client, service-instance=RequiredSomeIpVehiclePackageManagementInstance
package /apd/Machines/RadarFusionMachine/StartupConfigSets
  startup config ota_client_startup_hawkbit: process-arguments=[--provider-mode, hawkbitProvider, --c, etc/config.ini], scheduling-policy=SCHEDULING-POLICY-ROUND-ROBIN, scheduling-priority=12, termination-behavior=PROCESS-IS-SELF-TERMINATING
  startup config ota_client_startup_itm: process-arguments=[--provider-mode, localProvider, --vehiclepackage, ucm_vpm_picar.arvp, --datapath, /usr/share/apdtest/ucm], scheduling-policy=SCHEDULING-POLICY-ROUND-ROBIN, scheduling-priority=12, termination-behavior=PROCESS-IS-SELF-TERMINATING
  startup config ota_client_startup_pull: process-arguments=[--provider-mode, pullProvider], scheduling-policy=SCHEDULING-POLICY-ROUND-ROBIN, scheduling-priority=12, termination-behavior=PROCESS-IS-SELF-TERMINATING
