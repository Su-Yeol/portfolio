AUTOSAR XML (schema 00052)
package /apd/Machines/RadarFusionMachine/ServiceInstanceToMachineMappings
  someip service instance to machine mapping RequiredVehicleDriverApplicationInterfaceInstanceToMachineMapping: communication-connector=RadarFusionConnector, service-instance=RequiredSomeIpVehicleDriverApplicationInterfaceInstance
package /apd/Machines/RadarFusionMachine/ServiceInstances
  required someip service instance RequiredSomeIpVehicleDriverApplicationInterfaceInstance: service-interface-deployment=VehicleDriverApplicationInterfaceSomeIp, required-minor-version=0, required-service-instance-id=ANY, sd-client-config=SomeipSdClientServiceInstanceConfig
    someip required event group ApprovalRequired_required_eventgroup: event-group=ApprovalRequired_eventgroup
    someip required event group CampaignState_required_eventgroup: event-group=CampaignState_eventgroup
    someip required event group VehicleConditionCollection_required_eventgroup: event-group=VehicleConditionCollection_eventgroup
