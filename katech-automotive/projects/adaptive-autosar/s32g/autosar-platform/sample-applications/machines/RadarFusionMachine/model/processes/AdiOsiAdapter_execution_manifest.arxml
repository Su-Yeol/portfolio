AUTOSAR XML (schema 00052)
package /apd/Machines/RadarFusionMachine/ProcessToMachineMappings
  process to machine mapping set AdiOsiAdapter
    process to machine mapping AdiOsiAdapter: machine=RadarFusionMachine, process=AdiOsiAdapter
package /apd/Machines/RadarFusionMachine/DltLogChannelToProcessMappings
  dlt application to process mapping AdiOsiAdapterDltApplicationToProcessMapping: dlt-application=AdiOsiAdapterApplication, process=AdiOsiAdapter
  dlt log sink to port prototype mapping AdiOsiAdapterDltLogSinkToPortPrototypeMapping: dlt-context=DefaultDltContext, dlt-log-sink=[ConsoleDltSink, RemoteDltSink, AdiOsiAdapterLogFileDltSink], process=AdiOsiAdapter
package /apd/Machines/RadarFusionMachine/Processes
  process AdiOsiAdapter: design=AdiOsiAdapter, executable=AdiOsiAdapter, state-dependent-startup-config{function-group-state=[MachineFG.Driving, MachineFG.Parking], resource-group=ResourceGroup1, startup-config=AdiOsiAdapterStartup}
    process state machine state_machine: type=ProcessStateMachine
package /apd/Machines/RadarFusionMachine/ServiceInstanceToPortPrototypeMappings
  9 x service instance to port prototype mapping, all with process=AdiOsiAdapter:
    SmartCameraSensor_RequiredServiceInstance_toPort: port-prototype=AdiOsiAdapter_RPort, service-instance=SmartCameraSensorRequiredSomeipServiceInstance
    SmartCameraSensor_RequiredServiceInstance{2..9}_toPort: port-prototype=AdiOsiAdapter_RPort{2..9}, service-instance=SmartCameraSensorRequiredSomeipServiceInstance{2..9}
package /apd/Machines/RadarFusionMachine/StartupConfigSets
  startup config AdiOsiAdapterStartup: environment-variables=tag-with-optional-value={key=VSOMEIP_CONFIGURATION, value=/etc/vsomeip.json}, scheduling-policy=SCHEDULING-POLICY-ROUND-ROBIN, scheduling-priority=12, termination-behavior=PROCESS-IS-NOT-SELF-TERMINATING
