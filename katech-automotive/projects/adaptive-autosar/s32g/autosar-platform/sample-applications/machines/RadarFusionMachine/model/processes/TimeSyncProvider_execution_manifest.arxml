AUTOSAR XML (schema 00052)
package /apd/Machines/RadarFusionMachine/ProcessToMachineMappings
  process to machine mapping set TimeSyncProvider
    process to machine mapping TimeSyncProvider: machine=RadarFusionMachine, process=TimeSyncProvider
package /apd/Machines/RadarFusionMachine/DltLogChannelToProcessMappings
  dlt application to process mapping TimeSyncProviderDltApplicationToProcessMapping: dlt-application=TimeSyncProviderApplication, process=TimeSyncProvider
  dlt log sink to port prototype mapping TimeSyncProviderDltLogSinkToPortPrototypeMapping: dlt-context=DefaultDltContext, dlt-log-sink=[ConsoleDltSink, RemoteDltSink, TimeSyncProviderFileDltSink], process=TimeSyncProvider
package /apd/Machines/RadarFusionMachine/Processes
  process TimeSyncProvider: design=TimeSyncProvider, executable=TimeSyncProvider, state-dependent-startup-config{function-group-state=[MachineFG.Driving, MachineFG.Parking], resource-group=ResourceGroup2, startup-config=TimeSyncProvider}
    process state machine state_machine: type=ProcessStateMachine
package /apd/Machines/RadarFusionMachine/StartupConfigSets
  startup config TimeSyncProvider: scheduling-policy=SCHEDULING-POLICY-ROUND-ROBIN, scheduling-priority=12, termination-behavior=PROCESS-IS-NOT-SELF-TERMINATING
