AUTOSAR XML (schema 00052)
package /apd/Machines/RadarFusionMachine/ProcessToMachineMappings
  process to machine mapping set FaultyReportingApplication
    process to machine mapping FaultyReportingApplication: machine=RadarFusionMachine, process=FaultyReportingApplication
package /apd/Machines/RadarFusionMachine/Dlt
  dlt application to process mapping FaultyReportingDltApplicationToProcessMapping: dlt-application=FaultyReportingApplication, process=FaultyReportingApplication
  dlt log sink to port prototype mapping FaultyReportingDltLogSinkToPortPrototypeMapping: dlt-context=DefaultDltContext, dlt-log-sink=[ConsoleDltSink, RemoteDltSink, FaultyReportingFileDltSink], process=FaultyReportingApplication
package /apd/Machines/RadarFusionMachine/Processes
  process FaultyReportingApplication: design=FaultyReportingApplication, executable=FaultyReportingApplication, number-of-restart-attempts=0, state-dependent-startup-config{function-group-state=Sensor.Reporting, resource-group=ResourceGroup1, startup-config=FaultyReportingApplication}
    process state machine state_machine: type=ProcessStateMachine
package /apd/Machines/RadarFusionMachine/ProcessDesigns
  process design FaultyReportingApplication: executable=FaultyReportingApplication
package /apd/Machines/RadarFusionMachine/StartupConfigSets
  startup config FaultyReportingApplication: scheduling-policy=SCHEDULING-POLICY-ROUND-ROBIN, scheduling-priority=12, termination-behavior=PROCESS-IS-SELF-TERMINATING, timeout={enter-timeout-value=1.0, exit-timeout-value=0.5}
