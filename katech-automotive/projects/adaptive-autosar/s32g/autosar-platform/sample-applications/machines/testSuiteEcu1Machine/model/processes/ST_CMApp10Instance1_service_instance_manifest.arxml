AUTOSAR XML (schema 00052)
package /apd/Machines/testSuiteEcu1Machine/ServiceInstanceToMachineMappings
  someip service instance to machine mapping CmService5RequiredServiceInstanceToEcu1Machine: communication-connector=CommunicationConnector1, service-instance=ST_CMApp10CMService5RequiredSomeipServiceInstance, udp-port=CmService5ApplicationEndpoint
  someip service instance to machine mapping CMApp10DiagDataIdentifierProvidedServiceInstanceToEcu1Machine: communication-connector=CommunicationConnector1, service-instance=ST_CMApp10DiagDataIdentifierProvidedSomeipServiceInstance, udp-port=CMApp10DiagDataIdentifierApplicationEndpoint
  someip service instance to machine mapping CMApp10DiagRoutineProvidedServiceInstanceToEcu1Machine: communication-connector=CommunicationConnector1, service-instance=ST_CMApp10DiagRoutineProvidedSomeipServiceInstance, udp-port=ST_CMApp10DiagRoutineAplicationEndpoint
package /apd/Machines/testSuiteEcu1Machine/ServiceInstances
  required someip service instance ST_CMApp10CMService5RequiredSomeipServiceInstance: service-interface-deployment=CMService5_Someip, required-service-instance-id=25, sd-client-config=SomeipSdClientServiceInstanceConfig
  provided someip service instance ST_CMApp10DiagDataIdentifierProvidedSomeipServiceInstance: service-interface-deployment=DataIdentifier_Someip, sd-server-config=SomeipSdServerServiceInstanceConfig, service-instance-id=1003
  provided someip service instance ST_CMApp10DiagRoutineProvidedSomeipServiceInstance: service-interface-deployment=RoutineService_Someip, sd-server-config=SomeipSdServerServiceInstanceConfig, service-instance-id=1731
