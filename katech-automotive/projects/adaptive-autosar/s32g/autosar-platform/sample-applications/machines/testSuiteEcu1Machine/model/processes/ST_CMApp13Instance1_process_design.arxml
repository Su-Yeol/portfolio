AUTOSAR XML (schema 00052)
package /apd/Machines/testSuiteEcu1Machine/ProcessDesigns
  process design ST_CMApp13Instance1: executable=ST_CMApp13
