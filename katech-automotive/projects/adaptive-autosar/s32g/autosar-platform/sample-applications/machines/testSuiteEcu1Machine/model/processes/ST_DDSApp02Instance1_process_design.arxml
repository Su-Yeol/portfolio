AUTOSAR XML (schema 00052)
package /apd/Machines/testSuiteEcu1Machine/ProcessDesigns
  process design ST_DDSApp02Instance1: executable=ST_DDSApp02
