AUTOSAR XML (schema 00052)
package /apd/Machines/RadarFusionDDSMachine/ServiceInstanceToMachineMappings
  dds service instance to machine mapping radar_ProvidedServiceInstance_toMachine: communication-connector=RadarFusionDDSConnector, service-instance=Radar_ProvidedDdsServiceInstance
package /apd/Machines/RadarFusionDDSMachine/ServiceInstances
  dds provided service instance Radar_ProvidedDdsServiceInstance: service-interface-deployment=Radar_Dds, qos-profile=default, domain-id=42, dds-event-qos-props{qos-profile=default, event=DdsEventBrakeEvent}, dds-field-qos-props{qos-profile=default, field=UpdateRate_Dds}, service-instance-id=19
    e-2-e-event-protection-propss:
      end 2 end event protection props End2EndEventProtectionProps: data-ids=4321, e-2-e-profile-configuration=PROFILE_01, event=DdsEventBrakeEvent, max-data-length=4096, min-data-length=1
      end 2 end event protection props End2EndEventProtectionProps: data-ids=[4321, 4321], e-2-e-profile-configuration=PROFILE_01, event=DdsEventParkingBrakeEvent, max-data-length=4096, min-data-length=1
