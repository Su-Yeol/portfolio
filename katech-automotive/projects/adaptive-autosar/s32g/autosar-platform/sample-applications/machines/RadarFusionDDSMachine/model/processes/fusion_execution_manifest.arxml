AUTOSAR XML (schema 00052)
package /apd/Machines/RadarFusionDDSMachine/ProcessToMachineMappings
  process to machine mapping set fusion
    process to machine mapping fusion: machine=RadarFusionDDSMachine, process=fusion
package /apd/Machines/RadarFusionDDSMachine/Processes
  process fusion: design=fusion, executable=fusion, state-dependent-startup-config{function-group-state=[MachineFG.Driving, MachineFG.Parking], resource-group=ResourceGroup1, startup-config=FusionStartup}
    process state machine state_machine: type=ProcessStateMachine
package /apd/Machines/RadarFusionDDSMachine/Dlt
  dlt log sink to port prototype mapping FusionDltLogSinkToPortPrototypeMapping: dlt-context=DefaultDltContext, dlt-log-sink=[ConsoleDltSink, RemoteDltSink, FusionFileDltSink], process=fusion
  dlt application to process mapping FusionDltApplicationToProcessMapping: dlt-application=FusionApplication, process=fusion
package /apd/Machines/RadarFusionDDSMachine/ServiceInstanceToPortPrototypeMappings
  service instance to port prototype mapping radar_RequiredServiceInstance_toPort: port-prototype=radar_RPort, process=fusion, service-instance=Radar_RequiredDdsServiceInstance
package /apd/Machines/RadarFusionDDSMachine/StartupConfigSets
  startup config FusionStartup: scheduling-policy=SCHEDULING-POLICY-ROUND-ROBIN, scheduling-priority=12, termination-behavior=PROCESS-IS-NOT-SELF-TERMINATING
