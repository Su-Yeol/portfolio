AUTOSAR XML (schema 00052)
package /apd/Machines/testSuiteEcu1WRSOMEIPMachine/ProcessDesigns
  process design ST_CMApp10Instance1: executable=ST_CMApp10
