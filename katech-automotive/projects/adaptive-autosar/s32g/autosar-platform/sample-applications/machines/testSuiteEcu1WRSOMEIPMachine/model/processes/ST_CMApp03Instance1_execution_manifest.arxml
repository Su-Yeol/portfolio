AUTOSAR XML (schema 00052)
package /apd/Machines/testSuiteEcu1WRSOMEIPMachine/ProcessToMachineMappings
  process to machine mapping set CMApp03ProcessToMachineMapping
    process to machine mapping CMApp03SwcInstance1TotestSuiteEcu1WRSOMEIPMachine: machine=testSuiteEcu1WRSOMEIPMachine, process=ST_CMApp03Instance1
package /apd/Machines/testSuiteEcu1WRSOMEIPMachine/Processes
  process ST_CMApp03Instance1: design=ST_CMApp03Instance1, executable=ST_CMApp03, state-dependent-startup-config{function-group-state=SystemTestFunctionGroup.STS_CM_00001, resource-group=ResourceGroup1, startup-config=ST_CMApp03Startup}
    process state machine state_machine: type=ProcessStateMachine
package /apd/Machines/testSuiteEcu1WRSOMEIPMachine/ServiceInstanceToPortPrototypeMappings
  service instance to port prototype mapping CMApp03CMService1RequiredServiceInstanceToPort: port-prototype=CMApp03Service1Rport, process=ST_CMApp03Instance1, service-instance=ST_CMApp03CMService1RequiredSomeipServiceInstance
  service instance to port prototype mapping DataIdentifierPPortToCMApp03: port-prototype=DataIdentifierPport, process=ST_CMApp03Instance1, service-instance=ST_CMApp03DiagDataIdentifierProvidedSomeipServiceInstance
package /apd/Machines/testSuiteEcu1WRSOMEIPMachine/StartupConfigSets
  startup config ST_CMApp03Startup: environment-variables=[{key=VSOMEIP_CONFIGURATION, value=/opt/CMApp03/etc/vsomeip.json}, {key=DLT_LOG_MODE, value=3}], scheduling-policy=SCHEDULING-POLICY-ROUND-ROBIN, scheduling-priority=12
package /apd/Machines/testSuiteEcu1WRSOMEIPMachine/DltLogChannelToProcessMappings
  dlt application to process mapping ST_CMApp03Instance1DltApplicationToProcessMapping: dlt-application=CMApp03Application, process=ST_CMApp03Instance1
  dlt log sink to port prototype mapping ST_CMApp03Instance1DltLogSinkToPortPrototypeMapping: dlt-context=DefaultDltContext, dlt-log-sink=[CMApp03FileDltSink, ConsoleDltSink, RemoteDltSink], process=ST_CMApp03Instance1
