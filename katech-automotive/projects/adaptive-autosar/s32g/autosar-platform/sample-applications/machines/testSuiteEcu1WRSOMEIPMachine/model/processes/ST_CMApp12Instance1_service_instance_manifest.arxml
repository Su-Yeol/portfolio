AUTOSAR XML (schema 00052)
package /apd/Machines/testSuiteEcu1WRSOMEIPMachine/ServiceInstanceToMachineMappings
  someip service instance to machine mapping CMApp12DiagRoutineProvidedServiceInstanceToEcu1Machine: communication-connector=CommunicationWRSOMEIPConnector1, service-instance=ST_CMApp12DiagRoutineProvidedSomeipServiceInstance, udp-port=ST_CMApp12DiagRoutineApplicationEndpoint
  someip service instance to machine mapping CMService6ProvidedServiceInstanceToEcu1Machine: communication-connector=CommunicationWRSOMEIPConnector1, service-instance=ST_CMService6ProvidedSomeipServiceInstance, udp-port=CmService6ApplicationEndpoint
package /apd/Machines/testSuiteEcu1WRSOMEIPMachine/ServiceInstances
  provided someip service instance ST_CMApp12DiagRoutineProvidedSomeipServiceInstance: service-interface-deployment=RoutineService_Someip, sd-server-config=SomeipSdServerServiceInstanceConfig, service-instance-id=1733
  provided someip service instance ST_CMService6ProvidedSomeipServiceInstance: service-interface-deployment=CMService6_Someip, sd-server-config=SomeipSdServerServiceInstanceConfig, service-instance-id=35
