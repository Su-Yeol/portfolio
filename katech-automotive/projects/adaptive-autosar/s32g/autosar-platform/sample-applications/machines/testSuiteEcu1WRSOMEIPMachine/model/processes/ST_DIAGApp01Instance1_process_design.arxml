AUTOSAR XML (schema 00052)
package /apd/Machines/testSuiteEcu1WRSOMEIPMachine/ProcessDesigns
  process design ST_DIAGApp01Instance1: executable=ST_DIAGApp01
