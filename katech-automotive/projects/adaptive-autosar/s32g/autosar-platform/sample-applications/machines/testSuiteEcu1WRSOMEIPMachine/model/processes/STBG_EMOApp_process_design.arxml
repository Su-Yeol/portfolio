AUTOSAR XML (schema 00052)
package /apd/Machines/testSuiteEcu1WRSOMEIPMachine/ProcessDesigns
  process design STBG_EMOAppSysFGInstance: executable=STBG_EMOAppSysFG
  process design STBG_EMOAppSysFG1Instance: executable=STBG_EMOAppSysFG1
  process design STBG_EMOAppSysFG2Instance: executable=STBG_EMOAppSysFG2
