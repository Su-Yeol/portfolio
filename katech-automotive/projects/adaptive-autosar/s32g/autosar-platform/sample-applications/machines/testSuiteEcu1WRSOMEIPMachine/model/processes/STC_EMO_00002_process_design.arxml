AUTOSAR XML (schema 00052)
package /apd/Machines/testSuiteEcu1WRSOMEIPMachine/ProcessDesigns
  5 x process design:
    STC2_EMOApp{02..06}Instance: executable=STC2_EMOApp{02..06}
