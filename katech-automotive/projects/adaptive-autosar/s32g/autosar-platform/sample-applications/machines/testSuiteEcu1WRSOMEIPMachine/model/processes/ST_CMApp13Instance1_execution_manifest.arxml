AUTOSAR XML (schema 00052)
package /apd/Machines/testSuiteEcu1WRSOMEIPMachine/ProcessToMachineMappings
  process to machine mapping set CMApp13ProcessToMachineMapping
    process to machine mapping CMApp13SwcInstance1TotestSuiteEcu1WRSOMEIPMachine: machine=testSuiteEcu1WRSOMEIPMachine, process=ST_CMApp13Instance1
package /apd/Machines/testSuiteEcu1WRSOMEIPMachine/Processes
  process ST_CMApp13Instance1: design=ST_CMApp13Instance1, executable=ST_CMApp13, state-dependent-startup-config{function-group-state=SystemTestFunctionGroup.STS_CM_00004, resource-group=ResourceGroup1, startup-config=ST_CMApp13Startup}
    process state machine state_machine: type=ProcessStateMachine
package /apd/Machines/testSuiteEcu1WRSOMEIPMachine/ServiceInstanceToPortPrototypeMappings
  service instance to port prototype mapping CMApp13CMService6RequiredServiceInstanceToPort: port-prototype=CMApp13Service6Rport, process=ST_CMApp13Instance1, service-instance=ST_CMApp13CMService6RequiredSomeipServiceInstance
  service instance to port prototype mapping DataIdentifierPPortToCMApp13: port-prototype=DataIdentifierPport, process=ST_CMApp13Instance1, service-instance=ST_CMApp13DiagDataIdentifierProvidedSomeipServiceInstance
  service instance to port prototype mapping DiagRoutinePPortToCMApp13: port-prototype=DiagRoutineServicePport, process=ST_CMApp13Instance1, service-instance=ST_CMApp13DiagRoutineProvidedSomeipServiceInstance
package /apd/Machines/testSuiteEcu1WRSOMEIPMachine/StartupConfigSets
  startup config ST_CMApp13Startup: environment-variables=[{key=VSOMEIP_CONFIGURATION, value=/opt/CMApp13/etc/vsomeip.json}, {key=DLT_LOG_MODE, value=3}], scheduling-policy=SCHEDULING-POLICY-ROUND-ROBIN, scheduling-priority=12
package /apd/Machines/testSuiteEcu1WRSOMEIPMachine/DltLogChannelToProcessMappings
  dlt application to process mapping ST_CMApp13Instance1DltApplicationToProcessMapping: dlt-application=CMApp13Application, process=ST_CMApp13Instance1
  dlt log sink to port prototype mapping ST_CMApp13Instance1DltLogSinkToPortPrototypeMapping: dlt-context=DefaultDltContext, dlt-log-sink=[CMApp13FileDltSink, ConsoleDltSink, RemoteDltSink], process=ST_CMApp13Instance1
