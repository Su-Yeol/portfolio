AUTOSAR XML (schema 00052)
package /apd/Machines/testSuiteEcu1WRSOMEIPMachine/ProcessToMachineMappings
  5 x process to machine mapping set:
    STC2_EMOApp02ProcessToMachineMapping
      process to machine mapping STC2_EMOApp02SwcInstanceTotestSuiteEcu1WRSOMEIPMachine: machine=testSuiteEcu1WRSOMEIPMachine, process=STC2_EMOApp02Instance
    STC2_EMOApp03ProcessToMachineMapping
      process to machine mapping STC2_EMOApp03SwcInstanceTotestSuiteEcu1WRSOMEIPMachine: machine=testSuiteEcu1WRSOMEIPMachine, process=STC2_EMOApp03Instance
    STC2_EMOApp04ProcessToMachineMapping
      process to machine mapping STC2_EMOApp04SwcInstanceTotestSuiteEcu1WRSOMEIPMachine: machine=testSuiteEcu1WRSOMEIPMachine, process=STC2_EMOApp04Instance
    STC2_EMOApp05ProcessToMachineMapping
      process to machine mapping STC2_EMOApp05SwcInstanceTotestSuiteEcu1WRSOMEIPMachine: machine=testSuiteEcu1WRSOMEIPMachine, process=STC2_EMOApp05Instance
    STC2_EMOApp06ProcessToMachineMapping
      process to machine mapping STC2_EMOApp06SwcInstanceTotestSuiteEcu1WRSOMEIPMachine: machine=testSuiteEcu1WRSOMEIPMachine, process=STC2_EMOApp06Instance
package /apd/Machines/testSuiteEcu1WRSOMEIPMachine/Processes
  5 x process:
    STC2_EMOApp02Instance: design=STC2_EMOApp02Instance, executable=STC2_EMOApp02, state-dependent-startup-config{function-group-state=SystemTestFunctionGroup.STC_EMO_00002_Driving, resource-group=ResourceGroup1, startup-config=STC2_EMOApp02Startup}
      process state machine state_machine: type=ProcessStateMachine
    STC2_EMOApp03Instance: design=STC2_EMOApp03Instance, executable=STC2_EMOApp03, state-dependent-startup-config{execution-dependency=state_machine.Running, function-group-state=SystemTestFunctionGroup.STC_EMO_00002_Driving, resource-group=ResourceGroup1, startup-config=STC2_EMOApp03Startup}
      process state machine state_machine: type=ProcessStateMachine
    STC2_EMOApp04Instance: design=STC2_EMOApp04Instance, executable=STC2_EMOApp04, state-dependent-startup-config{execution-dependency=state_machine.Running, function-group-state=SystemTestFunctionGroup.STC_EMO_00002_Driving, resource-group=ResourceGroup1, startup-config=STC2_EMOApp04Startup}
      process state machine state_machine: type=ProcessStateMachine
    STC2_EMOApp05Instance: design=STC2_EMOApp05Instance, executable=STC2_EMOApp05, state-dependent-startup-config{function-group-state=[SystemTestFunctionGroup2.STC_EMO_00002_On, SystemTestFunctionGroup2.STC_EMO_00002_Activate], resource-group=ResourceGroup1, startup-config=STC2_EMOApp05Startup}
      process state machine state_machine: type=ProcessStateMachine
    STC2_EMOApp06Instance: design=STC2_EMOApp06Instance, executable=STC2_EMOApp06, state-dependent-startup-config{function-group-state=SystemTestFunctionGroup2.STC_EMO_00002_Activate, resource-group=ResourceGroup1, startup-config=STC2_EMOApp06Startup}
      process state machine state_machine: type=ProcessStateMachine
package /apd/Machines/testSuiteEcu1WRSOMEIPMachine/StartupConfigSets
  5 x startup config, all with environment-variables=tag-with-optional-value={key=DLT_LOG_MODE, value=3}, scheduling-policy=SCHEDULING-POLICY-ROUND-ROBIN, scheduling-priority=12, termination-behavior=PROCESS-IS-NOT-SELF-TERMINATING:
    STC2_EMOApp{02..06}Startup
package /apd/Machines/testSuiteEcu1WRSOMEIPMachine/DltApplicationToProcessMappings
  5 x dlt application to process mapping:
    STC2_EMOApp{02..06}InstanceDltApplicationToProcessMapping: dlt-application=STC2_EMOApp{02..06}Application, process=STC2_EMOApp{02..06}Instance
  5 x dlt log sink to port prototype mapping, all with dlt-context=DefaultDltContext:
    STC2_EMOApp{02..06}InstanceDltLogSinkToPortPrototypeMapping: dlt-log-sink=[STC2_EMOApp{02..06}FileDltSink, ConsoleDltSink, RemoteDltSink], process=STC2_EMOApp{02..06}Instance
