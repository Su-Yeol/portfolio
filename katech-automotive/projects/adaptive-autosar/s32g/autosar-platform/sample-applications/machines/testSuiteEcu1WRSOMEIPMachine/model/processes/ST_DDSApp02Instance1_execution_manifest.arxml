AUTOSAR XML (schema 00052)
package /apd/Machines/testSuiteEcu1WRSOMEIPMachine/ProcessToMachineMappings
  process to machine mapping set DDSApp02ProcessToMachineMapping
    process to machine mapping DDSApp02SwcInstance1TotestSuiteEcu1WRSOMEIPMachine: machine=testSuiteEcu1WRSOMEIPMachine, process=ST_DDSApp02Instance1
package /apd/Machines/testSuiteEcu1WRSOMEIPMachine/Processes
  process ST_DDSApp02Instance1: design=ST_DDSApp02Instance1, executable=ST_DDSApp02, state-dependent-startup-config{function-group-state=[SystemTestFunctionGroup.STS_DDS_00001, SystemTestFunctionGroup.STS_DDS_00002, SystemTestFunctionGroup.STS_DDS_00003, SystemTestFunctionGroup.STS_DDS_00004], resource-group=ResourceGroup1, startup-config=ST_DDSApp02Startup}
    process state machine state_machine: type=ProcessStateMachine
package /apd/Machines/testSuiteEcu1WRSOMEIPMachine/ServiceInstanceToPortPrototypeMappings
  service instance to port prototype mapping DDSApp02Service1RequiredServiceInstance_toPort: port-prototype=DDSApp02Service1RPort, process=ST_DDSApp02Instance1, service-instance=ST_DDSApp02Service1RequiredDdsServiceInstance
  service instance to port prototype mapping DDSApp02Service3RequiredServiceInstance_toPort: port-prototype=DDSApp02Service3RPort, process=ST_DDSApp02Instance1, service-instance=ST_DDSApp02Service3RequiredDdsServiceInstance
  service instance to port prototype mapping DDSApp02Service4RequiredServiceInstance_toPort: port-prototype=DDSApp02Service4RPort, process=ST_DDSApp02Instance1, service-instance=ST_DDSApp02Service4RequiredDdsServiceInstance
package /apd/Machines/testSuiteEcu1WRSOMEIPMachine/StartupConfigSets
  startup config ST_DDSApp02Startup: environment-variables=[{key=VSOMEIP_CONFIGURATION, value=/opt/DDSApp02/etc/vsomeip.json}, {key=DLT_LOG_MODE, value=3}], scheduling-policy=SCHEDULING-POLICY-ROUND-ROBIN, scheduling-priority=12
package /apd/Machines/testSuiteEcu1WRSOMEIPMachine/DltLogChannelToProcessMappings
  dlt application to process mapping ST_DDSApp02Instance1DltApplicationToProcessMapping: dlt-application=DDSApp02Application, process=ST_DDSApp02Instance1
  dlt log sink to port prototype mapping ST_DDSApp02Instance1DltLogSinkToPortPrototypeMapping: dlt-context=DefaultDltContext, dlt-log-sink=[DDSApp02FileDltSink, ConsoleDltSink, RemoteDltSink], process=ST_DDSApp02Instance1
