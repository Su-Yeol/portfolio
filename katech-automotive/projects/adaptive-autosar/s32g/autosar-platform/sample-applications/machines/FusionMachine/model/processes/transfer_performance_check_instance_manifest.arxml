AUTOSAR XML (schema 00052)
package /apd/Machines/FusionMachine/ServiceInstanceToMachineMappings
  someip service instance to machine mapping RequiredPackageManagementInstanceToMachineMappingTPC: communication-connector=FusionConnector, service-instance=RequiredSomeIpPackageManagementInstanceTPC
package /apd/Machines/FusionMachine/ServiceInstances
  required someip service instance RequiredSomeIpPackageManagementInstanceTPC: service-interface-deployment=PackageManagementSomeIp, required-minor-version=0, required-service-instance-id=813, sd-client-config=SomeipSdClientServiceInstanceConfig
    someip required event group CurrentStatus_required_eventgroup: event-group=CurrentStatus_eventgroup
