AUTOSAR XML (schema 00052)
package /apd/Machines/FusionMachine/ProcessToMachineMappings
  process to machine mapping set TlvDemoReceiver
    process to machine mapping TlvDemoReceiver: machine=FusionMachine, process=TlvDemoReceiver
package /apd/Machines/FusionMachine/Dlt
  dlt application to process mapping TlvDemoReceiverDltApplicationToProcessMapping: dlt-application=TlvDemoReceiverApplication, process=TlvDemoReceiver
  dlt log sink to port prototype mapping TlvDemoReceiverDltLogSinkToPortPrototypeMapping: dlt-context=DefaultDltContext, dlt-log-sink=[ConsoleDltSink, RemoteDltSink, TlvDemoReceiverFileDltSink], process=TlvDemoReceiver
package /apd/Machines/FusionMachine/Processes
  process TlvDemoReceiver: design=TlvDemoReceiver, executable=TlvDemoReceiver, state-dependent-startup-config{function-group-state=MachineFG.Driving, resource-group=ResourceGroup1, startup-config=TlvDemoReceiverStartup}
    process state machine state_machine: type=ProcessStateMachine
package /apd/Machines/FusionMachine/ServiceInstanceToPortPrototypeMappings
  service instance to port prototype mapping tlv_RequiredServiceInstance_toPort: port-prototype=tlv_RPort, process=TlvDemoReceiver, service-instance=TlvRequiredSomeipServiceInstance
package /apd/Machines/FusionMachine/StartupConfigSets
  startup config TlvDemoReceiverStartup: environment-variables=tag-with-optional-value={key=VSOMEIP_CONFIGURATION, value=/etc/vsomeip.json}, scheduling-policy=SCHEDULING-POLICY-ROUND-ROBIN, scheduling-priority=12, termination-behavior=PROCESS-IS-NOT-SELF-TERMINATING
