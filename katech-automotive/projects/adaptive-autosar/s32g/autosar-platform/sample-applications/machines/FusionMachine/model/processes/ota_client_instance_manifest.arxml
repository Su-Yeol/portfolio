AUTOSAR XML (schema 00052)
package /apd/Machines/FusionMachine/ServiceInstanceToMachineMappings
  someip service instance to machine mapping RequiredVehPackageManagementInstanceToMachineMapping: communication-connector=FusionConnector, service-instance=RequiredSomeIpVehiclePackageManagementInstance
package /apd/Machines/FusionMachine/ServiceInstances
  required someip service instance RequiredSomeIpVehiclePackageManagementInstance: service-interface-deployment=VehiclePackageManagementSomeIp, required-minor-version=0, required-service-instance-id=909, sd-client-config=SomeipSdClientServiceInstanceConfig
    someip required event group RequestedPackage_required_eventgroup: event-group=RequestedPackage_eventgroup
    someip required event group VehicleConditionCollection_required_eventgroup: event-group=VehicleConditionCollection_eventgroup
    someip required event group TransferState_required_eventgroup: event-group=TransferState_eventgroup
