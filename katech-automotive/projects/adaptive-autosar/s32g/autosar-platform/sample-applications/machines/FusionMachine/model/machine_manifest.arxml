AUTOSAR XML (schema 00052)
package /apd/Machines/FusionMachine
  machine FusionMachine: default-application-timeout=exit-timeout-value=0.1, environment-variables=tag-with-optional-value={key=DLT_LOG_MODE, value=3}, machine-design=FusionMachineDesign
    module-instantiations:
      log and trace instantiation LogAndTraceInstanciation: log-sink=ConsoleDltSink
      os module instantiation Linux
        6 x resource group:
          ResourceGroup1: cpu-usage=95, mem-usage=2000000000
          ResourceGroup2: cpu-usage=95, mem-usage=2000000000
          ResourceGroupDB: cpu-usage=80, mem-usage=500000000
          ResourceGroupDIAG: cpu-usage=80, mem-usage=500000000
          ResourceGroupIAM: cpu-usage=80, mem-usage=500000000
          ResourceGroupSM: cpu-usage=80, mem-usage=500000000
      ucm subordinate module instantiation UcmInstance: identifier=FusionMachineUCM
package /apd/Machines/FusionMachine/E2E
  e 2 e profile configuration set e2eprofiles
    e 2 e profile configuration PROFILE_01: max-delta-counter=1, max-error-state-init=0, max-error-state-invalid=0, max-error-state-valid=0, min-ok-state-init=1, min-ok-state-invalid=1, min-ok-state-valid=1, profile-name=PROFILE_01, window-size-init=1, window-size-invalid=1, window-size-valid=1
package /apd/Machines/FusionMachine/Dlt
  dlt ecu FusionMachineDltEcu
    16 x dlt application, all with contexts=DefaultDltContext:
      FusionLogApplication: application-description=example app. fusion, application-id=EXFU
      ara_tsync_daemon_LogApplication: application-description=Time Sync Daemon Platform Application, application-id=TSYD
      TimeSyncConsumerLogApplication: application-description=Time Sync Consumer Application, application-id=TSYC
      TlvDemoReceiverApplication: application-description=TLV Demo Receiver Application, application-id=TSYC
      StateManagerLogApplication: application-description=State Manager, application-id=STMR
      EmoSampleApplication: application-description=Emo Sample Application, application-id=EMAP
      shmMasterLogApplication: application-description=shm Master Sample Application, application-id=SHMS
      FlashingAdapterApplication: application-description=Flashing Adapter, application-id=FLAD
      VehicleStateManagerIfApplication: application-description=example app. vehicle state manager interface, application-id=VSMI
      OtaClientApplication: application-description=example app. ota, application-id=EXOTA
      PkgmgrApplication: application-description=UCM SAMPLE, application-id=UCMS
      PackageManager: application-description=UCM, application-id=UCM
      VehiclePackageManager: application-description=UCMM, application-id=UCM Master
      UpdatableApplication: application-description=Updatable App, application-id=UAPP
      TransferPerformanceCheckApplication: application-description=Transfer Performance Test, application-id=EXTPT
      Controller: application-description=example app. picar controller, application-id=PIC
  dlt log sink ConsoleDltSink: category=DLT_LOGSINK_CONSOLE, buffer-output=true, default-log-threshold=VERBOSE
package /apd/Machines/FusionMachine/FunctionGroupSets
  function group set FusionFunctionGroups
    function-groups:
      4 x mode declaration group prototype:
        MachineFG: type=MachineState
        Lane_Change_Assistance: type=Lane_Change_Assistance
        Pedestrian_Protection: type=Pedestrian_Protection
        UpdatableApplicationFG: type=UpdatableApplicationFG
package /apd/Machines/FusionMachine/SoftwareClusters
  software cluster FusionCoreCluster:
    category=PLATFORM_CORE
    claimed-function-group=[MachineFG, Lane_Change_Assistance, Pedestrian_Protection, FusionFunctionGroups/UpdatableApplicationFG, DevelopmentFunctionGroups/UpdatableApplicationFG]
    contained-process=[ara_tsync_daemon, controller, EmoSampleApplication, flashing_adapter, fusion, ota_client, PersistencyDemo, PersistencyRedundancyDemo, StateManager, TimeSyncConsumer, shmMaster, transfer_performance_check, UpdatableApp, vehicle_state_manager_application]
    module-instantiation=Linux
package /ara/apd/function_group_modes
  mode declaration group UpdatableApplicationFG: initial-mode=Off
    mode Off
    mode Running
    mode Verify
package /ara/apd/function_group_sets
  function group set DevelopmentFunctionGroups
    function-groups:
      mode declaration group prototype UpdatableApplicationFG: type=UpdatableApplicationFG
