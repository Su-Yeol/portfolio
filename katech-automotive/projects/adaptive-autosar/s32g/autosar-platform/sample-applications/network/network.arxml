AUTOSAR XML (schema 00052)
package /apd/CommunicationClusters
  ethernet cluster APDNet
    ethernet physical channel APDChannel
      comm-connectors:
        FusionConnector
        RadarFusionDDSConnector
        RadarFusionConnector
        RadarFusionWRSOMEIPConnector
        RadarConnector
        shmConnector
        testSuiteEcu1MachineDesign/CommunicationConnector1
        testSuiteEcu1WRSOMEIPMachineDesign/CommunicationWRSOMEIPConnector1
        testSuiteEcu2MachineDesign/CommunicationConnector1
        testSuiteEcu2WRSOMEIPMachineDesign/CommunicationWRSOMEIPConnector1
        AdaptiveMachineDesign/AdaptiveMachineConnector
      12 x network endpoint:
        Ecu1Network1Endpoint: network-endpoint-addresses=ipv-4-configuration={default-gateway=192.168.7.1, ipv-4-address=192.168.7.12, network-mask=255.255.255.0}
        Ecu1WRSOMEIPNetwork1Endpoint: network-endpoint-addresses=ipv-4-configuration={default-gateway=192.168.7.1, ipv-4-address=192.168.7.12, network-mask=255.255.255.0}
        Ecu2Network1Endpoint: network-endpoint-addresses=ipv-4-configuration={default-gateway=192.168.7.1, ipv-4-address=192.168.7.14, network-mask=255.255.255.0}
        Ecu2WRSOMEIPNetwork1Endpoint: network-endpoint-addresses=ipv-4-configuration={default-gateway=192.168.7.1, ipv-4-address=192.168.7.14, network-mask=255.255.255.0}
        FusionMachineEndpoint: network-endpoint-addresses=ipv-4-configuration={default-gateway=192.168.7.1, ipv-4-address=192.168.7.4, network-mask=255.255.255.0}
        RadarFusionDDSMachineEndpoint: network-endpoint-addresses=ipv-4-configuration={default-gateway=192.168.7.1, ipv-4-address=192.168.7.2, network-mask=255.255.255.0}
        RadarFusionMachineEndpoint: network-endpoint-addresses=ipv-4-configuration={default-gateway=192.168.7.1, ipv-4-address=192.168.7.2, network-mask=255.255.255.0}
        RadarFusionWRSOMEIPMachineEndpoint: network-endpoint-addresses=ipv-4-configuration={default-gateway=192.168.7.1, ipv-4-address=192.168.7.2, network-mask=255.255.255.0}
        RadarMachineEndpoint: network-endpoint-addresses=ipv-4-configuration={default-gateway=192.168.7.1, ipv-4-address=192.168.7.2, network-mask=255.255.255.0}
        SDNetworkEndpoint: network-endpoint-addresses=ipv-4-configuration=ipv-4-address=224.244.224.245
        shmMachineEndpoint: network-endpoint-addresses=ipv-4-configuration={default-gateway=192.168.7.1, ipv-4-address=192.168.7.16, network-mask=255.255.255.0}
        AdaptiveMachineEndpoint: network-endpoint-addresses=ipv-4-configuration={default-gateway=192.168.7.1, ipv-4-address=192.168.7.2, network-mask=255.255.255.0}
package /apd/MachineDesigns
  11 x machine design:
    FusionMachineDesign: service-discovery-configs=someip-service-discovery={multicast-sd-ip-address=APDChannel/SDNetworkEndpoint, someip-service-discovery-port=30490}
      ethernet communication connector FusionConnector: unicast-network-endpoint=FusionMachineEndpoint
        8 x ap application endpoint:
          PackageManagementApplicationEndpoint: tp-configuration=tcp-tp=tcp-tp-port=port-number=5001
          FlashingAdapterApplicationEndpoint: tp-configuration=tcp-tp=tcp-tp-port=port-number=5003
          RadarApplicationEndpoint: tp-configuration=udp-tp=udp-tp-port=port-number=33111
          RoutineServiceApplicationEndpoint: tp-configuration=udp-tp=udp-tp-port=port-number=5001
          StateMachineServiceApplicationEndpoint: tp-configuration=tcp-tp=tcp-tp-port=port-number=5007
          TriggerApplicationEndpoint: tp-configuration=udp-tp=udp-tp-port=port-number=33111
          UpdateAllowedServiceApplicationEndpoint: tp-configuration=tcp-tp=tcp-tp-port=port-number=5006
          UpdateRequestApplicationEndpoint: tp-configuration=tcp-tp=tcp-tp-port=port-number=5000
      ethernet communication connector healthInfoConnector: unicast-network-endpoint=FusionMachineEndpoint
        ap application endpoint shmMasterApplicationEndpoint: tp-configuration=udp-tp=udp-tp-port=port-number=33121
        ap application endpoint TriggerApplicationEndpoint: tp-configuration=udp-tp=udp-tp-port=port-number=33121
        ap application endpoint UpdateRequestApplicationEndpoint: tp-configuration=udp-tp=udp-tp-port=port-number=5000
      ethernet communication connector healthIndicatorConnector: unicast-network-endpoint=FusionMachineEndpoint
        ap application endpoint shmMasterApplicationEndpoint: tp-configuration=udp-tp=udp-tp-port=port-number=33122
        ap application endpoint TriggerApplicationEndpoint: tp-configuration=udp-tp=udp-tp-port=port-number=33122
        ap application endpoint UpdateRequestApplicationEndpoint: tp-configuration=udp-tp=udp-tp-port=port-number=5000
    RadarFusionDDSMachineDesign: service-discovery-configs=someip-service-discovery={multicast-sd-ip-address=APDChannel/SDNetworkEndpoint, someip-service-discovery-port=30490}
      ethernet communication connector RadarFusionDDSConnector: unicast-network-endpoint=RadarFusionDDSMachineEndpoint
        4 x ap application endpoint:
          StateMachineServiceApplicationEndpoint: tp-configuration=tcp-tp=tcp-tp-port=port-number=5007
          TriggerApplicationEndpoint: tp-configuration=udp-tp=udp-tp-port=port-number=33111
          UpdateAllowedServiceApplicationEndpoint: tp-configuration=tcp-tp=tcp-tp-port=port-number=5006
          UpdateRequestApplicationEndpoint: tp-configuration=udp-tp=udp-tp-port=port-number=5000
    RadarFusionMachineDesign: service-discovery-configs=someip-service-discovery={multicast-sd-ip-address=APDChannel/SDNetworkEndpoint, someip-service-discovery-port=30490}
      ethernet communication connector RadarFusionConnector: unicast-network-endpoint=RadarFusionMachineEndpoint
        13 x ap application endpoint:
          PackageManagementTCPApplicationEndpoint: tp-configuration=tcp-tp=tcp-tp-port=port-number=5001
          PackageManagementApplicationEndpoint: tp-configuration=tcp-tp=tcp-tp-port=port-number=5001
          FlashingAdapterApplicationEndpoint: tp-configuration=tcp-tp=tcp-tp-port=port-number=5003
          UpdateAdapterAglApplicationEndpoint: tp-configuration=tcp-tp=tcp-tp-port=port-number=5004
          UpdateAdapterAndroidApplicationEndpoint: tp-configuration=tcp-tp=tcp-tp-port=port-number=5005
          RoutineServiceApplicationEndpoint: tp-configuration=udp-tp=udp-tp-port=port-number=5000
          StateMachineServiceApplicationEndpoint: tp-configuration=tcp-tp=tcp-tp-port=port-number=5007
          TriggerApplicationEndpoint: tp-configuration=udp-tp=udp-tp-port=port-number=33111
          TriggerApplicationEndpointExtended: tp-configuration=udp-tp=udp-tp-port=port-number=33112
          UpdateAllowedServiceApplicationEndpoint: tp-configuration=tcp-tp=tcp-tp-port=port-number=5006
          UpdateRequestApplicationEndpoint: tp-configuration=tcp-tp=tcp-tp-port=port-number=5000
          VehiclePackageManagementApplicationEndpoint: tp-configuration=tcp-tp=tcp-tp-port=port-number=5002
          PicarApplicationEndpoint: tp-configuration=udp-tp=udp-tp-port=port-number=31415
    RadarFusionWRSOMEIPMachineDesign: service-discovery-configs=someip-service-discovery={multicast-sd-ip-address=APDChannel/SDNetworkEndpoint, someip-service-discovery-port=30490}
      ethernet communication connector RadarFusionWRSOMEIPConnector: unicast-network-endpoint=RadarFusionWRSOMEIPMachineEndpoint
        8 x ap application endpoint:
          PackageManagementApplicationEndpoint: tp-configuration=tcp-tp=tcp-tp-port=port-number=5001
          StateMachineServiceApplicationEndpoint: tp-configuration=tcp-tp=tcp-tp-port=port-number=5007
          TriggerApplicationEndpoint: tp-configuration=udp-tp=udp-tp-port=port-number=33111
          TriggerApplicationEndpointExtended: tp-configuration=udp-tp=udp-tp-port=port-number=33112
          UpdateAllowedServiceApplicationEndpoint: tp-configuration=tcp-tp=tcp-tp-port=port-number=5006
          UpdateRequestApplicationEndpoint: tp-configuration=tcp-tp=tcp-tp-port=port-number=5000
          UpdateAdapterAglApplicationEndpoint: tp-configuration=tcp-tp=tcp-tp-port=port-number=5004
          UpdateAdapterAndroidApplicationEndpoint: tp-configuration=tcp-tp=tcp-tp-port=port-number=5005
    RadarMachineDesign: service-discovery-configs=someip-service-discovery={multicast-sd-ip-address=APDChannel/SDNetworkEndpoint, someip-service-discovery-port=30490}
      ethernet communication connector RadarConnector: unicast-network-endpoint=RadarMachineEndpoint
        10 x ap application endpoint:
          PackageManagementApplicationEndpoint: tp-configuration=tcp-tp=tcp-tp-port=port-number=5001
          PicarApplicationEndpoint: tp-configuration=udp-tp=udp-tp-port=port-number=31415
          RoutineServiceApplicationEndpoint: tp-configuration=udp-tp=udp-tp-port=port-number=5001
          StateMachineServiceApplicationEndpoint: tp-configuration=tcp-tp=tcp-tp-port=port-number=5007
          TriggerApplicationEndpoint: tp-configuration=udp-tp=udp-tp-port=port-number=33111
          UpdateAllowedServiceApplicationEndpoint: tp-configuration=tcp-tp=tcp-tp-port=port-number=5006
          UpdateRequestApplicationEndpoint: tp-configuration=tcp-tp=tcp-tp-port=port-number=5000
          VehiclePackageManagementApplicationEndpoint: tp-configuration=tcp-tp=tcp-tp-port=port-number=5002
          UpdateAdapterAglApplicationEndpoint: tp-configuration=tcp-tp=tcp-tp-port=port-number=5004
          UpdateAdapterAndroidApplicationEndpoint: tp-configuration=tcp-tp=tcp-tp-port=port-number=5005
      ethernet communication connector shmConnector: unicast-network-endpoint=RadarMachineEndpoint
        4 x ap application endpoint:
          StateMachineServiceApplicationEndpoint: tp-configuration=tcp-tp=tcp-tp-port=port-number=5007
          TriggerApplicationEndpoint: tp-configuration=udp-tp=udp-tp-port=port-number=33121
          UpdateAllowedServiceApplicationEndpoint: tp-configuration=tcp-tp=tcp-tp-port=port-number=5006
          HealthInfoApplicationEndpoint: tp-configuration=udp-tp=udp-tp-port=port-number=5000
    testSuiteEcu1MachineDesign: service-discovery-configs=someip-service-discovery={multicast-sd-ip-address=APDChannel/SDNetworkEndpoint, someip-service-discovery-port=30491}
      ethernet communication connector CommunicationConnector1: unicast-network-endpoint=Ecu1Network1Endpoint
        21 x ap application endpoint:
          PackageManagementApplicationEndpoint: tp-configuration=tcp-tp=tcp-tp-port=port-number=5001
          CMApp03DiagRoutineApplicationEndpoint: tp-configuration=udp-tp=udp-tp-port=port-number=3909
          ST_CMApp10DiagRoutineAplicationEndpoint: tp-configuration=udp-tp=udp-tp-port=port-number=3911
          ST_CMApp12DiagRoutineAplicationEndpoint: tp-configuration=udp-tp=udp-tp-port=port-number=3912
          ST_CMApp13DiagRoutineAplicationEndpoint: tp-configuration=udp-tp=udp-tp-port=port-number=3913
          ST_CMApp12DiagRoutineAplicationEndpoint: tp-configuration=udp-tp=udp-tp-port=port-number=3912
          ST_CMApp13DiagRoutineAplicationEndpoint: tp-configuration=udp-tp=udp-tp-port=port-number=3913
          CMApp03DiagDataIdentifierApplicationEndpoint: tp-configuration=udp-tp=udp-tp-port=port-number=3910
          CmService1ApplicationEndpoint: tp-configuration=udp-tp=udp-tp-port=port-number=5000
          CmService2ApplicationEndpoint: tp-configuration=udp-tp=udp-tp-port=port-number=5001
          CmService5ApplicationEndpoint: tp-configuration=udp-tp=udp-tp-port=port-number=5004
          CmService6ApplicationEndpoint: tp-configuration=udp-tp=udp-tp-port=port-number=5005
          CMApp10DiagDataIdentifierApplicationEndpoint: tp-configuration=udp-tp=udp-tp-port=port-number=3930
          CMApp12DiagDataIdentifierApplicationEndpoint: tp-configuration=udp-tp=udp-tp-port=port-number=3931
          CMApp13DiagDataIdentifierApplicationEndpoint: tp-configuration=udp-tp=udp-tp-port=port-number=3932
          ST_CMApp01DiagRoutineAplicationEndpoint: tp-configuration=udp-tp=udp-tp-port=port-number=3901
          ST_DIAGApp01DiagDataServiceApplicationEndpoint: tp-configuration=udp-tp=udp-tp-port=port-number=3961
          StateMachineServiceApplicationEndpoint: tp-configuration=tcp-tp=tcp-tp-port=port-number=5007
          TriggerApplicationEndpoint: tp-configuration=udp-tp=udp-tp-port=port-number=33111
          UpdateAllowedServiceApplicationEndpoint: tp-configuration=tcp-tp=tcp-tp-port=port-number=5006
          UpdateRequestApplicationEndpoint: tp-configuration=tcp-tp=tcp-tp-port=port-number=5000
    testSuiteEcu1WRSOMEIPMachineDesign: service-discovery-configs=someip-service-discovery={multicast-sd-ip-address=APDChannel/SDNetworkEndpoint, someip-service-discovery-port=30491}
      ethernet communication connector CommunicationWRSOMEIPConnector1: unicast-network-endpoint=Ecu1WRSOMEIPNetwork1Endpoint
        19 x ap application endpoint:
          PackageManagementApplicationEndpoint: tp-configuration=tcp-tp=tcp-tp-port=port-number=5001
          CMApp03DiagRoutineApplicationEndpoint: tp-configuration=udp-tp=udp-tp-port=port-number=3909
          ST_CMApp10DiagRoutineApplicationEndpoint: tp-configuration=udp-tp=udp-tp-port=port-number=3911
          ST_CMApp12DiagRoutineApplicationEndpoint: tp-configuration=udp-tp=udp-tp-port=port-number=3912
          ST_CMApp13DiagRoutineApplicationEndpoint: tp-configuration=udp-tp=udp-tp-port=port-number=3913
          CMApp03DiagDataIdentifierApplicationEndpoint: tp-configuration=udp-tp=udp-tp-port=port-number=3910
          CmService1ApplicationEndpoint: tp-configuration=udp-tp=udp-tp-port=port-number=5000
          CmService2ApplicationEndpoint: tp-configuration=udp-tp=udp-tp-port=port-number=5001
          CmService5ApplicationEndpoint: tp-configuration=udp-tp=udp-tp-port=port-number=5004
          CmService6ApplicationEndpoint: tp-configuration=udp-tp=udp-tp-port=port-number=5005
          CMApp10DiagDataIdentifierApplicationEndpoint: tp-configuration=udp-tp=udp-tp-port=port-number=3930
          CMApp12DiagDataIdentifierApplicationEndpoint: tp-configuration=udp-tp=udp-tp-port=port-number=3931
          CMApp13DiagDataIdentifierApplicationEndpoint: tp-configuration=udp-tp=udp-tp-port=port-number=3932
          ST_CMApp01DiagRoutineApplicationEndpoint: tp-configuration=udp-tp=udp-tp-port=port-number=3901
          ST_DIAGApp01DiagDataServiceApplicationEndpoint: tp-configuration=udp-tp=udp-tp-port=port-number=3961
          StateMachineServiceApplicationEndpoint: tp-configuration=tcp-tp=tcp-tp-port=port-number=5007
          TriggerApplicationEndpoint: tp-configuration=udp-tp=udp-tp-port=port-number=33111
          UpdateAllowedServiceApplicationEndpoint: tp-configuration=tcp-tp=tcp-tp-port=port-number=5006
          UpdateRequestApplicationEndpoint: tp-configuration=tcp-tp=tcp-tp-port=port-number=5000
    testSuiteEcu2MachineDesign: service-discovery-configs=someip-service-discovery={multicast-sd-ip-address=APDChannel/SDNetworkEndpoint, someip-service-discovery-port=30491}
      ethernet communication connector CommunicationConnector1: unicast-network-endpoint=Ecu2Network1Endpoint
        14 x ap application endpoint:
          ST_CMApp02DiagRoutineApplicationEndpoint: tp-configuration=udp-tp=udp-tp-port=port-number=3909
          ST_CMApp09DiagRoutineAplicationEndpoint: tp-configuration=udp-tp=udp-tp-port=port-number=3903
          ST_CMApp11DiagRoutineAplicationEndpoint: tp-configuration=udp-tp=udp-tp-port=port-number=3904
          ST_CMApp14DiagRoutineAplicationEndpoint: tp-configuration=udp-tp=udp-tp-port=port-number=3905
          CMApp02DiagDataIdentifierApplicationEndpoint: tp-configuration=udp-tp=udp-tp-port=port-number=3911
          ST_CMApp02CMService1ApplicationEndpoint: tp-configuration=udp-tp=udp-tp-port=port-number=5000
          ST_CMApp02CMService2ApplicationEndpoint: tp-configuration=udp-tp=udp-tp-port=port-number=5001
          CMService5ApplicationEndpoint: tp-configuration=udp-tp=udp-tp-port=port-number=5004
          CMApp11DiagDataIdentifierApplicationEndpoint: tp-configuration=udp-tp=udp-tp-port=port-number=3931
          CMApp14DiagDataIdentifierApplicationEndpoint: tp-configuration=udp-tp=udp-tp-port=port-number=3932
          CMService6ApplicationEndpoint: tp-configuration=udp-tp=udp-tp-port=port-number=5005
          StateMachineServiceApplicationEndpoint: tp-configuration=tcp-tp=tcp-tp-port=port-number=5007
          TriggerApplicationEndpoint: tp-configuration=udp-tp=udp-tp-port=port-number=33111
          UpdateAllowedServiceApplicationEndpoint: tp-configuration=tcp-tp=tcp-tp-port=port-number=5006
    testSuiteEcu2WRSOMEIPMachineDesign: service-discovery-configs=someip-service-discovery={multicast-sd-ip-address=APDChannel/SDNetworkEndpoint, someip-service-discovery-port=30491}
      ethernet communication connector CommunicationWRSOMEIPConnector1: unicast-network-endpoint=Ecu2WRSOMEIPNetwork1Endpoint
        14 x ap application endpoint:
          ST_CMApp02DiagRoutineApplicationEndpoint: tp-configuration=udp-tp=udp-tp-port=port-number=3909
          ST_CMApp09DiagRoutineApplicationEndpoint: tp-configuration=udp-tp=udp-tp-port=port-number=3903
          ST_CMApp11DiagRoutineApplicationEndpoint: tp-configuration=udp-tp=udp-tp-port=port-number=3904
          ST_CMApp14DiagRoutineApplicationEndpoint: tp-configuration=udp-tp=udp-tp-port=port-number=3905
          CMApp02DiagDataIdentifierApplicationEndpoint: tp-configuration=udp-tp=udp-tp-port=port-number=3911
          ST_CMApp02CMService1ApplicationEndpoint: tp-configuration=udp-tp=udp-tp-port=port-number=5000
          ST_CMApp02CMService2ApplicationEndpoint: tp-configuration=udp-tp=udp-tp-port=port-number=5001
          CMService5ApplicationEndpoint: tp-configuration=udp-tp=udp-tp-port=port-number=5004
          CMApp11DiagDataIdentifierApplicationEndpoint: tp-configuration=udp-tp=udp-tp-port=port-number=3931
          CMApp14DiagDataIdentifierApplicationEndpoint: tp-configuration=udp-tp=udp-tp-port=port-number=3932
          CMService6ApplicationEndpoint: tp-configuration=udp-tp=udp-tp-port=port-number=5005
          StateMachineServiceApplicationEndpoint: tp-configuration=tcp-tp=tcp-tp-port=port-number=5007
          TriggerApplicationEndpoint: tp-configuration=udp-tp=udp-tp-port=port-number=33111
          UpdateAllowedServiceApplicationEndpoint: tp-configuration=tcp-tp=tcp-tp-port=port-number=5006
    shmMachineDesign: service-discovery-configs=someip-service-discovery={multicast-sd-ip-address=APDChannel/SDNetworkEndpoint, someip-service-discovery-port=30492}
      ethernet communication connector shmClient2Connector: unicast-network-endpoint=shmMachineEndpoint
        4 x ap application endpoint:
          StateMachineServiceApplicationEndpoint: tp-configuration=tcp-tp=tcp-tp-port=port-number=5007
          TriggerApplicationEndpoint: tp-configuration=udp-tp=udp-tp-port=port-number=33122
          UpdateAllowedServiceApplicationEndpoint: tp-configuration=tcp-tp=tcp-tp-port=port-number=5006
          shmApplicationEndpoint: tp-configuration=udp-tp=udp-tp-port=port-number=5000
    AdaptiveMachineDesign: service-discovery-configs=someip-service-discovery={multicast-sd-ip-address=APDChannel/SDNetworkEndpoint, someip-service-discovery-port=30490}
      ethernet communication connector AdaptiveMachineConnector: unicast-network-endpoint=APDChannel/AdaptiveMachineEndpoint
        65 x ap application endpoint:
          CanDataProviderEndpoint: tp-configuration=udp-tp=udp-tp-port=port-number=30101
          CanDataSubscriberEndpoint: tp-configuration=udp-tp=udp-tp-port=port-number=30102
          CanDataEtcProviderEndpoint: tp-configuration=udp-tp=udp-tp-port=port-number=30201
          CanDataEtcSubscriberEndpoint: tp-configuration=udp-tp=udp-tp-port=port-number=30202
          ConnectivityInfoProviderEndpoint: tp-configuration=udp-tp=udp-tp-port=port-number=30401
          ConnectivityInfoSubscriberEndpoint: tp-configuration=udp-tp=udp-tp-port=port-number=30402
          DrivingTrajectoryProviderEndpoint: tp-configuration=udp-tp=udp-tp-port=port-number=30501
          DrivingTrajectorySubscriberEndpoint: tp-configuration=udp-tp=udp-tp-port=port-number=30502
          EmergencyBrakingProviderEndpoint: tp-configuration=udp-tp=udp-tp-port=port-number=30601
          EmergencyBrakingSubscriberEndpoint: tp-configuration=udp-tp=udp-tp-port=port-number=30602
          LaneDetectionProviderEndpoint: tp-configuration=udp-tp=udp-tp-port=port-number=30701
          LaneDetectionSubscriberEndpoint: tp-configuration=udp-tp=udp-tp-port=port-number=30702
          LocalMapProviderEndpoint: tp-configuration=udp-tp=udp-tp-port=port-number=30801
          LocalMapSubscriberEndpoint: tp-configuration=udp-tp=udp-tp-port=port-number=30802
          MatchingInfoProviderEndpoint: tp-configuration=udp-tp=udp-tp-port=port-number=30901
          MatchingInfoSubscriberEndpoint: tp-configuration=udp-tp=udp-tp-port=port-number=30902
          PerceptionObstaclesProviderEndpoint: tp-configuration=udp-tp=udp-tp-port=port-number=31001
          PerceptionObstaclesSubscriberEndpoint: tp-configuration=udp-tp=udp-tp-port=port-number=31002
          PointMapProviderEndpoint: tp-configuration=udp-tp=udp-tp-port=port-number=31101
          PointMapSubscriberEndpoint: tp-configuration=udp-tp=udp-tp-port=port-number=31102
          ReportFaultProviderEndpoint: tp-configuration=udp-tp=udp-tp-port=port-number=31201
          ReportFaultSubscriberEndpoint: tp-configuration=udp-tp=udp-tp-port=port-number=31202
          RoutingPathProviderEndpoint: tp-configuration=udp-tp=udp-tp-port=port-number=31301
          RoutingPathSubscriberEndpoint: tp-configuration=udp-tp=udp-tp-port=port-number=31302
          RoutingResultProviderEndpoint: tp-configuration=udp-tp=udp-tp-port=port-number=31401
          RoutingResultSubscriberEndpoint: tp-configuration=udp-tp=udp-tp-port=port-number=31402
          RoutingSearchProviderEndpoint: tp-configuration=udp-tp=udp-tp-port=port-number=31501
          RoutingSearchSubscriberEndpoint: tp-configuration=udp-tp=udp-tp-port=port-number=31502
          SemanticMapProviderEndpoint: tp-configuration=udp-tp=udp-tp-port=port-number=31601
          SemanticMapSubscriberEndpoint: tp-configuration=udp-tp=udp-tp-port=port-number=31602
          TrafficLightProviderEndpoint: tp-configuration=udp-tp=udp-tp-port=port-number=31701
          TrafficLightSubscriberEndpoint: tp-configuration=udp-tp=udp-tp-port=port-number=31702
          V2XProviderEndpoint: tp-configuration=udp-tp=udp-tp-port=port-number=31801
          V2XSubscriberEndpoint: tp-configuration=udp-tp=udp-tp-port=port-number=31802
          VehicleLocationProviderEndpoint: tp-configuration=udp-tp=udp-tp-port=port-number=31901
          VehicleLocationSubscriberEndpoint: tp-configuration=udp-tp=udp-tp-port=port-number=31902
          CollectFaultControlProviderEndpoint: tp-configuration=udp-tp=udp-tp-port=port-number=32001
          CollectFaultControlSubscriberEndpoint: tp-configuration=udp-tp=udp-tp-port=port-number=32002
          CollectFaultHdmapProviderEndpoint: tp-configuration=udp-tp=udp-tp-port=port-number=32101
          CollectFaultHdmapSubscriberEndpoint: tp-configuration=udp-tp=udp-tp-port=port-number=32102
          CollectFaultHmiProviderEndpoint: tp-configuration=udp-tp=udp-tp-port=port-number=32201
          CollectFaultHmiSubscriberEndpoint: tp-configuration=udp-tp=udp-tp-port=port-number=32202
          CollectFaultLocalizationProviderEndpoint: tp-configuration=udp-tp=udp-tp-port=port-number=32301
          CollectFaultLocalizationSubscriberEndpoint: tp-configuration=udp-tp=udp-tp-port=port-number=32302
          CollectFaultPerceptionCameraProviderEndpoint: tp-configuration=udp-tp=udp-tp-port=port-number=32401
          CollectFaultPerceptionCameraSubscriberEndpoint: tp-configuration=udp-tp=udp-tp-port=port-number=32402
          CollectFaultPerceptionLidarProviderEndpoint: tp-configuration=udp-tp=udp-tp-port=port-number=32501
          CollectFaultPerceptionLidarSubscriberEndpoint: tp-configuration=udp-tp=udp-tp-port=port-number=32502
          CollectFaultPlanningProviderEndpoint: tp-configuration=udp-tp=udp-tp-port=port-number=32601
          CollectFaultPlanningSubscriberEndpoint: tp-configuration=udp-tp=udp-tp-port=port-number=32602
          CollectFaultRoutingProviderEndpoint: tp-configuration=udp-tp=udp-tp-port=port-number=32701
          CollectFaultRoutingSubscriberEndpoint: tp-configuration=udp-tp=udp-tp-port=port-number=32702
          CollectFaultV2XProviderEndpoint: tp-configuration=udp-tp=udp-tp-port=port-number=32801
          CollectFaultV2XSubscriberEndpoint: tp-configuration=udp-tp=udp-tp-port=port-number=32802
          PlanningHmiDataProviderEndpoint: tp-configuration=udp-tp=udp-tp-port=port-number=33001
          PlanningHmiDataSubscriberEndpoint: tp-configuration=udp-tp=udp-tp-port=port-number=33002
          SensorRadarProviderEndpoint: tp-configuration=udp-tp=udp-tp-port=port-number=33101
          SensorRadarSubscriberEndpoint: tp-configuration=udp-tp=udp-tp-port=port-number=33102
          SmartCruiseControlProviderEndpoint: tp-configuration=udp-tp=udp-tp-port=port-number=33401
          SmartCruiseControlSubscriberEndpoint: tp-configuration=udp-tp=udp-tp-port=port-number=33402
          ControlBridgeProviderEndpoint: tp-configuration=udp-tp=udp-tp-port=port-number=33501
          ControlBridgeSubscriberEndpoint: tp-configuration=udp-tp=udp-tp-port=port-number=33502
          BridgeControlProviderEndpoint: tp-configuration=udp-tp=udp-tp-port=port-number=33601
          BridgeControlSubscriberEndpoint: tp-configuration=udp-tp=udp-tp-port=port-number=33602
          OTA_ClientEndpoint: tp-configuration=udp-tp=udp-tp-port=port-number=5000
package /adcm/CommunicationClusters
  ethernet cluster ADCMNet
    ethernet physical channel ADCMChannel: comm-connectors=AdaptiveMachineDesign/AdaptiveMachineConnector
      network endpoint AdaptiveMachineEndpoint: network-endpoint-addresses=ipv-4-configuration={default-gateway=192.168.1.1, ipv-4-address=192.168.1.99, network-mask=255.255.255.0}
      network endpoint SDNetworkEndpoint: network-endpoint-addresses=ipv-4-configuration=ipv-4-address=224.244.224.245
package /adcm/MachineDesigns
  machine design AdaptiveMachineDesign: service-discovery-configs=someip-service-discovery={multicast-sd-ip-address=ADCMChannel/SDNetworkEndpoint, someip-service-discovery-port=30490}
    ethernet communication connector AdaptiveMachineConnector: unicast-network-endpoint=ADCMChannel/AdaptiveMachineEndpoint
      65 x ap application endpoint:
        CanDataProviderEndpoint: tp-configuration=udp-tp=udp-tp-port=port-number=30101
        CanDataSubscriberEndpoint: tp-configuration=udp-tp=udp-tp-port=port-number=30102
        CanDataEtcProviderEndpoint: tp-configuration=udp-tp=udp-tp-port=port-number=30201
        CanDataEtcSubscriberEndpoint: tp-configuration=udp-tp=udp-tp-port=port-number=30202
        ConnectivityInfoProviderEndpoint: tp-configuration=udp-tp=udp-tp-port=port-number=30401
        ConnectivityInfoSubscriberEndpoint: tp-configuration=udp-tp=udp-tp-port=port-number=30402
        DrivingTrajectoryProviderEndpoint: tp-configuration=udp-tp=udp-tp-port=port-number=30501
        DrivingTrajectorySubscriberEndpoint: tp-configuration=udp-tp=udp-tp-port=port-number=30502
        EmergencyBrakingProviderEndpoint: tp-configuration=udp-tp=udp-tp-port=port-number=30601
        EmergencyBrakingSubscriberEndpoint: tp-configuration=udp-tp=udp-tp-port=port-number=30602
        LaneDetectionProviderEndpoint: tp-configuration=udp-tp=udp-tp-port=port-number=30701
        LaneDetectionSubscriberEndpoint: tp-configuration=udp-tp=udp-tp-port=port-number=30702
        LocalMapProviderEndpoint: tp-configuration=udp-tp=udp-tp-port=port-number=30801
        LocalMapSubscriberEndpoint: tp-configuration=udp-tp=udp-tp-port=port-number=30802
        MatchingInfoProviderEndpoint: tp-configuration=udp-tp=udp-tp-port=port-number=30901
        MatchingInfoSubscriberEndpoint: tp-configuration=udp-tp=udp-tp-port=port-number=30902
        PerceptionObstaclesProviderEndpoint: tp-configuration=udp-tp=udp-tp-port=port-number=31001
        PerceptionObstaclesSubscriberEndpoint: tp-configuration=udp-tp=udp-tp-port=port-number=31002
        PointMapProviderEndpoint: tp-configuration=udp-tp=udp-tp-port=port-number=31101
        PointMapSubscriberEndpoint: tp-configuration=udp-tp=udp-tp-port=port-number=31102
        ReportFaultProviderEndpoint: tp-configuration=udp-tp=udp-tp-port=port-number=31201
        ReportFaultSubscriberEndpoint: tp-configuration=udp-tp=udp-tp-port=port-number=31202
        RoutingPathProviderEndpoint: tp-configuration=udp-tp=udp-tp-port=port-number=31301
        RoutingPathSubscriberEndpoint: tp-configuration=udp-tp=udp-tp-port=port-number=31302
        RoutingResultProviderEndpoint: tp-configuration=udp-tp=udp-tp-port=port-number=31401
        RoutingResultSubscriberEndpoint: tp-configuration=udp-tp=udp-tp-port=port-number=31402
        RoutingSearchProviderEndpoint: tp-configuration=udp-tp=udp-tp-port=port-number=31501
        RoutingSearchSubscriberEndpoint: tp-configuration=udp-tp=udp-tp-port=port-number=31502
        SemanticMapProviderEndpoint: tp-configuration=udp-tp=udp-tp-port=port-number=31601
        SemanticMapSubscriberEndpoint: tp-configuration=udp-tp=udp-tp-port=port-number=31602
        TrafficLightProviderEndpoint: tp-configuration=udp-tp=udp-tp-port=port-number=31701
        TrafficLightSubscriberEndpoint: tp-configuration=udp-tp=udp-tp-port=port-number=31702
        V2XProviderEndpoint: tp-configuration=udp-tp=udp-tp-port=port-number=31801
        V2XSubscriberEndpoint: tp-configuration=udp-tp=udp-tp-port=port-number=31802
        VehicleLocationProviderEndpoint: tp-configuration=udp-tp=udp-tp-port=port-number=31901
        VehicleLocationSubscriberEndpoint: tp-configuration=udp-tp=udp-tp-port=port-number=31902
        CollectFaultControlProviderEndpoint: tp-configuration=udp-tp=udp-tp-port=port-number=32001
        CollectFaultControlSubscriberEndpoint: tp-configuration=udp-tp=udp-tp-port=port-number=32002
        CollectFaultHdmapProviderEndpoint: tp-configuration=udp-tp=udp-tp-port=port-number=32101
        CollectFaultHdmapSubscriberEndpoint: tp-configuration=udp-tp=udp-tp-port=port-number=32102
        CollectFaultHmiProviderEndpoint: tp-configuration=udp-tp=udp-tp-port=port-number=32201
        CollectFaultHmiSubscriberEndpoint: tp-configuration=udp-tp=udp-tp-port=port-number=32202
        CollectFaultLocalizationProviderEndpoint: tp-configuration=udp-tp=udp-tp-port=port-number=32301
        CollectFaultLocalizationSubscriberEndpoint: tp-configuration=udp-tp=udp-tp-port=port-number=32302
        CollectFaultPerceptionCameraProviderEndpoint: tp-configuration=udp-tp=udp-tp-port=port-number=32401
        CollectFaultPerceptionCameraSubscriberEndpoint: tp-configuration=udp-tp=udp-tp-port=port-number=32402
        CollectFaultPerceptionLidarProviderEndpoint: tp-configuration=udp-tp=udp-tp-port=port-number=32501
        CollectFaultPerceptionLidarSubscriberEndpoint: tp-configuration=udp-tp=udp-tp-port=port-number=32502
        CollectFaultPlanningProviderEndpoint: tp-configuration=udp-tp=udp-tp-port=port-number=32601
        CollectFaultPlanningSubscriberEndpoint: tp-configuration=udp-tp=udp-tp-port=port-number=32602
        CollectFaultRoutingProviderEndpoint: tp-configuration=udp-tp=udp-tp-port=port-number=32701
        CollectFaultRoutingSubscriberEndpoint: tp-configuration=udp-tp=udp-tp-port=port-number=32702
        CollectFaultV2XProviderEndpoint: tp-configuration=udp-tp=udp-tp-port=port-number=32801
        CollectFaultV2XSubscriberEndpoint: tp-configuration=udp-tp=udp-tp-port=port-number=32802
        PlanningHmiDataProviderEndpoint: tp-configuration=udp-tp=udp-tp-port=port-number=33001
        PlanningHmiDataSubscriberEndpoint: tp-configuration=udp-tp=udp-tp-port=port-number=33002
        SensorRadarProviderEndpoint: tp-configuration=udp-tp=udp-tp-port=port-number=33101
        SensorRadarSubscriberEndpoint: tp-configuration=udp-tp=udp-tp-port=port-number=33102
        SmartCruiseControlProviderEndpoint: tp-configuration=udp-tp=udp-tp-port=port-number=33401
        SmartCruiseControlSubscriberEndpoint: tp-configuration=udp-tp=udp-tp-port=port-number=33402
        ControlBridgeProviderEndpoint: tp-configuration=udp-tp=udp-tp-port=port-number=33501
        ControlBridgeSubscriberEndpoint: tp-configuration=udp-tp=udp-tp-port=port-number=33502
        BridgeControlProviderEndpoint: tp-configuration=udp-tp=udp-tp-port=port-number=33601
        BridgeControlSubscriberEndpoint: tp-configuration=udp-tp=udp-tp-port=port-number=33602
        OTA_ClientEndpoint: tp-configuration=udp-tp=udp-tp-port=port-number=5000
