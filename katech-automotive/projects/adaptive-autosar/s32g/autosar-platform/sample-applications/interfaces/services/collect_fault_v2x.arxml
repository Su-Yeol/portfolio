AUTOSAR XML (schema 00052)
package /adcm
  service interface collect_fault_v2x
    namespaces:
      symbol props adcm
    events:
      data collectFaultV2XEvent: type=collect_fault_v2x_Objects
package /adcm/events
  std cpp implementation data type collect_fault_v2x_Objects: category=STRUCTURE, type-emitter=TYPE_EMITTER_ARA
    namespaces:
      symbol props adcm
    cpp implementation data type element AP: type-reference={inplace=false, type-reference=uint8_t}
    cpp implementation data type element Fault_V2X: type-reference={inplace=false, type-reference=uint8Vector}
