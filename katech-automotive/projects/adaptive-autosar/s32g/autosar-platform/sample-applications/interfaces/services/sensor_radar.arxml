AUTOSAR XML (schema 00052)
package /adcm
  service interface sensor_radar
    namespaces:
      symbol props adcm
    events:
      data sensorRadarEvent: type=sensor_radar_Objects
package /adcm/events
  std cpp implementation data type sensor_radar_Objects: category=STRUCTURE, type-emitter=TYPE_EMITTER_ARA
    namespaces:
      symbol props adcm
    cpp implementation data type element Front: type-reference={inplace=false, type-reference=RadarFrontStruct}
    cpp implementation data type element Side: type-reference={inplace=false, type-reference=RadarPointVector}
  std cpp implementation data type RadarFrontStruct: category=STRUCTURE, type-emitter=TYPE_EMITTER_ARA
    namespaces:
      symbol props adcm
    cpp implementation data type element length: type-reference={inplace=false, type-reference=double}
    cpp implementation data type element RelativeVelocity: type-reference={inplace=false, type-reference=double}
