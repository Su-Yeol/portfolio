AUTOSAR XML (schema 00052)
package /adcm
  service interface driving_trajectory
    namespaces:
      symbol props adcm
    events:
      data drivingTrajectoryEvent: type=driving_trajectory_Objects
package /adcm/events
  4 x std cpp implementation data type, all with type-emitter=TYPE_EMITTER_ARA:
    driving_trajectory_Objects: category=STRUCTURE
      namespaces:
        symbol props adcm
      6 x cpp implementation data type element:
        TrajectoryPointVector: type-reference={inplace=false, type-reference=TrajectoryPointArray}
        Position: type-reference={inplace=false, type-reference=Vector3DStruct}
        Target_speed: type-reference={inplace=false, type-reference=double}
        Drive_Mode: type-reference={inplace=false, type-reference=bool}
        Emergency_acceleration: type-reference={inplace=false, type-reference=double}
        Turn_Signal: type-reference={inplace=false, type-reference=uint8_t}
    TrajectoryPointArray: category=VECTOR, cpp-template-argument=TrajectoryPoint
    TrajectoryPoint: category=STRUCTURE
      namespaces:
        symbol props adcm
      cpp implementation data type element Vector3D: type-reference={inplace=false, type-reference=Vector3DStruct}
    Vector3DStruct: category=STRUCTURE
      namespaces:
        symbol props adcm
      cpp implementation data type element x: type-reference={inplace=false, type-reference=double}
      cpp implementation data type element y: type-reference={inplace=false, type-reference=double}
      cpp implementation data type element yaw: type-reference={inplace=false, type-reference=double}
