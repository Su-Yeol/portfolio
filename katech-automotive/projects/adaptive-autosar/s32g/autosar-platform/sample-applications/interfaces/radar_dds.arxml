AUTOSAR XML (schema 00052)
package /apd/ServiceInterfaceDeployments
  dds service interface deployment Radar_Dds: service-interface=radar, field-reply-topic-name=DdsTopicRadarFieldReply, field-request-topic-name=DdsTopicRadarFieldRequest, method-reply-topic-name=DdsTopicRadarMethodReply, method-request-topic-name=DdsTopicRadarMethodRequest, service-interface-id=Radar, transport-protocols=UDP
    dds event deployment DdsEventBrakeEvent: event=brakeEvent, topic-name=DdsTopicBrakeEvent, transport-protocols=UDP
    dds event deployment DdsEventParkingBrakeEvent: event=parkingBrakeEvent, topic-name=DdsTopicParkingBrakeEvent, transport-protocols=UDP
    4 x dds field deployment:
      UpdateRate_Dds: field=UpdateRate
        notifier notifier: topic-name=DdsTopicUpdateRateNotifier, transport-protocols=UDP
      FrontObjectDistance_Dds: field=FrontObjectDistance
        notifier notifier: topic-name=DdsTopicFrontObjectDistanceNotifier, transport-protocols=UDP
      RearObjectDistance_Dds: field=RearObjectDistance
      ObjectDetectionLimit_Dds: field=ObjectDetectionLimit
