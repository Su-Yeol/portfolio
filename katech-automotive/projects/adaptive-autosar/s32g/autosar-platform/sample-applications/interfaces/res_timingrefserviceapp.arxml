AUTOSAR XML (schema 00052)
package /apd/ServiceInterfaces
  service interface SensorActuatorService
    namespaces:
      symbol props apd
      symbol props wgres
      symbol props tra
    events:
      data sensorData: type=uint32_t
    methods:
      operation Action
        arg intensity: type=uint32_t, direction=IN
        arg return_value: type=uint32_t, direction=OUT
