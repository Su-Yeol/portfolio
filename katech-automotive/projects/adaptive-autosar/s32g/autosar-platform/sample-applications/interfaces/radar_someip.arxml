AUTOSAR XML (schema 00052)
package /apd/ServiceInterfaceDeployments
  someip service interface deployment Radar_Someip: service-interface=radar, service-interface-id=99, service-interface-version={major-version=1, minor-version=0}
    someip event deployment Brake_Someip: event=brakeEvent, event-id=1, transport-protocol=UDP
    someip event deployment ParkingBrake_Someip: event=parkingBrakeEvent, event-id=2, transport-protocol=UDP
    4 x someip field deployment:
      UpdateRate_Someip: field=UpdateRate
        get getter: method-id=3001, transport-protocol=UDP
        notifier notifier: event-id=3000, transport-protocol=UDP
        set setter: method-id=3002, transport-protocol=UDP
      FrontObjectDistance_Someip: field=FrontObjectDistance
        notifier notifier: event-id=3004, transport-protocol=UDP
      RearObjectDistance_Someip: field=RearObjectDistance
        get getter: method-id=3006, transport-protocol=UDP
      ObjectDetectionLimit_Someip: field=ObjectDetectionLimit
        set setter: method-id=3011, transport-protocol=UDP
    someip method deployment Adjust_Someip: method=Adjust, method-id=32000, transport-protocol=UDP
    someip method deployment Calibrate_Someip: method=Calibrate, method-id=32010, transport-protocol=UDP
    someip method deployment EchoSomeipMethod: method=Echo, method-id=32020, transport-protocol=UDP
    4 x someip event group:
      SomeipEventgroup1: event-group-id=1, event=Brake_Someip
      SomeipEventgroup2: event-group-id=2, event=ParkingBrake_Someip
      SomeipEventgroup3: event-group-id=3, event=UpdateRate_Someip/notifier
      SomeipEventgroup4: event-group-id=4, event=FrontObjectDistance_Someip/notifier
