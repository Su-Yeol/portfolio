AUTOSAR XML (schema 00052)
package /apd/ServiceInterfaces
  service interface ImagePP
    namespaces:
      symbol props apd
      symbol props scenario2
      symbol props portinterfaces
    events:
      data Data: type=ByteArray
