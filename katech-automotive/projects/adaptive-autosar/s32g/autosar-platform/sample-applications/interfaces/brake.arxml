AUTOSAR XML (schema 00052)
package /apd/CppImplementationDataTypes
  std cpp implementation data type BrakeSignal: category=STRUCTURE, type-emitter=TYPE_EMITTER_ARA
    namespaces:
      symbol props apd
      symbol props scenario2
    cpp implementation data type element size: type-reference=uint8_t
    cpp implementation data type element payload: type-reference=uint8_t
package /apd/ServiceInterfaces
  service interface Brake
    namespaces:
      symbol props apd
      symbol props scenario2
      symbol props portinterfaces
    events:
      data BrakeSignal: type=BrakeSignal
