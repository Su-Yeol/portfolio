AUTOSAR XML (schema 00052)
package /apd/ServiceInterfaceDeployments
  someip service interface deployment PotentiallyMovingObjects_Someip: service-interface=PotentiallyMovingObjectsService, service-interface-id=0, service-interface-version={major-version=1, minor-version=0}
    someip event deployment PotentiallyMovingObjectsInterface_Someip: event=PotentiallyMovingObjectInterfaceEvent, event-id=1, transport-protocol=UDP
    someip method deployment Capability_Someip: method=PotentiallyMovingObjectsCapability, method-id=32000, transport-protocol=UDP
    someip event group SomeipEventgroup1: event-group-id=1, event=PotentiallyMovingObjectsInterface_Someip
