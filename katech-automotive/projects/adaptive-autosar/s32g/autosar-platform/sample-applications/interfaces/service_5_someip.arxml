AUTOSAR XML (schema 00052)
package /apd/ServiceInterfaceDeployments
  someip service interface deployment Service5_Someip: service-interface=Service5, service-interface-id=9
    someip event deployment Data_Someip: event=Data, event-id=1, transport-protocol=UDP
    someip event group Service5: event-group-id=1, event=Data_Someip
