AUTOSAR XML (schema 00052)
package /apd/CppImplementationDataTypes
  std cpp implementation data type UdsNrc: type-emitter=TYPE_EMITTER_ARA, type-reference=uint8_t
    namespaces:
      symbol props ara
      symbol props diag
  std cpp implementation data type UdsRh: type-emitter=TYPE_EMITTER_ARA, type-reference=uint16_t
    namespaces:
      symbol props ara
      symbol props diag
package /apd/ServiceInterfaces
  service interface RawServiceValidation
    namespaces:
      symbol props ara
      symbol props diag
    methods:
      operation Validate
        4 x arg:
          continueProcessing: type=bool, direction=OUT
          negativeResponseCode: type=UdsNrc, direction=OUT
          request: type=ByteArray, direction=IN
          requestHandle: type=UdsRh, direction=IN
      operation Confirmation
        arg requestHandle: type=UdsRh, direction=IN
        arg status: type=uint8_t, direction=IN
