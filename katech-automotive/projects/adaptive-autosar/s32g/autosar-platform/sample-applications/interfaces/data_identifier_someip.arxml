AUTOSAR XML (schema 00052)
package /apd/ServiceInterfaceDeployments
  someip service interface deployment DataIdentifier_Someip: service-interface=DataIdentifier, service-interface-id=1701
    someip method deployment Read_Someip: method=Read, method-id=1704, transport-protocol=UDP
    someip method deployment Write_Someip: method=Write, method-id=1705, transport-protocol=UDP
