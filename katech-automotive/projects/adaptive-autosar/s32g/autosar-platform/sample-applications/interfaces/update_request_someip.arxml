AUTOSAR XML (schema 00052)
package /apd/ServiceInterfaceDeployments
  someip service interface deployment UpdateRequest_Someip: service-interface=UpdateRequest, service-interface-id=666, service-interface-version={major-version=1, minor-version=0}
    6 x someip method deployment, all with transport-protocol=UDP:
      PrepareRollback: method=PrepareRollback, method-id=30004
      PrepareUpdate: method=PrepareUpdate, method-id=30001
      ResetMachine: method=ResetMachine, method-id=30002
      RequestUpdateSession: method=RequestUpdateSession, method-id=30000
      StopUpdateSession: method=StopUpdateSession, method-id=30005
      VerfiyUpdate: method=VerifyUpdate, method-id=30003
