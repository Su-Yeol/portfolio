AUTOSAR XML (schema 00052)
package /apd/CppImplementationDataTypes
  std cpp implementation data type PublisherObjects: category=STRUCTURE, type-emitter=TYPE_EMITTER_ARA
    namespaces:
      symbol props ara
      symbol props com
      symbol props sample
    cpp implementation data type element active: type-reference={inplace=false, type-reference=bool}
    cpp implementation data type element objectVector: type-reference={inplace=false, type-reference=ByteArray}
  std cpp implementation data type PositionData: category=STRUCTURE, type-emitter=TYPE_EMITTER_ARA
    namespaces:
      symbol props ara
      symbol props com
      symbol props sample
    cpp implementation data type element x: type-reference={inplace=false, type-reference=int32_t}
    cpp implementation data type element y: type-reference={inplace=false, type-reference=int32_t}
    cpp implementation data type element z: type-reference={inplace=false, type-reference=int32_t}
  std cpp implementation data type VariantData: compu {0x01=FV_CHINA (China), 0x05=FV_USA (USA), 0x06=FV_EUROPE (Europe), 0x07=FV_RUSSIA (Russia)}, type-emitter=TYPE_EMITTER_ARA, type-reference=uint16_t
    namespaces:
      symbol props ara
      symbol props com
      symbol props sample
package /apd/PubSubErrors
  ap application error domain SpecificErrors: value=44
    namespaces:
      symbol props ara
      symbol props com
      symbol props sample
  ap application error domain GenericErrors: value=45
    namespaces:
      symbol props ara
      symbol props com
      symbol props sample
  ap application error InvalidConfigString: error-code=5, error-domain=SpecificErrors  # Configuration string is invalid.
  ap application error InvalidParameter: error-code=6, error-domain=SpecificErrors  # Parameter is invalid.
  ap application error GenericFailure1: error-code=12, error-domain=GenericErrors  # Generic failure.
package /apd/ServiceInterfaces
  service interface CMValidatorPublisher
    namespaces:
      symbol props ara
      symbol props com
      symbol props sample
    events:
      data Event1: type=PublisherObjects
      data Event2: type=PublisherObjects
    field Field1: type=uint32_t, has-getter=true, has-notifier=true, has-setter=true
    field Field2: type=uint16_t, has-getter=false, has-notifier=true, has-setter=false
    methods:
      operation MethodsCapability: possible-ap-error=InvalidConfigString
        arg result: type=bool, direction=OUT
      operation Echo: fire-and-forget=true
        arg text: type=String, direction=IN
