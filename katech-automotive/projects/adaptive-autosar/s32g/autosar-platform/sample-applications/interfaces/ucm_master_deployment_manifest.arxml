AUTOSAR XML (schema 00052)
package /ara/apd/ucm_master/deployment
  someip service interface deployment VehicleDriverApplicationInterfaceSomeIp: service-interface=VehicleDriverApplicationInterface, service-interface-id=740, service-interface-version={major-version=1, minor-version=0}
    someip field deployment ApprovalRequired: field=ApprovalRequired
      get ApprovalRequired_getter: method-id=32101, transport-protocol=TCP
      notifier ApprovalRequired_notifier: event-id=9534, transport-protocol=TCP
    someip field deployment CampaignState: field=CampaignState
      get CampaignState_getter: method-id=32102, transport-protocol=TCP
      notifier CampaignState_notifier: event-id=9535, transport-protocol=TCP
    someip field deployment VehicleConditionCollection: field=VehicleConditionCollection
      get VehicleConditionCollection_getter: method-id=32103, transport-protocol=UDP
      notifier VehicleConditionCollection_notifier: event-id=9536, transport-protocol=UDP
    11 x someip method deployment:
      AllowCampaign: method=AllowCampaign, method-id=32001, transport-protocol=TCP
      CancelCampaign: method=CancelCampaign, method-id=32002, transport-protocol=TCP
      DriverApproval: method=DriverApproval, method-id=32003, transport-protocol=TCP
      GetCampaignHistory: method=GetCampaignHistory, method-id=32004, transport-protocol=TCP
      GetSwClusterInfo: method=GetSwClusterInfo, method-id=32005, transport-protocol=TCP
      GetSwPackageDescription: method=GetSwPackageDescription, method-id=32006, transport-protocol=TCP
      GetVehiclePackageDescription: method=GetVehiclePackageDescription, method-id=32011, transport-protocol=TCP
      GetSwProcessProgress: method=GetSwProcessProgress, method-id=32007, transport-protocol=TCP
      GetSwTransferToUCMProgress: method=GetSwTransferToUCMProgress, method-id=32008, transport-protocol=UDP
      ReportUnsupportedSafetyConditions: method=ReportUnsupportedSafetyConditions, method-id=32009, transport-protocol=UDP
      GetSwTransferToUCMMasterProgress: method=GetSwTransferToUCMMasterProgress, method-id=32010, transport-protocol=UDP
    someip event group ApprovalRequired_eventgroup: event-group-id=55001, event=ApprovalRequired_notifier
    someip event group CampaignState_eventgroup: event-group-id=55002, event=CampaignState/CampaignState_notifier
    someip event group VehicleConditionCollection_eventgroup: event-group-id=55003, event=VehicleConditionCollection/VehicleConditionCollection_notifier
  someip service interface deployment VehiclePackageManagementSomeIp: service-interface=VehiclePackageManagement, service-interface-id=730, service-interface-version={major-version=1, minor-version=0}
    someip field deployment RequestedPackage: field=RequestedPackage
      get RequestedPackage_getter: method-id=31006, transport-protocol=TCP
      notifier RequestedPackage_notifier: event-id=9433, transport-protocol=TCP
    someip field deployment TransferState: field=TransferState
      get TransferState_getter: method-id=31005, transport-protocol=TCP
      notifier TransferState_notifier: event-id=9432, transport-protocol=TCP
    someip field deployment VehicleConditionCollection: field=VehicleConditionCollection
      get VehicleConditionCollection_getter: method-id=31008, transport-protocol=UDP
      notifier VehicleConditionCollection_notifier: event-id=9435, transport-protocol=UDP
    12 x someip method deployment, all with transport-protocol=TCP:
      AllowCampaign: method=AllowCampaign, method-id=31100
      CancelCampaign: method=CancelCampaign, method-id=31109
      DeleteTransfer: method=DeleteTransfer, method-id=31111
      GetCampaignHistory: method=GetCampaignHistory, method-id=31110
      GetSwClusterInfo: method=GetSwClusterInfo, method-id=31102
      GetSwPackages: method=GetSwPackages, method-id=31112
      GetVehicleUCMInfo: method=GetVehicleUCMInfo, method-id=31113
      SwPackageInventory: method=SwPackageInventory, method-id=31101
      TransferData: method=TransferData, method-id=31105
      TransferExit: method=TransferExit, method-id=31106
      TransferStart: method=TransferStart, method-id=31103
      TransferVehiclePackage: method=TransferVehiclePackage, method-id=31104
    someip event group RequestedPackage_eventgroup: event-group-id=45401, event=RequestedPackage_notifier
    someip event group TransferState_eventgroup: event-group-id=45403, event=TransferState_notifier
    someip event group VehicleConditionCollection_eventgroup: event-group-id=45404, event=VehicleConditionCollection/VehicleConditionCollection_notifier
  someip service interface deployment VehicleStateManagerInterfaceSomeIp: service-interface=VehicleStateManagerInterface, service-interface-id=750, service-interface-version={major-version=1, minor-version=0}
    someip field deployment VehicleConditionCollection: field=VehicleConditionCollection
      get VehicleConditionCollection_getter: method-id=30101, transport-protocol=UDP
      notifier VehicleConditionCollection_notifier: event-id=9631, transport-protocol=UDP
    someip field deployment CampaignState: field=CampaignState
      get CampaignState_getter: method-id=30102, transport-protocol=TCP
      notifier CampaignState_notifier: event-id=9632, transport-protocol=TCP
    someip method deployment PublishSafetyState: method=PublishSafetyState, method-id=30001, transport-protocol=TCP
    someip method deployment VehicleCheck: method=VehicleCheck, method-id=30002, transport-protocol=TCP
    someip event group VehicleConditionCollection_eventgroup: event-group-id=65001, event=VehicleConditionCollection/VehicleConditionCollection_notifier
    someip event group CampaignState_eventgroup: event-group-id=65002, event=CampaignState/CampaignState_notifier
