AUTOSAR XML (schema 00052)
package /apd/ServiceInterfaces
  service interface ActorInterface: category=APPLICATION_LEVEL
    namespaces:
      symbol props apd
      symbol props picar
    methods:
      operation Move: fire-and-forget=true
        arg angle: type=int32_t, direction=IN
        arg speed: type=int32_t, direction=IN
