AUTOSAR XML (schema 00052)
package /apd/TlvDataIdDefinitionSet
  tlv data id definition set TlvDataIdDefinition_State
    tlv-data-id-definitions:
      id=0, tlv-implementation-data-type-element=temperature
      id=1, tlv-implementation-data-type-element=voltage
      id=2, tlv-implementation-data-type-element=current
      id=3, tlv-implementation-data-type-element=state
package /apd/TransformationToServiceInterfaceElementMapping
  transformation props to service interface element mapping tlv_TransformationProps_Mapping: method-return=State, tlv-data-id-definition=TlvDataIdDefinition_State, transformation-props=tlv_State_TransformationProps
  transformation props set TransformationPropsSet
    ap someip transformation props tlv_State_TransformationProps: is-dynamic-length-field-size=false, size-of-struct-length-field=2
package /apd/CppImplementationDataTypes
  std cpp implementation data type TlvStateDefs: compu {0x01=RS_AVAILABLE (Available), 0x03=RS_OFF (OFF)}, type-emitter=TYPE_EMITTER_ARA, type-reference=uint16_t
    namespaces:
      symbol props ara
      symbol props com
      symbol props sample
  std cpp implementation data type TlvState: category=STRUCTURE, type-emitter=TYPE_EMITTER_ARA
    namespaces:
      symbol props ara
      symbol props com
      symbol props sample
    4 x cpp implementation data type element:
      temperature: type-reference={inplace=false, type-reference=float}
      voltage: type-reference={inplace=false, type-reference=float}
      current: is-optional=true, type-reference={inplace=false, type-reference=float}
      state: is-optional=true, type-reference={inplace=false, type-reference=TlvStateDefs}
package /apd/ServiceInterfaces
  service interface tlv
    namespaces:
      symbol props ara
      symbol props com
      symbol props sample
    methods:
      operation State
        arg state: type=TlvState, direction=OUT
