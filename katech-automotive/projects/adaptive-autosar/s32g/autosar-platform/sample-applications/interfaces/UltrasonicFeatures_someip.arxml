AUTOSAR XML (schema 00052)
package /apd/ServiceInterfaceDeployments
  someip service interface deployment UltrasonicFeatures_Someip: service-interface=UltrasonicFeaturesService, service-interface-id=4, service-interface-version={major-version=1, minor-version=0}
    someip event deployment UltrasonicFeaturesInterface_Someip: event=UltrasonicFeatureInterfaceEvent, event-id=1, transport-protocol=UDP
    someip method deployment Capability_Someip: method=UltrasonicFeaturesCapability, method-id=32000, transport-protocol=UDP
    someip event group SomeipEventgroup1: event-group-id=1, event=UltrasonicFeaturesInterface_Someip
