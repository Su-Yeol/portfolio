AUTOSAR XML (schema 00052)
package /apd/ServiceInterfaces
  service interface Cmts
    namespaces:
      symbol props ara
      symbol props com
      symbol props test
    field TestCounter: type=uint16_t, has-getter=true, has-notifier=false, has-setter=true
