AUTOSAR XML (schema 00052)
package /apd/ServiceInterfaceDeployments
  someip service interface deployment TriggerIn_Someip: service-interface=TriggerIn, service-interface-id=667, service-interface-version={major-version=1, minor-version=0}
    someip field deployment Trigger_Someip: field=Trigger
      set Set: method-id=1, transport-protocol=UDP
