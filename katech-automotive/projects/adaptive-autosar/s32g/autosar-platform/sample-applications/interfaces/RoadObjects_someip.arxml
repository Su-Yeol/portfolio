AUTOSAR XML (schema 00052)
package /apd/ServiceInterfaceDeployments
  someip service interface deployment RoadObjects_Someip: service-interface=RoadObjectsService, service-interface-id=199, service-interface-version={major-version=1, minor-version=0}
    someip event deployment RoadObjectInterface_Someip: event=RoadObjectInterfaceEvent, event-id=1, transport-protocol=UDP
    someip method deployment Capability_Someip: method=RoadObjectsCapability, method-id=32000, transport-protocol=UDP
    someip event group SomeipEventgroup1: event-group-id=1, event=RoadObjectInterface_Someip
