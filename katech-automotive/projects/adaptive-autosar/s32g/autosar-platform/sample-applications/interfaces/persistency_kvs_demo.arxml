AUTOSAR XML (schema 00052)
package /apd/PersistencyKeyValueDatabaseInterfaces
  persistency key value storage interface PersistencyKvsDemo
