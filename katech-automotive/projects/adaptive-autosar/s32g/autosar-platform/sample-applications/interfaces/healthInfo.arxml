AUTOSAR XML (schema 00052)
package /apd/CppImplementationDataTypes
  std cpp implementation data type HealthInfoStructure: category=STRUCTURE, type-emitter=TYPE_EMITTER_ARA
    namespaces:
      symbol props ara
      symbol props com
      symbol props sample
    cpp implementation data type element GlobalSupervisionInfoVector: type-reference={inplace=false, type-reference=ByteArray}
  std cpp implementation data type PlatformHealthIndicatorStructure: category=STRUCTURE, type-emitter=TYPE_EMITTER_ARA
    namespaces:
      symbol props ara
      symbol props com
      symbol props sample
    cpp implementation data type element HealthIndicatorID: type-reference={inplace=false, type-reference=int8_t}
    cpp implementation data type element Reliability: type-reference={inplace=false, type-reference=int16_t}
package /apd/SHMErrors
  ap application error domain SpecificErrors: value=44
    namespaces:
      symbol props ara
      symbol props com
      symbol props sample
  ap application error domain GenericErrors: value=45
    namespaces:
      symbol props ara
      symbol props com
      symbol props sample
  ap application error InvalidConfigString: error-code=5, error-domain=SpecificErrors  # Configuration string is invalid.
  ap application error InvalidParameter: error-code=6, error-domain=SpecificErrors  # Parameter is invalid.
  ap application error GenericFailure: error-code=12, error-domain=GenericErrors  # Generic failure.
package /apd/ServiceInterfaces
  service interface HealthInfo
    namespaces:
      symbol props ara
      symbol props com
      symbol props sample
    events:
      data HealthInfoEvent: type=HealthInfoStructure
      data HealthIndicatorEvent: type=PlatformHealthIndicatorStructure
