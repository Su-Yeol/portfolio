AUTOSAR XML (schema 00052)
package /apd/ServiceInterfaces
  service interface ddsservice3
    namespaces:
      symbol props apd
      symbol props testsuite
      symbol props cmdds
    field FieldA: type=uint32_t, has-getter=true, has-notifier=true, has-setter=true
