AUTOSAR XML (schema 00052)
package /apd/ServiceInterfaceDeployments
  someip service interface deployment Service8_Someip: service-interface=Service8, service-interface-id=10
    someip event deployment Data_someip: event=Data, event-id=1, transport-protocol=UDP
    someip event group Service8: event-group-id=1, event=Data_someip
