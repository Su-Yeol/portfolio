AUTOSAR XML (schema 00052)
package /apd/CppImplementationDataTypes
  std cpp implementation data type DDSVehicleState: compu {0x01=DRIVING, 0x02=PARKING, 0x03=STARTUP, 0x04=SHUTDOWN}, type-emitter=TYPE_EMITTER_ARA, type-reference=uint16_t  # Insert description here if needed.
    namespaces:
      symbol props apd
      symbol props testsuite
      symbol props cmdds
  std cpp implementation data type DDSFusionVariant: compu {0x01=FV_CHINA (China), 0x05=FV_USA (USA), 0x06=FV_EUROPE (Europe), 0x07=FV_RUSSIA (Russia)}, type-emitter=TYPE_EMITTER_ARA, type-reference=uint16_t
    namespaces:
      symbol props apd
      symbol props testsuite
      symbol props cmdds
package /apd/ServiceInterfaces
  service interface ddsservice4
    namespaces:
      symbol props apd
      symbol props testsuite
      symbol props cmdds
    methods:
      operation MethodA
        arg configuration: type=String, direction=IN
        arg vehiclestate: type=DDSVehicleState, direction=IN
        arg result: type=bool, direction=OUT
      operation MethodB
        arg configuration: type=String, direction=IN
        arg variant: type=DDSFusionVariant, direction=IN
        arg result: type=bool, direction=OUT
