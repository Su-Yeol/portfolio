AUTOSAR XML (schema 00052)
package /apd/ServiceInterfaceDeployments
  someip service interface deployment RadarDetections_Someip: service-interface=RadarDetectionsService, service-interface-id=5, service-interface-version={major-version=1, minor-version=0}
    someip event deployment RadarDetectionsInterface_Someip: event=RadarDetectionsInterfaceEvent, event-id=1, transport-protocol=UDP
    someip method deployment Capability_Someip: method=RadarDetectionsCapability, method-id=32000, transport-protocol=UDP
    someip event group SomeipEventgroup1: event-group-id=1, event=RadarDetectionsInterface_Someip
