AUTOSAR XML (schema 00052)
package /apd/ServiceInterfaceDeployments
  someip service interface deployment CameraDetection_Someip: service-interface=CameraDetectionsService, service-interface-id=7, service-interface-version={major-version=1, minor-version=0}
    someip event deployment CameraDetectionInterface_Someip: event=CameraDetectionsEvent, event-id=1, transport-protocol=UDP
    someip method deployment Capability_Someip: method=CameraDetectionsCapability, method-id=32000, transport-protocol=UDP
    someip event group SomeipEventgroup1: event-group-id=1, event=CameraDetectionInterface_Someip
