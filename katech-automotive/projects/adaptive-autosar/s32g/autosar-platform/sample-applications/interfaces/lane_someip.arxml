AUTOSAR XML (schema 00052)
package /apd/ServiceInterfaceDeployments
  someip service interface deployment Lane_Someip: service-interface=Lane, service-interface-id=3
    someip event deployment Data_Someip: event=Data, event-id=1, transport-protocol=UDP
    someip event group Lane: event-group-id=1, event=Data_Someip
