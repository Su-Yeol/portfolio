AUTOSAR XML (schema 00052)
package /apd/ServiceInterfaceDeployments
  dds service interface deployment DDSService3_Dds: service-interface=ddsservice3, field-reply-topic-name=DdsTopicFieldAReply, field-request-topic-name=DdsTopicFieldARequest, service-interface-id=ddsservice3, transport-protocols=UDP
    dds field deployment FieldA_Dds: field=FieldA
      notifier notifier: topic-name=DdsTopicFieldANotifier, transport-protocols=UDP
