AUTOSAR XML (schema 00052)
package /apd/SoftwareClusters/Controller
  software cluster ControllerAppSwcl: artifact-checksums=@ARTIFACT_CHECKSUMS@, claimed-function-group=ControllerApplicationFG, installation-behavior=CAN-BE-REMOVED, license=AUTOSAR_LIC, release-notes=R2003_RN, type-approval=e1*2024/123*4567*89, vendor-id=1447315780, version=2.0.0
