AUTOSAR XML (schema 00052)
package /apd/diag
  adaptive application sw component type SeedKeyProvider
    provide port port: provided-interface=SecurityAccess
  executable SeedKeyExe
    root sw component prototype service: application-type=SeedKeyProvider
  process SeedKey_instance: design=SeedKey_instance_design, executable=SeedKeyExe
  process design SeedKey_instance_design: executable=SeedKeyExe
  process to machine mapping set ProcessToMachineMappingSet
    process to machine mapping SeedKeyInstanceProcessMapping: machine=dmMachine, process=SeedKey_instance
