AUTOSAR XML (schema 00052)
package /apd/AdaptiveApplicationSwComponentTypes
  adaptive application sw component type EmoSampleApplication
package /apd/Executables
  executable EmoSampleApplication: category=APPLICATION_LEVEL, minimum-timer-granularity=1000, reporting-behavior=REPORTS-EXECUTION-STATE
    root sw component prototype EmoSampleApplication: application-type=EmoSampleApplication
