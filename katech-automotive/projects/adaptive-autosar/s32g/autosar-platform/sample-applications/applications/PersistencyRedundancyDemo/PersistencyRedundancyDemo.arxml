AUTOSAR XML (schema 00052)
package /apd/AdaptiveApplicationSwComponentTypes
  adaptive application sw component type PersistencyRedundancyDemo_SwComp
    provide/require port PersistencyRedundancyDemo_PRPort: provided-required-interface=PersistencyRedundancyDemo_KvsInterf
package /apd/Executables
  executable PersistencyRedundancyDemo: category=APPLICATION_LEVEL, minimum-timer-granularity=1000.0
    root sw component prototype PersistencyRedundancyDemo_RootSwComp: application-type=PersistencyRedundancyDemo_SwComp
