AUTOSAR XML (schema 00052)
package /apd/AdaptiveApplicationSwComponentTypes
  adaptive application sw component type update_adapter_android
    provide port PackageManagementProvided: provided-interface=PackageManagement
    provide/require port SwClusterDescPRPort: provided-required-interface=SwClusterDescriptionKVSInterface
    provide/require port SwPackageTransferStatusPRPort: provided-required-interface=SwPackageTransferStatus
package /apd/Executables
  executable update_adapter_android: category=APPLICATION_LEVEL, minimum-timer-granularity=1000.0, version=1.0.0
    root sw component prototype UpdateAdapterAndroidSwc: application-type=update_adapter_android
