AUTOSAR XML (schema 00052)
package /apd/AdaptiveApplicationSwComponentTypes
  adaptive application sw component type pkgmgr_sample
    require port PackageManagementRPort: required-interface=PackageManagement
package /apd/Executables
  executable pkgmgr_sample: category=APPLICATION_LEVEL, minimum-timer-granularity=1000.0, version=1.0.0
    root sw component prototype pkgmgr_app_root: application-type=pkgmgr_sample
