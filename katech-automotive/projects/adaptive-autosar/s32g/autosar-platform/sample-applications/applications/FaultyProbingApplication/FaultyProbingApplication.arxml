AUTOSAR XML (schema 00052)
package /apd/AdaptiveApplicationSwComponentTypes
  adaptive application sw component type FaultyProbingApplication
package /apd/Executables
  executable FaultyProbingApplication: category=APPLICATION_LEVEL, minimum-timer-granularity=1000, reporting-behavior=REPORTS-EXECUTION-STATE
    root sw component prototype FaultyProbingApp: application-type=FaultyProbingApplication
