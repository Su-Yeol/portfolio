AUTOSAR XML (schema 00052)
package /adcm/AdaptiveApplicationSwComponentTypes
  adaptive application sw component type TimeSyncConsumer
package /adcm/Executables
  executable TimeSyncConsumer: category=APPLICATION_LEVEL, minimum-timer-granularity=1000
    root sw component prototype TimeSyncConsumerRoot: application-type=TimeSyncConsumer
