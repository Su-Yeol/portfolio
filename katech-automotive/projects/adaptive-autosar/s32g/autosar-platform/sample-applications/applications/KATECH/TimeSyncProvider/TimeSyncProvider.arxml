AUTOSAR XML (schema 00052)
package /adcm/AdaptiveApplicationSwComponentTypes
  adaptive application sw component type TimeSyncProvider
package /adcm/Executables
  executable TimeSyncProvider: category=APPLICATION_LEVEL, minimum-timer-granularity=1000
    root sw component prototype TimeSyncProviderRoot: application-type=TimeSyncProvider
