AUTOSAR XML (schema 00052)
package /apd/AdaptiveApplicationSwComponentTypes
  adaptive application sw component type vehicle_driver_application
    require port VehicleDriverApplicationInterfaceRPort: required-interface=VehicleDriverApplicationInterface
package /apd/Executables
  executable vehicle_driver_application: category=APPLICATION_LEVEL, minimum-timer-granularity=1000.0, version=1.0.0
    root sw component prototype app_root: application-type=vehicle_driver_application
