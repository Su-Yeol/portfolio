AUTOSAR XML (schema 00052)
package /apd/AdaptiveApplicationSwComponentTypes
  adaptive application sw component type ST_DDSApp01
    5 x provide port:
      DDSApp01Service{1..5}PPort: provided-interface=ddsservice{1..5}
package /apd/Executables
  executable ST_DDSApp01: category=APPLICATION_LEVEL, minimum-timer-granularity=1000
    root sw component prototype ST_DDSApp01Root: application-type=ST_DDSApp01
