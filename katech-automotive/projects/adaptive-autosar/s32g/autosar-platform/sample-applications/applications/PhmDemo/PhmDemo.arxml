AUTOSAR XML (schema 00052)
package /apd/AdaptiveApplicationSwComponentTypes
  adaptive application sw component type PhmDemo
package /apd/Executables
  executable PhmDemo: category=APPLICATION_LEVEL, minimum-timer-granularity=1000
    root sw component prototype PhmDemo: application-type=PhmDemo
